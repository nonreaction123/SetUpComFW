/*@!Encoding:1252*/
includes
{
  #pragma library("..\..\Exec32\capldll.dll")
  
  
}



variables
{
  const byte KEYPAIR_SIZE = 104;


  BYTE C1_BLE_Flash[KEYPAIR_SIZE] = { 0x45,0x43,0x53,0x32,0x20,0x00,0x00,0x00,0x3b,0x9c,0x37,0x74,0xd1,0xbe,0x63,0xe5,0x04,0x5c,0xd3,0x43,0x06,0x28,0xa9,0x71,0xa4,0xc1,0x90,0x28,0xf1,0x37,0xe6,0x42,0x34,0x42,0xa8,0x43,0xd5,0xfe,0xb9,0x4b,0xb1,0x69,0x5e,0xdf,0xc3,0x9a,0x73,0xd3,0xd1,0x8a,0xca,0xaa,0x74,0xca,0x6d,0x4b,0xf5,0x50,0x21,0x65,0x88,0x92,0x89,0xda,0x07,0xff,0x3a,0x53,0x2e,0x89,0xbb,0x19,0x59,0x4f,0x7e,0x41,0xa0,0xcf,0x7e,0x0b,0x75,0xfd,0x99,0x19,0x2c,0x64,0xdd,0xd2,0xcb,0x97,0x8c,0x4f,0x81,0x8d,0x85,0xb0,0x34,0x4f,0xa5,0x4f,0xc8,0x6e,0xa0,0xf9 };
  BYTE C1_S32_Flash[KEYPAIR_SIZE] = { 0x45,0x43,0x53,0x32,0x20,0x00,0x00,0x00,0xa7,0xc3,0x53,0x7a,0x7f,0x71,0xbb,0x8a,0xe4,0x5f,0x13,0xaf,0x31,0x0a,0xf6,0xd5,0xbb,0xdb,0xe5,0x96,0xd1,0x09,0xea,0x17,0x74,0xb9,0x9d,0xf2,0xc5,0xfd,0x6d,0xef,0xe6,0x3a,0x8c,0x8a,0x7b,0xd4,0x6d,0x3a,0x6a,0x81,0xf4,0x48,0x75,0x3e,0x94,0x12,0xe9,0x98,0xd9,0xa5,0xef,0xee,0x40,0x62,0x9a,0x54,0x3f,0x48,0x38,0x9f,0xcb,0x6c,0x44,0xe1,0x35,0xa2,0xce,0xc4,0xe3,0x40,0x79,0x48,0xd1,0x8b,0x4f,0x54,0xbe,0xf9,0x4a,0xf3,0x6f,0xea,0xa1,0xc7,0xb3,0x73,0x51,0x78,0xc9,0x95,0xcf,0x5a,0x3d,0x5f };
  BYTE C1_UDS_inCar[KEYPAIR_SIZE] = { 0x45,0x43,0x53,0x32,0x20,0x00,0x00,0x00,0x10,0x42,0xa5,0xda,0xdf,0x07,0x22,0x6d,0x16,0xbe,0x11,0x51,0x3b,0x47,0x52,0x88,0x01,0x28,0xa9,0xc5,0x49,0xa1,0xc0,0xcf,0xd6,0xd2,0xed,0xba,0x36,0xcc,0x59,0xbc,0xc0,0x04,0x57,0x4b,0xc4,0x7a,0x99,0x32,0x56,0xb2,0xb9,0x1f,0x36,0xae,0xc0,0x40,0xcb,0xf5,0x2b,0x8f,0x9a,0xed,0xc9,0x3d,0x35,0x85,0xd5,0x98,0x74,0x89,0xf7,0x66,0xe4,0xc3,0x2b,0x6a,0x84,0xbc,0x24,0x3a,0xdf,0xfc,0xda,0x64,0xf3,0xbf,0x44,0x96,0x97,0xad,0xc6,0x52,0x90,0x73,0x54,0x4a,0xd1,0x78,0xf8,0x9b,0x8d,0xfb,0xa6,0x57 };
  BYTE C1_UDS_Bosch[KEYPAIR_SIZE] = { 0x45,0x43,0x53,0x32,0x20,0x00,0x00,0x00,0x49,0x52,0x23,0xfd,0x04,0x4a,0x02,0xd6,0xf7,0xbe,0xb5,0xa8,0x9f,0x1d,0xd3,0x17,0x9e,0x0f,0x23,0x54,0x41,0xc5,0x4e,0xbd,0x37,0x20,0x39,0xcc,0x24,0x71,0xed,0x19,0x69,0xc3,0x9e,0xb5,0x2d,0x1b,0x3b,0xe3,0xf3,0xe0,0xd4,0xae,0x59,0xdd,0x81,0xa3,0xe6,0x67,0x25,0x5f,0x26,0x04,0x40,0xdf,0x66,0x15,0x32,0x23,0xb2,0xeb,0xf4,0xd6,0x0c,0x8d,0x19,0x98,0xda,0x96,0x2a,0x3a,0xb3,0x4d,0x6b,0x3f,0xe5,0xb2,0x8c,0x24,0xf9,0xc0,0x20,0x09,0x9c,0x74,0xf0,0x5c,0x6d,0x70,0x92,0x96,0x65,0x47,0xdf,0x55 };
  
  BYTE C1_UAES_BLE_Flash[KEYPAIR_SIZE] = { 0x45,0x43,0x53,0x32,0x20,0x00,0x00,0x00,0xd8,0xb9,0x38,0x81,0xa0,0x74,0x39,0x2b,0x4f,0x75,0xe0,0x9b,0xa4,0x2b,0x80,0xee,0xbd,0x85,0xaf,0x3d,0x8f,0x08,0xf9,0x36,0xa4,0x4c,0x34,0x87,0x0e,0x7a,0x69,0x87,0x15,0x6d,0xc4,0x33,0x32,0x20,0x1d,0xf5,0x4a,0x80,0x1c,0x19,0xd9,0xc2,0xb8,0x7a,0xfb,0x37,0xce,0xb5,0xa3,0x69,0x83,0x38,0x7b,0x3c,0x30,0xb8,0x91,0xe1,0x4f,0x2f,0x4c,0xca,0xa4,0x19,0x96,0xf4,0x0a,0x7d,0xfb,0x53,0xbe,0x23,0xeb,0xdf,0xbb,0xa9,0xf6,0x24,0x44,0x95,0xfd,0xd2,0xb3,0xa9,0xe6,0x57,0x7f,0x0f,0x43,0x0a,0x0c,0x7a };
  BYTE C1_UAES_S32_Flash[KEYPAIR_SIZE] = { 0x45,0x43,0x53,0x32,0x20,0x00,0x00,0x00,0xd8,0xd6,0x24,0x2b,0xaf,0x4a,0x93,0x9a,0xeb,0x6b,0x84,0xb0,0x63,0x3d,0x2a,0xc7,0x20,0x55,0x41,0x84,0xcf,0xa3,0x98,0xe4,0x87,0x52,0xc8,0x16,0x4a,0xa5,0x28,0x34,0x1b,0xce,0x12,0x31,0x7c,0xac,0xa2,0x7a,0x3f,0x09,0x9b,0xa6,0xa8,0xfe,0x2a,0x61,0xc3,0xb6,0xa6,0x3b,0x00,0x88,0xd0,0xa3,0xbe,0xff,0x39,0x80,0xe3,0x6c,0xa8,0x16,0x8a,0x1e,0xc7,0x89,0x2e,0xd2,0x8a,0x65,0x92,0xe9,0xc3,0x80,0x6d,0x8d,0x4a,0x34,0x52,0xb4,0x0e,0xe6,0xdc,0x87,0xb5,0x10,0xc2,0x73,0x8c,0x15,0x44,0x66,0x15,0x52 };
  BYTE C1_UAES_UDS_inCar[KEYPAIR_SIZE] = { 0x45,0x43,0x53,0x32,0x20,0x00,0x00,0x00,0xab,0x17,0x75,0x66,0x5f,0x73,0x62,0x5c,0x2c,0x47,0xe7,0x0b,0x1c,0xe8,0x76,0x15,0xec,0xe5,0x88,0xc8,0x51,0x94,0x01,0xdd,0xcb,0x82,0x83,0x23,0x52,0x1b,0xf2,0xdd,0x49,0x69,0x1a,0x04,0xae,0x0c,0x39,0xf3,0x14,0x09,0xc6,0x4c,0xb4,0xb1,0xa7,0x64,0xb8,0x98,0x7a,0x8a,0x89,0x2f,0x9c,0xe3,0x09,0x47,0x47,0x60,0xde,0x2e,0x29,0xd5,0x84,0x9a,0x22,0x3c,0xd8,0xe6,0x20,0x9f,0xa4,0x9c,0xca,0x30,0x44,0xf1,0x63,0x83,0x5d,0xa7,0x87,0xdb,0x59,0xcc,0x84,0xaa,0x29,0xda,0x87,0xa0,0xe0,0x89,0xfd,0x6e };
  BYTE C1_UAES_UDS_Bosch[KEYPAIR_SIZE] = { 0x45,0x43,0x53,0x32,0x20,0x00,0x00,0x00,0xa1,0x92,0x91,0x7e,0xc3,0x2f,0x7e,0x2d,0x39,0x0e,0xd9,0x16,0x59,0x6c,0xd1,0x32,0xcc,0x53,0x39,0x91,0x1b,0x32,0x04,0xb7,0xf2,0x4a,0x11,0xfa,0x5d,0xcd,0x87,0x44,0xa2,0xb4,0x24,0xf7,0x80,0xb7,0xd1,0x3f,0x38,0xe0,0x8c,0xe9,0x6e,0xf3,0x52,0xa4,0x81,0xfb,0x18,0x5d,0xce,0x6e,0x0f,0x6e,0x2d,0xa9,0xa1,0x51,0x74,0x1e,0x37,0xaf,0x80,0x85,0xa5,0x3b,0xef,0x1e,0x65,0x59,0x9d,0x81,0x35,0x06,0x46,0x40,0x69,0xe5,0x35,0xbd,0x5d,0x20,0x4a,0x78,0x7b,0xf5,0x7c,0x29,0x89,0xb5,0xaf,0x8e,0x3e,0xba };
  
  BYTE C1_DEV_BLE_Flash[KEYPAIR_SIZE] = { 0x45,0x43,0x53,0x32,0x20,0x00,0x00,0x00,0x3b,0x9c,0x37,0x74,0xd1,0xbe,0x63,0xe5,0x04,0x5c,0xd3,0x43,0x06,0x28,0xa9,0x71,0xa4,0xc1,0x90,0x28,0xf1,0x37,0xe6,0x42,0x34,0x42,0xa8,0x43,0xd5,0xfe,0xb9,0x4b,0xb1,0x69,0x5e,0xdf,0xc3,0x9a,0x73,0xd3,0xd1,0x8a,0xca,0xaa,0x74,0xca,0x6d,0x4b,0xf5,0x50,0x21,0x65,0x88,0x92,0x89,0xda,0x07,0xff,0x3a,0x53,0x2e,0x89,0xbb,0x19,0x59,0x4f,0x7e,0x41,0xa0,0xcf,0x7e,0x0b,0x75,0xfd,0x99,0x19,0x2c,0x64,0xdd,0xd2,0xcb,0x97,0x8c,0x4f,0x81,0x8d,0x85,0xb0,0x34,0x4f,0xa5,0x4f,0xc8,0x6e,0xa0,0xf9 };
  BYTE C1_DEV_S32_Flash[KEYPAIR_SIZE] = { 0x45,0x43,0x53,0x32,0x20,0x00,0x00,0x00,0xa7,0xc3,0x53,0x7a,0x7f,0x71,0xbb,0x8a,0xe4,0x5f,0x13,0xaf,0x31,0x0a,0xf6,0xd5,0xbb,0xdb,0xe5,0x96,0xd1,0x09,0xea,0x17,0x74,0xb9,0x9d,0xf2,0xc5,0xfd,0x6d,0xef,0xe6,0x3a,0x8c,0x8a,0x7b,0xd4,0x6d,0x3a,0x6a,0x81,0xf4,0x48,0x75,0x3e,0x94,0x12,0xe9,0x98,0xd9,0xa5,0xef,0xee,0x40,0x62,0x9a,0x54,0x3f,0x48,0x38,0x9f,0xcb,0x6c,0x44,0xe1,0x35,0xa2,0xce,0xc4,0xe3,0x40,0x79,0x48,0xd1,0x8b,0x4f,0x54,0xbe,0xf9,0x4a,0xf3,0x6f,0xea,0xa1,0xc7,0xb3,0x73,0x51,0x78,0xc9,0x95,0xcf,0x5a,0x3d,0x5f };
  BYTE C1_DEV_UDS_inCar[KEYPAIR_SIZE] = { 0x45,0x43,0x53,0x32,0x20,0x00,0x00,0x00,0x10,0x42,0xa5,0xda,0xdf,0x07,0x22,0x6d,0x16,0xbe,0x11,0x51,0x3b,0x47,0x52,0x88,0x01,0x28,0xa9,0xc5,0x49,0xa1,0xc0,0xcf,0xd6,0xd2,0xed,0xba,0x36,0xcc,0x59,0xbc,0xc0,0x04,0x57,0x4b,0xc4,0x7a,0x99,0x32,0x56,0xb2,0xb9,0x1f,0x36,0xae,0xc0,0x40,0xcb,0xf5,0x2b,0x8f,0x9a,0xed,0xc9,0x3d,0x35,0x85,0xd5,0x98,0x74,0x89,0xf7,0x66,0xe4,0xc3,0x2b,0x6a,0x84,0xbc,0x24,0x3a,0xdf,0xfc,0xda,0x64,0xf3,0xbf,0x44,0x96,0x97,0xad,0xc6,0x52,0x90,0x73,0x54,0x4a,0xd1,0x78,0xf8,0x9b,0x8d,0xfb,0xa6,0x57 };
  BYTE C1_DEV_UDS_Bosch[KEYPAIR_SIZE] = { 0x45,0x43,0x53,0x32,0x20,0x00,0x00,0x00,0x49,0x52,0x23,0xfd,0x04,0x4a,0x02,0xd6,0xf7,0xbe,0xb5,0xa8,0x9f,0x1d,0xd3,0x17,0x9e,0x0f,0x23,0x54,0x41,0xc5,0x4e,0xbd,0x37,0x20,0x39,0xcc,0x24,0x71,0xed,0x19,0x69,0xc3,0x9e,0xb5,0x2d,0x1b,0x3b,0xe3,0xf3,0xe0,0xd4,0xae,0x59,0xdd,0x81,0xa3,0xe6,0x67,0x25,0x5f,0x26,0x04,0x40,0xdf,0x66,0x15,0x32,0x23,0xb2,0xeb,0xf4,0xd6,0x0c,0x8d,0x19,0x98,0xda,0x96,0x2a,0x3a,0xb3,0x4d,0x6b,0x3f,0xe5,0xb2,0x8c,0x24,0xf9,0xc0,0x20,0x09,0x9c,0x74,0xf0,0x5c,0x6d,0x70,0x92,0x96,0x65,0x47,0xdf,0x55 };
  
  BYTE C2_BLE_Flash[KEYPAIR_SIZE] = { 0x45,0x43,0x53,0x32,0x20,0x00,0x00,0x00,0x26,0xbd,0x55,0x27,0xfd,0x81,0x6c,0xa4,0x15,0x36,0xbe,0x75,0x68,0x63,0xd8,0xba,0x18,0xc7,0xbd,0x96,0x57,0x86,0xc9,0x04,0xc3,0xb9,0xbd,0xb5,0xf9,0x55,0xb0,0x44,0xc7,0x7b,0x3e,0xf2,0xb8,0xa6,0xba,0xd9,0x16,0x00,0x86,0xe4,0xfc,0x96,0x65,0x05,0x09,0xca,0xb7,0x07,0x57,0x50,0x44,0x09,0x75,0xcb,0xad,0x37,0xfb,0xb6,0x4e,0xc3,0xaa,0xb3,0x9b,0x32,0xf3,0x6e,0xe8,0x73,0xb4,0x75,0x0a,0x91,0x37,0xae,0xb1,0x2c,0x99,0x1d,0xa0,0xa8,0x3a,0x45,0xad,0x16,0xf4,0x75,0x30,0x6a,0x76,0x93,0xc1,0x2f };
  BYTE C2_S32_Flash[KEYPAIR_SIZE] = { 0x45,0x43,0x53,0x32,0x20,0x00,0x00,0x00,0x4b,0x78,0x7b,0x41,0x5b,0x59,0x9e,0xaa,0x19,0x22,0xbe,0x3e,0x32,0x3b,0x03,0x88,0x17,0x20,0x11,0x86,0xdf,0x86,0xa6,0x09,0xb7,0xdd,0x71,0x5b,0x06,0xe3,0xf5,0xc6,0xf4,0x77,0x12,0x87,0x40,0x38,0x7d,0x7d,0x3d,0x23,0xd4,0x99,0x4e,0x6d,0x6c,0xf0,0x7f,0xd3,0xfb,0x32,0x7a,0xa4,0x83,0x2b,0x04,0xee,0x7f,0x2a,0x6e,0x80,0xfd,0xf2,0xc5,0xb3,0x92,0x59,0xad,0x78,0x4d,0x8c,0x28,0xcd,0xae,0xea,0x59,0x25,0xbc,0x06,0x44,0x17,0xf5,0x83,0x3b,0xfa,0xf2,0x6e,0x6b,0x89,0xf4,0x37,0xb0,0xd5,0x96,0x10 };
  BYTE C2_UDS_inCar[KEYPAIR_SIZE] = { 0x45,0x43,0x53,0x32,0x20,0x00,0x00,0x00,0x10,0x42,0xa5,0xda,0xdf,0x07,0x22,0x6d,0x16,0xbe,0x11,0x51,0x3b,0x47,0x52,0x88,0x01,0x28,0xa9,0xc5,0x49,0xa1,0xc0,0xcf,0xd6,0xd2,0xed,0xba,0x36,0xcc,0x59,0xbc,0xc0,0x04,0x57,0x4b,0xc4,0x7a,0x99,0x32,0x56,0xb2,0xb9,0x1f,0x36,0xae,0xc0,0x40,0xcb,0xf5,0x2b,0x8f,0x9a,0xed,0xc9,0x3d,0x35,0x85,0xd5,0x98,0x74,0x89,0xf7,0x66,0xe4,0xc3,0x2b,0x6a,0x84,0xbc,0x24,0x3a,0xdf,0xfc,0xda,0x64,0xf3,0xbf,0x44,0x96,0x97,0xad,0xc6,0x52,0x90,0x73,0x54,0x4a,0xd1,0x78,0xf8,0x9b,0x8d,0xfb,0xa6,0x57 };
  BYTE C2_UDS_Bosch[KEYPAIR_SIZE] = { 0x45,0x43,0x53,0x32,0x20,0x00,0x00,0x00,0x49,0x52,0x23,0xfd,0x04,0x4a,0x02,0xd6,0xf7,0xbe,0xb5,0xa8,0x9f,0x1d,0xd3,0x17,0x9e,0x0f,0x23,0x54,0x41,0xc5,0x4e,0xbd,0x37,0x20,0x39,0xcc,0x24,0x71,0xed,0x19,0x69,0xc3,0x9e,0xb5,0x2d,0x1b,0x3b,0xe3,0xf3,0xe0,0xd4,0xae,0x59,0xdd,0x81,0xa3,0xe6,0x67,0x25,0x5f,0x26,0x04,0x40,0xdf,0x66,0x15,0x32,0x23,0xb2,0xeb,0xf4,0xd6,0x0c,0x8d,0x19,0x98,0xda,0x96,0x2a,0x3a,0xb3,0x4d,0x6b,0x3f,0xe5,0xb2,0x8c,0x24,0xf9,0xc0,0x20,0x09,0x9c,0x74,0xf0,0x5c,0x6d,0x70,0x92,0x96,0x65,0x47,0xdf,0x55 };
  
  BYTE C2_DEV_BLE_Flash[KEYPAIR_SIZE] = { 0x45,0x43,0x53,0x32,0x20,0x00,0x00,0x00,0x26,0xbd,0x55,0x27,0xfd,0x81,0x6c,0xa4,0x15,0x36,0xbe,0x75,0x68,0x63,0xd8,0xba,0x18,0xc7,0xbd,0x96,0x57,0x86,0xc9,0x04,0xc3,0xb9,0xbd,0xb5,0xf9,0x55,0xb0,0x44,0xc7,0x7b,0x3e,0xf2,0xb8,0xa6,0xba,0xd9,0x16,0x00,0x86,0xe4,0xfc,0x96,0x65,0x05,0x09,0xca,0xb7,0x07,0x57,0x50,0x44,0x09,0x75,0xcb,0xad,0x37,0xfb,0xb6,0x4e,0xc3,0xaa,0xb3,0x9b,0x32,0xf3,0x6e,0xe8,0x73,0xb4,0x75,0x0a,0x91,0x37,0xae,0xb1,0x2c,0x99,0x1d,0xa0,0xa8,0x3a,0x45,0xad,0x16,0xf4,0x75,0x30,0x6a,0x76,0x93,0xc1,0x2f };
  BYTE C2_DEV_S32_Flash[KEYPAIR_SIZE] = { 0x45,0x43,0x53,0x32,0x20,0x00,0x00,0x00,0x4b,0x78,0x7b,0x41,0x5b,0x59,0x9e,0xaa,0x19,0x22,0xbe,0x3e,0x32,0x3b,0x03,0x88,0x17,0x20,0x11,0x86,0xdf,0x86,0xa6,0x09,0xb7,0xdd,0x71,0x5b,0x06,0xe3,0xf5,0xc6,0xf4,0x77,0x12,0x87,0x40,0x38,0x7d,0x7d,0x3d,0x23,0xd4,0x99,0x4e,0x6d,0x6c,0xf0,0x7f,0xd3,0xfb,0x32,0x7a,0xa4,0x83,0x2b,0x04,0xee,0x7f,0x2a,0x6e,0x80,0xfd,0xf2,0xc5,0xb3,0x92,0x59,0xad,0x78,0x4d,0x8c,0x28,0xcd,0xae,0xea,0x59,0x25,0xbc,0x06,0x44,0x17,0xf5,0x83,0x3b,0xfa,0xf2,0x6e,0x6b,0x89,0xf4,0x37,0xb0,0xd5,0x96,0x10 };
  BYTE C2_DEV_UDS_inCar[KEYPAIR_SIZE] = { 0x45,0x43,0x53,0x32,0x20,0x00,0x00,0x00,0x10,0x42,0xa5,0xda,0xdf,0x07,0x22,0x6d,0x16,0xbe,0x11,0x51,0x3b,0x47,0x52,0x88,0x01,0x28,0xa9,0xc5,0x49,0xa1,0xc0,0xcf,0xd6,0xd2,0xed,0xba,0x36,0xcc,0x59,0xbc,0xc0,0x04,0x57,0x4b,0xc4,0x7a,0x99,0x32,0x56,0xb2,0xb9,0x1f,0x36,0xae,0xc0,0x40,0xcb,0xf5,0x2b,0x8f,0x9a,0xed,0xc9,0x3d,0x35,0x85,0xd5,0x98,0x74,0x89,0xf7,0x66,0xe4,0xc3,0x2b,0x6a,0x84,0xbc,0x24,0x3a,0xdf,0xfc,0xda,0x64,0xf3,0xbf,0x44,0x96,0x97,0xad,0xc6,0x52,0x90,0x73,0x54,0x4a,0xd1,0x78,0xf8,0x9b,0x8d,0xfb,0xa6,0x57 };
  BYTE C2_DEV_UDS_Bosch[KEYPAIR_SIZE] = { 0x45,0x43,0x53,0x32,0x20,0x00,0x00,0x00,0x49,0x52,0x23,0xfd,0x04,0x4a,0x02,0xd6,0xf7,0xbe,0xb5,0xa8,0x9f,0x1d,0xd3,0x17,0x9e,0x0f,0x23,0x54,0x41,0xc5,0x4e,0xbd,0x37,0x20,0x39,0xcc,0x24,0x71,0xed,0x19,0x69,0xc3,0x9e,0xb5,0x2d,0x1b,0x3b,0xe3,0xf3,0xe0,0xd4,0xae,0x59,0xdd,0x81,0xa3,0xe6,0x67,0x25,0x5f,0x26,0x04,0x40,0xdf,0x66,0x15,0x32,0x23,0xb2,0xeb,0xf4,0xd6,0x0c,0x8d,0x19,0x98,0xda,0x96,0x2a,0x3a,0xb3,0x4d,0x6b,0x3f,0xe5,0xb2,0x8c,0x24,0xf9,0xc0,0x20,0x09,0x9c,0x74,0xf0,0x5c,0x6d,0x70,0x92,0x96,0x65,0x47,0xdf,0x55 };
  
  byte hash[32];
  byte signature[64];
  byte msg[5]={0x42, 0x4f, 0x53, 0x43, 0x48};
  byte msg2[1] = 0x48;
  byte plus[1] = 0x40;
  int ret = 0;
  int i;
  char tmp[8];    // Temporary buffer containing single HEX value
  char out[512];  // Bigger output string and "local" to function
  char buffer[100];
  long ret1, ret2, ret3, ret4;
  byte securitySeed[48];
  byte securityKey[64] = {0, 0, 0, 0, 0, 0, 0, 0, 0, 0, 0, 0, 0, 0, 0, 0, 0, 0, 0, 0, 0, 0, 0, 0, 0, 0, 0, 0, 0, 0, 0, 0,0, 0, 0, 0, 0, 0, 0, 0, 0, 0, 0, 0, 0, 0, 0, 0, 0, 0, 0, 0, 0, 0, 0, 0, 0, 0, 0, 0, 0, 0, 0, 0};
  dword keySizeOut;
}
void printHex(byte ByteArray[], int ByteArraySize)
{
    for (i = 0; i<ByteArraySize; i++)
  { 
   //write("%.2x",hash[i]);
    snprintf(tmp, elcount(tmp), "%.2X", ByteArray[i]);  // byte to HEX convert
    strncat(out, tmp, elcount(out));  // Concatenate HEX value to output string
  }
 
 
  writeEx(0, 1,"%s", out);
  
  for (i = 0; i < 301; i++) out[i] = 0;
  for (i = 0; i < 8; i++) tmp[i] = 0;
  
}

on start
{

  write("KeyPair : ");
  printHex(C1_S32_Flash, 104);
  
  ret =dllSHA256_Init();
  write("Init: %d",ret);
  
  ret = dllSHA256_Update(msg, 4);
  write("Update: %d",ret);

  ret = dllSHA256_Update(msg2, 1);
  write("Update2: %d",ret);  
  
  ret =dllSHA256_Finish(hash, 32);
  write("Finish: %d",ret);
  
  write("Hash : ");
  printHex(hash, 32);
  
  ret = dllImport_KeyPair(C1_S32_Flash, 104);
  write("ImportPrivateKey: %d",ret);
  
  ret = dllEcdsaSign(hash, 32, signature, 64);
  write("EcdsaSign: %d",ret);
  
  ret = dllEcdsaVerify(hash, 32, signature, 64);
  write("EcdsaVerify: %d",ret);

  write("Signature : ");
  printHex(signature, 64);
  
  write("SeedKey : ");
  printHex(securityKey, 8);
  
  ret =dllSHA256_Init(); 
  ret = dllSHA256_Update(securitySeed, elCount(securitySeed)); 
  ret =dllSHA256_Finish(hash, 32);
  
  
  ret2 = DiagGenerateKeyFromSeed("DiagAnchor1",securitySeed, elCount(securitySeed), 1, "C1_S32_FLASH", "", securityKey, elCount(securityKey), keySizeOut); // form 2
  write("seedkey ret: %d", ret2);
  write("SeedKey : ");
  printHex(securityKey, 64);

  ret = dllImport_KeyPair(C1_S32_Flash, 104);
  
  ret = dllEcdsaVerify(hash, 32, securityKey, 64);
  write("S32 EcdsaVerify: %d",ret);

  
}