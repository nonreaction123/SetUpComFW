/*@!Encoding:1252*/
includes
{
    #include "..\Configuration.cin"
    #include "..\Lib\UDS\DiagnosticSessionControl\DiagnosticSessionControl.cin"
    #include "..\Lib\UDS\SecurityAccess\SecurityAccess.cin"
    #include "..\Lib\UDS\ReadDataByIdentifier\ReadDataByIdentifier.cin"
    #include "..\Lib\UDS\WriteDataByIdentifier\ReadWriteDataByIdentifier.cin"
    #include "..\utility.cin"
    #include "..\Lib\utility\util_compare.cin"

    #include "..\UtilityBootloader.cin"
    #include "..\DTCFunctions.cin"
    #include "..\DownloadFunctions.cin"

    //#include "..\ReadWriteDataByIdentifier.cin"
    #include "..\BootloaderTestCases.cin"
}

variables
{
  struct gwParams
  {
    dword id;
    byte  src;
    int   dest[2];
  };


  //Paths for APP files
  char APP_BIN[1000];
  char APP_R4_BIN[1000];
  char APP_RXCONFIG_BIN[1000];
  char APP_TXCONFIG_BIN[1000];
  char APP_R4_PKG[1000];
  char CONFIG_BIN[1000];

  char Variant[20];

  char erase0[20] = {0};

}


MainTest()
{
  // ----- add information to test report 
  char testName[64] = "Programming ECU";
  TestModuleTitle("Program ECU"); // change test module title and add description
  utility_initBusContext();

  // Initial setup
  Configuration_Init();
  
  if (1 == @sysvar::PROGRAM_ECU::progAnchorBle)
  {
    word ii;
    
    for (ii = 0; ii < 10; ii++)
    {
      if (1 == @sysvar::PROGRAM_ECU::boAnchor[ii])
      {
        char ecuName[32];
        if(ii != 9)
        {
          snprintf(ecuName, elCount(ecuName), "DiagAnchor%d", (ii+1));
        }
        else
        {
          snprintf(ecuName, elCount(ecuName), "DiagAnchorF");
        }

        sysSetVariableDWord(sysvar::PROGRAM_ECU::AnchorID, ii); // form 1
        testWaitForTimeout(1000);
        diagSetTarget(ecuName);

        testGroupBegin("Variant Check", "Checking Variant of Anchor");
        tc_DSC_ExtendedSession( "ExtDiagSession", UDS_ERROR_CODE_OK, 1000 );
        tc_SA_SecurityUnlockL1(testName);        
        testGroupEnd();
        
        if (0 == TestGetVerdictLastTestCase()) //(1)
        {
          sysGetVariableString(sysvar::PROGRAM_ECU::strAnchorBleFile, APP_BIN, elCount(APP_BIN));
          setTotalLength(APP_BIN);
		      
          if (@sysvar::PROGRAM_ECU::totalLength > 0)
          {
            {
              char temp[100];
              snprintf(temp, elcount(temp), "Flashing %s Ble Bin", ecuName);
              setProgressText(temp);
            }
            programBleANCHOR(APP_BIN);
          }
          if (@sysvar::PROGRAM_ECU::boAR4binfile == 1)
          {
            sysGetVariableString( sysvar::PROGRAM_ECU::strAnchorR4File, APP_R4_BIN, elCount(APP_R4_BIN));
            setTotalLength(APP_R4_BIN);
            if (@sysvar::PROGRAM_ECU::totalLength > 0)
            {
                {
                  char temp[100];
                  snprintf(temp, elcount(temp), "Flashing %s R4 Bin", ecuName);
                  setProgressText(temp);
                }
				write("Programming the Anchor R4 files");
                programR4(APP_R4_BIN);
            }
            sysGetVariableString( sysvar::PROGRAM_ECU::strR4RxConfigFile, APP_RXCONFIG_BIN, elCount(APP_RXCONFIG_BIN));
            setTotalLength(APP_RXCONFIG_BIN);
            if (@sysvar::PROGRAM_ECU::totalLength > 0)
            {          
              {
                char temp[100];
                snprintf(temp, elcount(temp), "Flashing %s RxConfig Bin", ecuName);
                setProgressText(temp);
              }
			  write("Programming the Anchor Rx Config files");
              programR4RxConfig(APP_RXCONFIG_BIN);
            }
            sysGetVariableString( sysvar::PROGRAM_ECU::strR4TxConfigFile, APP_TXCONFIG_BIN, elCount(APP_TXCONFIG_BIN));
            setTotalLength(APP_TXCONFIG_BIN);
            if (@sysvar::PROGRAM_ECU::totalLength > 0)
            {          
              {
                char temp[100];
                snprintf(temp, elcount(temp), "Flashing %s TxConfig Bin", ecuName);
                setProgressText(temp);
              }
			  write("Programming the Anchor Tx Config files");
              programR4TxConfig(APP_TXCONFIG_BIN);
            }          
            setProgressText("Done");
          }
          else if (@sysvar::PROGRAM_ECU::boAR4pkgfile == 1)
          {
            sysGetVariableString( sysvar::PROGRAM_ECU::strAnchorR4PkgFile, APP_R4_PKG, elCount(APP_R4_PKG));
            setTotalLength(APP_R4_PKG);
            if (@sysvar::PROGRAM_ECU::totalLength > 0)
            {
                {
                  char temp[100];
                  snprintf(temp, elcount(temp), "Flashing %s R4 Pkg", ecuName);
                  setProgressText(temp);
                }
				write("Programming the Anchor R4 PKG files");
                programR4PKG(APP_R4_PKG);
            }
            setProgressText("Done");            
          }
        }
        else
        {
          char dialogMsg[1000];
      
          snprintf(dialogMsg, elcount(dialogMsg),
              "%s (%s)\n",
              "Error: Invalid variant read.",
              Variant
              );
          testWaitForTesterConfirmation(dialogMsg, 10000);
        }
      }
    }
  }  
  
  if (1 == @sysvar::PROGRAM_ECU::progMasterBle)
  {
    //Oliver To communicate with MasterBLE, we have to connect to private CAN, this needs to change
    //testGroupBegin("MasterMcu Check", "Checking MasterMcu is in Application");
    //tc_CheckMasterMcuInApplication();
    //testGroupEnd();
    
    if (1) // Sin the previous test is not used, so no need to check result(0 == TestGetVerdictLastTestCase())
    {
      testWaitForTimeout(1000);
      DiagSetTarget( "DiagMasterBLE" );      
      testGroupBegin("Variant Check", "Checking Variant of Master");
      tc_DSC_ExtendedSession( "ExtDiagSession", UDS_ERROR_CODE_OK, 3000 );
      tc_SA_SecurityUnlockL1(testName);
      tc_GetMasterBleVariant();
      testGroupEnd();
     
	  
      if (0 == TestGetVerdictLastTestCase())
      {
        sysGetVariableString(sysvar::PROGRAM_ECU::strMasterBleFile, APP_BIN, elCount(APP_BIN));
        setTotalLength(APP_BIN);
        if (@sysvar::PROGRAM_ECU::totalLength > 0)
        {
          {
            char temp[100];
            snprintf(temp, elcount(temp), "Flashing DiagMasterBLE");
            setProgressText(temp);
          }
          programBleMaster(APP_BIN);
        }
  		  if (@sysvar::PROGRAM_ECU::boMR4binfile == 1)
        {
    			sysGetVariableString(sysvar::PROGRAM_ECU::strMasterR4File, APP_R4_BIN, elCount(APP_R4_BIN));
    			setTotalLength(APP_R4_BIN);
    			if (@sysvar::PROGRAM_ECU::totalLength > 0)
    			{
    			  {
    				char temp[100];
    				snprintf(temp, elcount(temp), "Flashing DiagMasterR4");
    			  }
				  write("Programming the Master R4 files");
            programR4(APP_R4_BIN);
    			}
    			sysGetVariableString(sysvar::PROGRAM_ECU::strMasterR4RxConfigFile, APP_RXCONFIG_BIN, elCount(APP_RXCONFIG_BIN));
    			setTotalLength(APP_RXCONFIG_BIN);
    			if (@sysvar::PROGRAM_ECU::totalLength > 0)
    			{
    			  {
    				char temp[100];
    				snprintf(temp, elcount(temp), "Flashing DiagMasterR4");
    			  }
				  write("Programming the Master Rx Config files");
    			  programR4RxConfig(APP_RXCONFIG_BIN);
    			}
    			sysGetVariableString(sysvar::PROGRAM_ECU::strMasterR4TxConfigFile, APP_TXCONFIG_BIN, elCount(APP_TXCONFIG_BIN));
    			setTotalLength(APP_TXCONFIG_BIN);
    			if (@sysvar::PROGRAM_ECU::totalLength > 0)
    			{        
    			  {
    				char temp[100];
    				snprintf(temp, elcount(temp), "Flashing DiagMasterR4");
    			  }
				  write("Programming the Master Tx Config files");
    			  programR4TxConfig(APP_TXCONFIG_BIN);
    			}
    			setProgressText("Done");
  		  }
        else if (@sysvar::PROGRAM_ECU::boMR4pkgfile == 1)
        {
          sysGetVariableString( sysvar::PROGRAM_ECU::strMasterR4PkgFile, APP_R4_PKG, elCount(APP_R4_PKG));
          setTotalLength(APP_R4_PKG);
          if (@sysvar::PROGRAM_ECU::totalLength > 0)
          {
            {
              char temp[100];
              snprintf(temp, elcount(temp), "Flashing DiagMasterR4");
            }
          write("Programming the Master R4 PKG files");
            programR4PKG(APP_R4_PKG);
          }
          setProgressText("Done");            
        }
      }
      else
      {
        char dialogMsg[1000];
    
        snprintf(dialogMsg, elcount(dialogMsg),
            "%s (%s)\n",
            "Error: Invalid variant read.",
            Variant
            );
        testWaitForTesterConfirmation(dialogMsg, 10000);
      }      
    }
      else
      {
        char dialogMsg[1000];
    
        snprintf(dialogMsg, elcount(dialogMsg),
            "%s\n",
            "Error: MasterBle cannot be programmed because MasterMcu is not in Application."
            );
        testWaitForTesterConfirmation(dialogMsg, 10000);
      }
  } 
    
  if (1 == @sysvar::PROGRAM_ECU::progMasterMcu)
  {
    testWaitForTimeout(1000);
    DiagSetTarget( "DiagMasterMCU" );

    sysGetVariableString(sysvar::PROGRAM_ECU::strMasterMcuFile, APP_BIN, elCount(APP_BIN));
    setTotalLength(APP_BIN);
    if (@sysvar::PROGRAM_ECU::totalLength > 0)
    {        
      {
        char temp[100];
        snprintf(temp, elcount(temp), "Flashing DiagMasterMCU");
        setProgressText(temp);
      }
      programECU(APP_BIN);
    }
    setProgressText("Done");
  }
  
  if (1 == @sysvar::PROGRAM_ECU::progCalib)
  {
    testWaitForTimeout(1000);
    DiagSetTarget( "DiagMasterMCU" );

    sysGetVariableString(sysvar::PROGRAM_ECU::strCalibrationFile, CONFIG_BIN, elCount(CONFIG_BIN));    
    setTotalLength(CONFIG_BIN);
    if (@sysvar::PROGRAM_ECU::totalLength > 0)
    {            
      {
        char temp[100];
        snprintf(temp, elcount(temp), "Flashing Calibration");
        setProgressText(temp);
      }
      programCAL(CONFIG_BIN);
    }
    setProgressText("Done");
  }  
  
}


testcase tc_CheckMasterMcuInApplication(void)
{
  testCaseTitle("MCU", "Checking MasterMcu is in Application");
  
  DiagSetTarget( "DiagMasterMCU" );
  if (RESPONSE_CHECK_IS_OK == nf_DSC_ExtendedSession_Fuzzy("MCU $10 $03", UDS_ERROR_CODE_OK, 5000, 0))
  {
    testStepPass("MCU $10 $03", "MasterMcu is in Application");
    tf_DSC_DefaultSession("MCU $10 $01", UDS_ERROR_CODE_OK, 5000);    
  }
  else
  {
    testStepFail("MCU $10 $03", "MasterMcu is not in Application");
  }
}

testcase tc_CheckVersionInMaster(void)
{
  //diagRequest DiagMasterMCU.SWInformation_All_Read McuSwInfo_req;
  //diagResponse DiagMasterMCU.SWInformation_All_Read McuSwInfo_resp;
  diagRequest DiagMasterBLE.SWInformation_All_Read MBleSwInfo_req;
  diagResponse DiagMasterBLE.SWInformation_All_Read MBleSwInfo_resp;
  
  char masterMcuVersion[3];
  char masterBleVersion[3];
  
  byte mcuVersionValid;
  byte mbleVersionValid;
  
  testCaseTitle("Master", "Checking MasterMcu and MasterBle versions ");   
  
  DiagSetTarget( "DiagMasterMCU" );
 /* if (RESPONSE_CHECK_IS_OK == nf_RDBI_ReadDIDxxxx_Fuzzy("$22 $FE11", McuSwInfo_req, McuSwInfo_resp, UDS_ERROR_CODE_OK, 10000, 0))
  {
    masterMcuVersion[0] = diagGetParameter(McuSwInfo_resp, "Major");
    masterMcuVersion[1] = diagGetParameter(McuSwInfo_resp, "Minor");
    masterMcuVersion[2] = diagGetParameter(McuSwInfo_resp, "Revision");
    mcuVersionValid = 1;
  }
  else
  {
    mcuVersionValid = 0;
  }*/
  
  mcuVersionValid = 1;
  DiagSetTarget( "DiagMasterBLE" );
  if (RESPONSE_CHECK_IS_OK == nf_RDBI_ReadDIDxxxx_Fuzzy("$22 $FE11", MBleSwInfo_req, MBleSwInfo_resp, UDS_ERROR_CODE_OK, 10000, 0))
  {
    masterBleVersion[0] = diagGetParameter(MBleSwInfo_resp, "Major");
    masterBleVersion[1] = diagGetParameter(MBleSwInfo_resp, "Minor");
    masterBleVersion[2] = diagGetParameter(MBleSwInfo_resp, "Revision");
    mbleVersionValid = 1;
  }
  else
  {
    mbleVersionValid = 0;
  }
  
  if  (   (1 == mcuVersionValid)
      &&  (1 == mbleVersionValid)
      )
  {
    if  (   (1 == nf_ucmp_CompareByte("$22 $FE11", "Major",    masterMcuVersion[0], masterBleVersion[0], 1))
        &&  (1 == nf_ucmp_CompareByte("$22 $FE11", "Minor",    masterMcuVersion[1], masterBleVersion[1], 1))
        &&  (1 == nf_ucmp_CompareByte("$22 $FE11", "Revision", masterMcuVersion[2], masterBleVersion[2], 1))
        )
    {
      testStepPass("$22 $FE11", "Versions matched.");          
    }
    else
    {
      char dialogMsg[1000];
      snprintf(dialogMsg, elcount(dialogMsg),
                "%s\n%s%d.%d.%d\n%s%d.%d.%d\n",
                "Warning: MasterMcu and MasterBle version mismatch!",
                "     MasterMcu Version: ", masterMcuVersion[0], masterMcuVersion[1], masterMcuVersion[2],
                "     MasterBle Version: ", masterBleVersion[0], masterBleVersion[1], masterBleVersion[2]
              );
      testWaitForTesterConfirmation(dialogMsg, 10000);
      testStepWarning("$22 $FE11", "Versions mismatched.");          
    }
  }
  else if (0 == mcuVersionValid)
  {
    char dialogMsg[1000];
    snprintf(dialogMsg, elcount(dialogMsg),
              "%s\n%s\n",
              "Warning: MasterMcu and MasterBle version mismatch!",
              "         Cannot read MasterMcu version."
            );
    testWaitForTesterConfirmation(dialogMsg, 10000);
    testStepWarning("$22 $FE11", "Cannot read SW version of MasterMcu!");
  }    
  else //if (0 == mbleVersionValid)
  {
    char dialogMsg[1000];
    snprintf(dialogMsg, elcount(dialogMsg),
              "%s\n%s\n",
              "Warning: MasterMcu and MasterBle version mismatch!",
              "         Cannot read MasterBle version."
            );
    testWaitForTesterConfirmation(dialogMsg, 10000);
    testStepWarning("$22 $FE11", "Cannot read SW version of MasterBle!");    
  }      
}

testcase tc_GetAnchorBleVariant(void)
{
  diagRequest SWInformation_All_Read SwInfo_req;
  diagResponse SWInformation_All_Read SwInfo_resp;  
  
  byte variantValid;
  
  testCaseTitle("HW Variant", "Getting HW variant");   
  
  if (RESPONSE_CHECK_IS_OK == nf_RDBI_ReadDIDxxxx_Fuzzy("$22 $FE11", SwInfo_req, SwInfo_resp, UDS_ERROR_CODE_OK, 10000, 0))
  {
    if (SwInfo_resp.GetParameter("dp_Anchor_SoftwareVersion_Variant_PF", Variant, elcount(Variant)) >= 0) 
    {
      variantValid = 1;    
    }
    else
    {
      variantValid = 0;
    }
  }
  else
  {
    variantValid = 0;
  }
  
  if (1 == variantValid)
  {
    if (START_ADDRESS_ANCHOR_BLE.containsKey(Variant))
    {
      testStepPass("$22 $FE11", "Variant read (%s) is valid.", Variant);    
    }
    else
    {
      testStepFail("$22 $FE11", "Unknown variant(%s).", Variant);
    }
  }
  else
  {
    testStepFail("$22 $FE11", "Reading variant failed.");
  }
}

testcase tc_GetMasterBleVariant(void)
{
  diagRequest SWInformation_All_Read SwInfo_req;
  diagResponse SWInformation_All_Read SwInfo_resp;  
  
  byte variantValid;
  
  testCaseTitle("HW Variant", "Getting HW variant");   
  
  if (RESPONSE_CHECK_IS_OK == nf_RDBI_ReadDIDxxxx_Fuzzy("$22 $FE11", SwInfo_req, SwInfo_resp, UDS_ERROR_CODE_OK, 10000, 0))
  {
    if (SwInfo_resp.GetParameter("dp_Anchor_SoftwareVersion_Variant_PF", Variant, elcount(Variant)) >= 0)
    {
      variantValid = 1;    
    }
    else
    {
      variantValid = 0;
    }
  }
  else
  {
    variantValid = 0;
  }
  
  if (1 == variantValid)
  {
    if (START_ADDRESS_MASTER_BLE.containsKey(Variant))
    {
      testStepPass("$22 $FE11", "Variant read (%s) is valid.", Variant);    
    }
    else
    {
      testStepFail("$22 $FE11", "Unknown variant(%s).", Variant);
    }
  }
  else
  {
    testStepFail("$22 $FE11", "Reading variant failed.");
  }
}

void setProgressText(
  char text[]
  )
{
  sysSetVariableString(sysvar::PROGRAM_ECU::strProgressText, text);
  write(text);
}

void setTotalLength(char fileName[])
{
  byte dummy[1];
  dword fh;
  long totalLength;

  //Open the application firmware file in binary mode
  fh = openFileRead(fileName, 1);
  if (0 != fh)
  { //Get the number of characters in the firmware
    totalLength = 0;
    while ( fileGetBinaryBlock (dummy,elcount(dummy),fh)!=0 ) 
    {
      totalLength++;
    }
  }
  else
  {
    totalLength = 0;
  }
  sysSetVariableInt(sysvar::PROGRAM_ECU::transferredLength, 0);
  sysSetVariableInt(sysvar::PROGRAM_ECU::totalLength, totalLength);
  fileClose(fh);
}


on diagRequestSent Download_Transmit
{
  @sysvar::PROGRAM_ECU::transferredLength += (this.GetPrimitiveSize() - 2);
  @sysvar::PROGRAM_ECU::progressPercent = (@sysvar::PROGRAM_ECU::transferredLength * 100) / @sysvar::PROGRAM_ECU::totalLength;
}
