/*@!Encoding:1252*/
includes
{
}

variables
{
  char send_command[30];
  long length;
  char flag_traffic = 0;
  double volt;
  struct checkbyteDword
  {
     dword dw;
  } checkbyteDword;
  dword portID = 4;
  dword baudRate = 115200;
  dword byteSize = 8;
  dword parity = 0;
  dword stopBits = 1;
  byte buffer_send[30];
  char arr[20];
  char volt_command[20];
  int i;
  double a;
  double x;
  double delta;
  char asciiChar[10] ="";
  byte buffer_receive[20];
  char temp[10];
  int max_length_receive = 256;

}

// Function for set voltage
void set_output(double output)
{
	{
        
        mbstrncpy(send_command ,"OUTP ", elcount(send_command));
        snprintf(volt_command, elcount(volt_command),"%.2f", output);
        //write(volt_command);
        strncat(send_command,volt_command,30);
        strncat(send_command,"\r\n",30);
        length=strlen(send_command)+1;
				for (i=0;i<length;i++) buffer_send[i]=send_command[i]; // Get buffer to send to Power Supply
				if(rs232Send(portID,buffer_send,length) == 1)
				{	
					//write("Successful");
				}
			
		} 
} 
// Function for set voltage
void set_voltage(double volt)
{
	{
        mbstrncpy(send_command ,"VOLT ", elcount(send_command));
        snprintf(volt_command, elcount(volt_command),"%.2f", volt);
        //write(volt_command);
        strncat(send_command,volt_command,30);
        strncat(send_command,"\r\n",30);
        length=strlen(send_command)+1;
				for (i=0;i<length;i++) buffer_send[i]=send_command[i]; // Get buffer to send to Power Supply
				if(rs232Send(portID,buffer_send,length) == 1)
				{	
					//write("Successful");
				}
			
		} 
   

}
on key 'a'
  {
    rs232Open(portID);
    rs232Configure(portID,baudRate,byteSize,stopBits,parity);
    // Set Output 1 for Power Supply to enter voltage mode
    write("set volt 0V");
    volt = 0;
    @sysvar::PowerSupply::Input::Voltage = volt;
        set_voltage(volt);
   
  }
  on key 'b'
  {
    rs232Open(portID);
    rs232Configure(portID,baudRate,byteSize,stopBits,parity);
    // Set Output 1 for Power Supply to enter voltage mode
    write("set volt 12V");
    volt = 12;
    @sysvar::PowerSupply::Input::Voltage = volt;
        set_voltage(volt);
  }
