/*@!Encoding:65001*/
/*@!Encoding:1252*/
includes
{
  #include "Lib\PowerFluctuation.cin"
}





void fluctuation()
{
    ControlStageBySignal();
}
 

MainTest(){
    
    fluctuation();
}

