/*@!Encoding:1252*/
includes
{ 
  #include "Lib\Diag_Req_Resp.cin"
  #include "Lib\DiagUtilities_New.cin"
  #include "Lib\Battery.cin"
  
}

variables
{
   message BCM_FD_7 Ign_Counter_Msg;
   message NM_BCM NM_BCM_VCan;  
   //message MasterNm MasterNm_BBCan;  
   //const byte Bosch = 0x61;
   
   Char LogfileName[1000];
   Char TestcaseName[1000];
  message Anchor1Nm Anchr1;
  message Anchor2Nm Anchr2;
  message Anchor3Nm Anchr3;
  message Anchor4Nm Anchr4;
  message Anchor5Nm Anchr5;
//  message Anchor6Nm Anchr6;
//  message Anchor7Nm Anchr7;
//  message Anchor8Nm Anchr8;
//  message Anchor9Nm Anchr9;
 
}

NM_Wakeup()
{
  output(Anchr1);
  output(Anchr2);
//  output(Anchr3);
//  output(Anchr4);
//  output(Anchr5);
//  output(Anchr6);
//  output(Anchr7);
//  output(Anchr8);
//  output(Anchr9);
  testwaitfortimeout(200);
  
}





testfunction Precondition()
{
  TestStep(" ","Send request 3E 00 to send tester present periodically every 4sec");  
	SendTesterPresent();    
  TestStep(" ","Send request 10 03 to enter Diagnostic Extended Session");
	SendDiag_Request_Verify_Response(MasterMCU_Qualifier,"10 03","50 03 00 32 01 F4");
  testWaitForTimeout(2000);
  TestStep(" ","Security Access Unlock 11 &12");
  Security_Access_11_12_Leaf_8();
}




PreCondition(Char UseCaseName[])
{
  testCaseComment("Precondition");
  TestStep("1", "Switch ON Power Supply and set to 13V");
  //LIB_SetBattON(13);
 
  //NM_Wakeup();
  
  //////Logging file in given path///////
  Strncat(LogfileName, "Logs//", 6);
  Strncat(LogfileName, UseCaseName, elcount(TestcaseName));
  Strncat(LogfileName, ".asc", elcount(TestcaseName));
  setLogFileName(LogfileName);
  StartLogging();
  
  
  
  Teststep("2","Start tester present");
  diagStartTesterPresent(ECU_Qualifier); //// DiagAnchor3 is ECU qualifier name and Change the Qualifier based on type of Anchor(UWB Anchor or Combi Anchor)
  //testwaitfortimeout(1000);
  TestStep("3","Send request 10 01 to enter Diagnostic Default Session ");
  SendDiag_Request_Verify_Response(ECU_Qualifier,"10 01","50 01 00 32 01 F4");
  
}

PreCondition_Anchor(Char UseCaseName[])
{
  testCaseComment("Precondition");
  TestStep("1", "Switch ON Power Supply and set to 13V");
  //LIB_SetBattON(13);
 
  //NM_Wakeup();
  
  //////Logging file in given path///////
  Strncat(LogfileName, "Logs//", 6);
  Strncat(LogfileName, UseCaseName, elcount(TestcaseName));
  Strncat(LogfileName, ".asc", elcount(TestcaseName));
  setLogFileName(LogfileName);
  StartLogging();
  
  
  
  Teststep("2","Start tester present");
  diagStartTesterPresent(DiagAnchor3); //// DiagAnchor3 is ECU qualifier name and Change the Qualifier based on type of Anchor(UWB Anchor or Combi Anchor)
  //testwaitfortimeout(1000);
  TestStep("3","Send request 10 01 to enter Diagnostic Default Session ");
  SendDiag_Request_Verify_Response(DiagAnchor3,"10 01","50 01 00 32 01 F4");
  
}

PostCondition()
{
  testCaseComment("PostCondition");
  TestStep("1","Send request 10 01 to enter Diagnostic Default Session");
	SendDiag_Request_Verify_Response(ECU_Qualifier,"10 01","50 01 00 32 01 F4");
  TestStep("2","Stop tester present");
  StopTesterPresent();
  testwaitfortimeout(500);
  //TestStep("3", "Switch Off Power Supply to 0V");
  //LIB_SetBattON(0);
  
}

PostCondition_Anchor()
{
  testCaseComment("PostCondition");
  TestStep("1","Send request 10 01 to enter Diagnostic Default Session");
	SendDiag_Request_Verify_Response(DiagAnchor3,"10 01","50 01 00 32 01 F4");
  TestStep("2","Stop tester present");
  StopTesterPresent();
  //TestStep("3", "Switch Off Power Supply to 0V");
  //LIB_SetBattON(0);
  
}

SecurityUnlock_11_12()
{
  Security_Access_11_12_Leaf_8();
  testWaitForTimeout(5000);
}

testfunction Security_Access_11_12_Leaf_8()
{  
TestStep(" ","Send 27 11");    
SendDiag_Request_Verify_Response("SPAAK","27 11 30 82 03 5B 30 82 02 43 A0 03 02 01 02 02 02 10 86 30 0D 06 09 2A 86 48 86 F7 0D 01 01 0B 05 00 30 28 31 26 30 24 06 03 55 04 03 0C 1D 42 6F 73 63 68 44 65 76 20 53 47 57 32 20 44 69 61 67 20 53 69 67 6E 69 6E 67 20 43 41 30 1E 17 0D 31 39 31 31 30 38 31 35 34 38 30 32 5A 17 0D 32 30 31 31 30 37 31 35 34 38 30 32 5A 30 2A 31 28 30 26 06 03 55 04 03 0C 1F 42 6F 73 63 68 44 65 76 20 53 47 57 20 41 75 74 68 20 44 69 61 67 20 2D 20 52 6F 6C 65 20 38 30 82 01 22 30 0D 06 09 2A 86 48 86 F7 0D 01 01 01 05 00 03 82 01 0F 00 30 82 01 0A 02 82 01 01 00 F5 89 B7 3D 13 17 3A 1F DD 0E 9E E0 C0 D6 76 00 3A AB 62 70 51 82 46 9F 6B 82 A8 ED 14 24 62 51 72 12 A5 D2 3C FD 7D 4B E3 22 0C FE 99 DE 50 FA 5D 38 72 10 9A 9E 9E 7F BA 03 D6 CA B0 85 0A 67 B2 61 B2 AF CE C1 B8  05 D5 00 38 0F 14 0B 63 F7 9B D6 D1 A1 41 60 C0 5C 0A 8C 70 76 CB 1D 01 DF E2 77 BE BD 8D 5B C6 7D C6 C5 D4 C8 4F 72 8D 48 17 07 E6 FB AE 56 AD 37 8F CF B8 5D E8 B6 9C 74 4F C6 09 E6 C4 68 1B 17 4B D8 D1 9E EC C4 3D 13 82 EF 3A BA 0E 66 66 1F B7 C3 4B 81 5E CD 00 DA 0D D6 30 67 7E 82 61 CB B4 55 E3 35 BF 86 34 88 CD 78 AC 8A A8 7F 9E AD 7C A4 FE 1E 33 5F EE 61 99 79 4D 50 B6 FE 42 D7 9C 67 39 D3 CB C3 09 FB 2B 22 9D 5D C5 B0 FA 76 3F 94 F1 A1 88 3F 97 7F 50 B7 A2 9B 3A 20 4A 6F C3 EB 3C 2E 22 FB 6D 69 26 C0 4C 01 A7 86 8F AD F3 B8 36 6E 4D 66 08 D5 02 03 01 00 01 A3 81 8C 30 81 89 30 09 06 03 55 1D 13 04 02 30 00 30 0B 06 03 55 1D 0F 04 04 03 02 07 80 30 1A 06 03 55 1D 25 01 01 FF 04 10 30 0E 06 0C 2B 06 01 04 01 81 E9 22 03 01 01 01 30 1D 06 03 55 1D 0E 04 16 04 14 7A F9 08 22 72 D9 68 0E A4 D6 D0 CD 16 DC 8C 84 5E C4 53 D2 30 1F 06 03 55 1D 23 04 18 30 16 80 14 4B EF 20 2B 8C 94 A2 70 DC 45 61 62 46 EC AE AA AB F7 3C 92 30 13 06 0C 2B 06 01 04 01 81 E9 22 03 02 01 01 04 03 02 01 08 30 0D 06 09 2A 86 48 86 F7 0D 01 01 0B 05 00 03 82 01 01 00 A0 D2 F5 84 B9 DA 94 D4 8D E8 62 C8 10 5D F4 21 36 1D 5A C6 F9 7E 15 0B E9 63 05 21 2D D2 45 2C 7A EF 4B A0 34 C6 CF EC 5E CD 85 F2 82 87 20 32 55 8A 31 FF C5 42 8D 3E D2 6C A1 F7 5E BE 22 1F 1C 33 72 3F EE 81 86 51 E4 B4 7D 16 A8 6E A6 BD F3 AE FE A0 88 5E 06 F0 B3 C4 B0 43 9E 55 C6 A5 05 9A C2 6D C5 E6 78 00 98 AF 68 7A B7 B5 DD 03 09 95 CC 96 2A A6 FD E6 DD B4 21 2D 71 CF FE 54 A7 01 D2 29 86 56 56 26 D8 4D 02 EA A4 74 C5 98 8C 3F 1B B8 72 D2 43 C2 97 E8 42 E7 C0 B7 7A EF 64 DE E3 3B 27 20 3F 94 28 A0 81 FD DA D2 B8 A6 75 D5 00 E0 94 D3 0B EE 68 D2 02 FB F1 2F F8 B2 93 AF F1 7E 52 F2 AA D1 08 E9 EF 0C 44 C1 7C F2 D5 9E 77 0C 14 20 0A 21 92 C5 14 F5 21 1E F4 00 9A C9 E7 26 B8 82 B5 64 48 00 C7 58 19 DD 21 42 79 97 CF 0A 41 71 8F CA AC F4 BE 26 E1 57 44 E7 00 00 00 00 00 00 00 00 00 00 00 00 00 00 00 00 00 00 00 00 00 00 00 00 00 00 00 00 00 00 00 00 00 00 00 00 00 00 00 00 00 00 00 00 00 00 00 00 00 00 00 00 00 00 00 00 00 00 00 00 00 00 00 00 00 00 00 00 00 00 00 00 00 00 00 00 00 00 00 00 00 00 00 00 00 00 00 00 00 00 00 00 00 00 00 00 00 00 00 00 00 00 00 00 00 00 00 00 00 00 00 00 00 00 00 00 00 00 00 00 00 00 00 00 00 00 00 00 00 00 00 00 00 00 00 00 00 00 00 00 00 00 00 00 00 00 00 00 00 00 00 00 00 00 00 00 00 00 00 00 00 00 00 00 00 00 00 00 00 00 00 00 00 00 00 00 00 00 00 00 00 00 00 00 00 00 00 00 00 00 00 00 00 00 00 00 00 00 00 00 00 00 00 00 00 00 00 00 00 00 00 00 00 00 00 00 00 00 00 00 00 00 00 00 00 00 00 00 00 00 00 00 00 00 00 00 00 00 00 00 00 00 00 00 00 00 00 00 00 00 00 00 00 00 00 00 00 00 00 00 00 00 00 00 00 00 00 00 00 00 00 00 00 00 00 00 00 00 00 00 00 00 00 00 00 00 00 00 00 00 00 00 00 00 00 00 00 00 00 00 00 00 00 00 00 00 00 00 00 00 00 00 00 00 00 00 00 00 00 00 00 00 00 00 00 00 00 00 00 00 00 00 00 00 00 00 00 00 00 00 00 00 00 00 00 00 00 00 00 00 00 00 00 00 00 00 00 00 00 00 00 00 00 00 00 00 00 00 00 00 00 00 00 00 00 00 00 00 00 00 00 00 00 00 00 00 00 00 00 00 00 00 00 00 00 00 00 00 00 00 00 00 00 00 00 00 00 00 00 00 00 00 00 00 00 00 00 00 00 00 00 00 00 00 00 00 00 00 00 00 00 00 00 00 00 00 00 00 00 00 00 00 00 00 00 00 00 00 00 00 00 00 00 00 00 00 00 00 00 00 00 00 00 00 00 00 00 00 00 00 00 00 00 00 00 00 00 00 00 00 00 00 00 00 00 00 00 00 00 00 00 00 00 00 00 00 00 00 00 00 00 00 00 00 00 00 00 00 00 00 00 00 00 00 00 00 00 00 00 00 00 00 00 00 00 00 00 00 00 00 00 00 00 00 00 00 00 00 00 00 00 00 00 00 00 00 00 00 00 00 00 00 00 00 00 00 00 00 00 00 00 00 00 00 00 00 00 00 00 00 00 00 00 00 00 00 00 00 00 00 00 00 00 00 00 00 00 00 00 00 00 00 00 00 00 00 00 00 00 00 00 00 00 00 00 00 00 00 00 00 00 00 00 00 00 00 00 00 00 00 00 00 00 00 00 00 00 00 00 00 00 00 00 00 00 00 00 00 00 00 00 00 00 00 00 00 00 00 00 00 00 00 00 00 00 00 00 00 00 00 00 00 00 00 00 00 00 00 00 00 00 6A 0E","67 11");  TestStep(" ","Send 27 12 for leaf_8");        
SendDiag_Request_Verify_Response("SPAAK","27 12 16 83 F6 C6 CC 08 23 B2 C2 0B 02 A3 D3 98 2A 64 84 F7 21 FC 25 20 E4 CA 0E C7 FD 00 F5 47 7F 79 30 28 31 26 30 24 06 03 55 04 03 0C 1D 42 6F 73 63 68 44 65 76 20 53 47 57 32 20 44 69 61 67 20 53 69 67 6E 69 6E 67 20 43 41 30 1E 17 0D 31 39 31 31 30 38 31 35 34 38 30 32 5A 17 0D 32 30 31 31 30 37 31 35 34 38 30 32 5A 30 2A 31 28 30 26 06 03 55 04 03 0C 1F 42 6F 73 63 68 44 65 76 20 53 47 57 20 41 75 74 68 20 44 69 61 67 20 2D 20 52 6F 6C 65 20 38 30 82 01 22 30 0D 06 09 2A 86 48 86 F7 0D 01 01 01 05 00 03 82 01 0F 00 30 82 01 0A 02 82 01 01 00 F5 89 B7 3D 13 17 3A 1F DD 0E 9E E0 C0 D6 76 00 3A AB 62 70 51 82 46 9F 6B 82 A8 ED 14 24 62 51 72 12 A5 D2 3C FD 7D 4B E3 22 0C FE 99 DE 50 FA 5D 38 72 10 9A 9E 9E 7F BA 03 D6 CA B0 85 0A 67 B2 61 B2 AF CE C1 B8 05 D5 00 38 0F 14 0B 63 F7 9B D6 D1 A1 41 60 C0 5C 0A 8C 70 76 CB 1D 01 DF E2 77 BE BD 8D 5B C6 7D C6","67 12");  
}

testfunction Security_Access_11_12_Anchor_8()
{  
TestStep(" ","Send 27 11");    
SendDiag_Request_Verify_Response("DiagAnchorMaster","27 11 30 82 03 5B 30 82 02 43 A0 03 02 01 02 02 02 10 86 30 0D 06 09 2A 86 48 86 F7 0D 01 01 0B 05 00 30 28 31 26 30 24 06 03 55 04 03 0C 1D 42 6F 73 63 68 44 65 76 20 53 47 57 32 20 44 69 61 67 20 53 69 67 6E 69 6E 67 20 43 41 30 1E 17 0D 31 39 31 31 30 38 31 35 34 38 30 32 5A 17 0D 32 30 31 31 30 37 31 35 34 38 30 32 5A 30 2A 31 28 30 26 06 03 55 04 03 0C 1F 42 6F 73 63 68 44 65 76 20 53 47 57 20 41 75 74 68 20 44 69 61 67 20 2D 20 52 6F 6C 65 20 38 30 82 01 22 30 0D 06 09 2A 86 48 86 F7 0D 01 01 01 05 00 03 82 01 0F 00 30 82 01 0A 02 82 01 01 00 F5 89 B7 3D 13 17 3A 1F DD 0E 9E E0 C0 D6 76 00 3A AB 62 70 51 82 46 9F 6B 82 A8 ED 14 24 62 51 72 12 A5 D2 3C FD 7D 4B E3 22 0C FE 99 DE 50 FA 5D 38 72 10 9A 9E 9E 7F BA 03 D6 CA B0 85 0A 67 B2 61 B2 AF CE C1 B8  05 D5 00 38 0F 14 0B 63 F7 9B D6 D1 A1 41 60 C0 5C 0A 8C 70 76 CB 1D 01 DF E2 77 BE BD 8D 5B C6 7D C6 C5 D4 C8 4F 72 8D 48 17 07 E6 FB AE 56 AD 37 8F CF B8 5D E8 B6 9C 74 4F C6 09 E6 C4 68 1B 17 4B D8 D1 9E EC C4 3D 13 82 EF 3A BA 0E 66 66 1F B7 C3 4B 81 5E CD 00 DA 0D D6 30 67 7E 82 61 CB B4 55 E3 35 BF 86 34 88 CD 78 AC 8A A8 7F 9E AD 7C A4 FE 1E 33 5F EE 61 99 79 4D 50 B6 FE 42 D7 9C 67 39 D3 CB C3 09 FB 2B 22 9D 5D C5 B0 FA 76 3F 94 F1 A1 88 3F 97 7F 50 B7 A2 9B 3A 20 4A 6F C3 EB 3C 2E 22 FB 6D 69 26 C0 4C 01 A7 86 8F AD F3 B8 36 6E 4D 66 08 D5 02 03 01 00 01 A3 81 8C 30 81 89 30 09 06 03 55 1D 13 04 02 30 00 30 0B 06 03 55 1D 0F 04 04 03 02 07 80 30 1A 06 03 55 1D 25 01 01 FF 04 10 30 0E 06 0C 2B 06 01 04 01 81 E9 22 03 01 01 01 30 1D 06 03 55 1D 0E 04 16 04 14 7A F9 08 22 72 D9 68 0E A4 D6 D0 CD 16 DC 8C 84 5E C4 53 D2 30 1F 06 03 55 1D 23 04 18 30 16 80 14 4B EF 20 2B 8C 94 A2 70 DC 45 61 62 46 EC AE AA AB F7 3C 92 30 13 06 0C 2B 06 01 04 01 81 E9 22 03 02 01 01 04 03 02 01 08 30 0D 06 09 2A 86 48 86 F7 0D 01 01 0B 05 00 03 82 01 01 00 A0 D2 F5 84 B9 DA 94 D4 8D E8 62 C8 10 5D F4 21 36 1D 5A C6 F9 7E 15 0B E9 63 05 21 2D D2 45 2C 7A EF 4B A0 34 C6 CF EC 5E CD 85 F2 82 87 20 32 55 8A 31 FF C5 42 8D 3E D2 6C A1 F7 5E BE 22 1F 1C 33 72 3F EE 81 86 51 E4 B4 7D 16 A8 6E A6 BD F3 AE FE A0 88 5E 06 F0 B3 C4 B0 43 9E 55 C6 A5 05 9A C2 6D C5 E6 78 00 98 AF 68 7A B7 B5 DD 03 09 95 CC 96 2A A6 FD E6 DD B4 21 2D 71 CF FE 54 A7 01 D2 29 86 56 56 26 D8 4D 02 EA A4 74 C5 98 8C 3F 1B B8 72 D2 43 C2 97 E8 42 E7 C0 B7 7A EF 64 DE E3 3B 27 20 3F 94 28 A0 81 FD DA D2 B8 A6 75 D5 00 E0 94 D3 0B EE 68 D2 02 FB F1 2F F8 B2 93 AF F1 7E 52 F2 AA D1 08 E9 EF 0C 44 C1 7C F2 D5 9E 77 0C 14 20 0A 21 92 C5 14 F5 21 1E F4 00 9A C9 E7 26 B8 82 B5 64 48 00 C7 58 19 DD 21 42 79 97 CF 0A 41 71 8F CA AC F4 BE 26 E1 57 44 E7 00 00 00 00 00 00 00 00 00 00 00 00 00 00 00 00 00 00 00 00 00 00 00 00 00 00 00 00 00 00 00 00 00 00 00 00 00 00 00 00 00 00 00 00 00 00 00 00 00 00 00 00 00 00 00 00 00 00 00 00 00 00 00 00 00 00 00 00 00 00 00 00 00 00 00 00 00 00 00 00 00 00 00 00 00 00 00 00 00 00 00 00 00 00 00 00 00 00 00 00 00 00 00 00 00 00 00 00 00 00 00 00 00 00 00 00 00 00 00 00 00 00 00 00 00 00 00 00 00 00 00 00 00 00 00 00 00 00 00 00 00 00 00 00 00 00 00 00 00 00 00 00 00 00 00 00 00 00 00 00 00 00 00 00 00 00 00 00 00 00 00 00 00 00 00 00 00 00 00 00 00 00 00 00 00 00 00 00 00 00 00 00 00 00 00 00 00 00 00 00 00 00 00 00 00 00 00 00 00 00 00 00 00 00 00 00 00 00 00 00 00 00 00 00 00 00 00 00 00 00 00 00 00 00 00 00 00 00 00 00 00 00 00 00 00 00 00 00 00 00 00 00 00 00 00 00 00 00 00 00 00 00 00 00 00 00 00 00 00 00 00 00 00 00 00 00 00 00 00 00 00 00 00 00 00 00 00 00 00 00 00 00 00 00 00 00 00 00 00 00 00 00 00 00 00 00 00 00 00 00 00 00 00 00 00 00 00 00 00 00 00 00 00 00 00 00 00 00 00 00 00 00 00 00 00 00 00 00 00 00 00 00 00 00 00 00 00 00 00 00 00 00 00 00 00 00 00 00 00 00 00 00 00 00 00 00 00 00 00 00 00 00 00 00 00 00 00 00 00 00 00 00 00 00 00 00 00 00 00 00 00 00 00 00 00 00 00 00 00 00 00 00 00 00 00 00 00 00 00 00 00 00 00 00 00 00 00 00 00 00 00 00 00 00 00 00 00 00 00 00 00 00 00 00 00 00 00 00 00 00 00 00 00 00 00 00 00 00 00 00 00 00 00 00 00 00 00 00 00 00 00 00 00 00 00 00 00 00 00 00 00 00 00 00 00 00 00 00 00 00 00 00 00 00 00 00 00 00 00 00 00 00 00 00 00 00 00 00 00 00 00 00 00 00 00 00 00 00 00 00 00 00 00 00 00 00 00 00 00 00 00 00 00 00 00 00 00 00 00 00 00 00 00 00 00 00 00 00 00 00 00 00 00 00 00 00 00 00 00 00 00 00 00 00 00 00 00 00 00 00 00 00 00 00 00 00 00 00 00 00 00 00 00 00 00 00 00 00 00 00 00 00 00 00 00 00 00 00 00 00 00 00 00 00 00 00 00 00 00 00 00 00 00 00 00 00 00 00 00 00 00 00 00 00 00 00 00 00 00 00 00 00 00 00 00 00 00 00 00 00 00 00 00 00 00 00 00 00 00 00 00 00 00 00 00 00 00 00 00 00 00 00 00 00 00 00 00 00 00 00 00 00 00 00 00 00 00 00 00 00 00 6A 0E","67 11");  TestStep(" ","Send 27 12 for leaf_8");        
SendDiag_Request_Verify_Response("DiagAnchorMaster","27 12 16 83 F6 C6 CC 08 23 B2 C2 0B 02 A3 D3 98 2A 64 84 F7 21 FC 25 20 E4 CA 0E C7 FD 00 F5 47 7F 79 30 28 31 26 30 24 06 03 55 04 03 0C 1D 42 6F 73 63 68 44 65 76 20 53 47 57 32 20 44 69 61 67 20 53 69 67 6E 69 6E 67 20 43 41 30 1E 17 0D 31 39 31 31 30 38 31 35 34 38 30 32 5A 17 0D 32 30 31 31 30 37 31 35 34 38 30 32 5A 30 2A 31 28 30 26 06 03 55 04 03 0C 1F 42 6F 73 63 68 44 65 76 20 53 47 57 20 41 75 74 68 20 44 69 61 67 20 2D 20 52 6F 6C 65 20 38 30 82 01 22 30 0D 06 09 2A 86 48 86 F7 0D 01 01 01 05 00 03 82 01 0F 00 30 82 01 0A 02 82 01 01 00 F5 89 B7 3D 13 17 3A 1F DD 0E 9E E0 C0 D6 76 00 3A AB 62 70 51 82 46 9F 6B 82 A8 ED 14 24 62 51 72 12 A5 D2 3C FD 7D 4B E3 22 0C FE 99 DE 50 FA 5D 38 72 10 9A 9E 9E 7F BA 03 D6 CA B0 85 0A 67 B2 61 B2 AF CE C1 B8 05 D5 00 38 0F 14 0B 63 F7 9B D6 D1 A1 41 60 C0 5C 0A 8C 70 76 CB 1D 01 DF E2 77 BE BD 8D 5B C6 7D C6","67 12");  
}
Set_VehicleSpeedVSOSig(int x)
{  
  message BRAKE_FD_2 Speed_Sig; 
  Speed_Sig.VehicleSpeedVSOSig = x;
  output(Speed_Sig);
  testWaitForTimeout(500);
}

Set_TotalOdometer(int x)
{  
  message IPC_FD_1 IPC_Sig; 
  IPC_Sig.TotalOdometer = x;
  output(IPC_Sig);
  testWaitForTimeout(500);
}


Set_Battery_Volt1_Value(int input)
{ 
  message BCM_FD_3 Battery_Volt1_Sig;
  Battery_Volt1_Sig.Battery_Volt_1 = input;
 output(Battery_Volt1_Sig);  

}
Set_CmdIgnSts(int input)
{ 
// 0 - Initialization
// 1 - IGN_LK
// 3 - ACC
// 4 - RUN
// 5 - START
// 7 - SNA
  message BCM_FD_10 CmdIgnSts_Sig; 
  Switch(input)
  {
    case 0:
      CmdIgnSts_Sig.CmdIgnSts = input;
      TestStep("","CmdIgnSts set to Initialization");
      break;
    case 1:
      CmdIgnSts_Sig.CmdIgnSts = input;
      TestStep("","CmdIgnSts set to IGN_LK");
      break;
    case 3:
      CmdIgnSts_Sig.CmdIgnSts = input;
      TestStep("","CmdIgnSts set to ACC");
      break;
    case 4:
      CmdIgnSts_Sig.CmdIgnSts = input;
      TestStep("","CmdIgnSts set to RUN");
      break;
    case 5:
      CmdIgnSts_Sig.CmdIgnSts = input;
      TestStep("","CmdIgnSts set to START");
      break;
    case 7:
      CmdIgnSts_Sig.CmdIgnSts = input;
      TestStep("","CmdIgnSts set to SNA");
      break; 
    default:
      testStepFail("","Provide correct CmdIgnSts value");
      break;
  }
  output(CmdIgnSts_Sig);
}

Set_EC1_IgnitionSts(int input)
{ 
// 0 - Initialization
// 1 - Ignition_Off_WithoutKey
// 2 - Ignition_Off
// 3 - Ignition_Acc
// 4 - Ignition_On
// 5 - Ignition_Pre_Start
// 6 - Ignition_Start
// 7 - Ignition_Cranking
// 8 - Ignition_On_EngOn
// 9 - Ignition_Pre_Acc
// 10 - Ignition_Pre_Off 
// 11 - Automatic_Cranking
// 12 - Automatic_Stop
// 13 - Key_Authenticated
// 14 - Not_Used
// 15 - SNA
  
  message BCM_FD_2 OperationalModeSts_Sig; 
  Switch(input)
  {
    case 0:
      OperationalModeSts_Sig.OperationalModeSts = input;
      TestStep("","OperationalModeSts set to Initialization");
      break;
    case 1:
      OperationalModeSts_Sig.OperationalModeSts = input;
      TestStep("","OperationalModeSts set to Ignition_Off_WithoutKey");
      break;
    case 2:
      OperationalModeSts_Sig.OperationalModeSts = input;
      TestStep("","OperationalModeSts set to Ignition_Off");
      break;
    case 3:
      OperationalModeSts_Sig.OperationalModeSts = input;
      TestStep("","OperationalModeSts set to Ignition_Acc");
      break;
    case 4:
      OperationalModeSts_Sig.OperationalModeSts = input;
      TestStep("","OperationalModeSts set to Ignition_On");
      break;
    case 5:
      OperationalModeSts_Sig.OperationalModeSts = input;
      TestStep("","OperationalModeSts set to Ignition_Pre_Start");
      break; 
    case 6:
      OperationalModeSts_Sig.OperationalModeSts = input;
      TestStep("","OperationalModeSts set to Ignition_Start");
      break;
    case 7:
      OperationalModeSts_Sig.OperationalModeSts = input;
      TestStep("","OperationalModeSts set to Ignition_Cranking");
      break;
    case 8:
      OperationalModeSts_Sig.OperationalModeSts = input;
      TestStep("","OperationalModeSts set to Ignition_On_EngOn");
      break;
    case 9:
      OperationalModeSts_Sig.OperationalModeSts = input;
      TestStep("","OperationalModeSts set to Ignition_Pre_Acc");
      break;
    case 10:
      OperationalModeSts_Sig.OperationalModeSts = input;
      TestStep("","OperationalModeSts set to Ignition_Pre_Off");
      break;
    case 11:
      OperationalModeSts_Sig.OperationalModeSts = input;
      TestStep("","OperationalModeSts set to Automatic_Cranking");
      break;
    case 12:
      OperationalModeSts_Sig.OperationalModeSts = input;
      TestStep("","OperationalModeSts set to Automatic_Stop");
      break;
    case 13:
      OperationalModeSts_Sig.OperationalModeSts = input;
      TestStep("","OperationalModeSts set to Key_Authenticated");
      break;
    case 14:
      OperationalModeSts_Sig.OperationalModeSts = input;
      TestStep("","OperationalModeSts set to Not_Used");
      break;
    case 15:
      OperationalModeSts_Sig.OperationalModeSts = input;
      TestStep("","OperationalModeSts set to SNA");
      break; 
    default:
      testStepFail("","Provide correct CmdIgnSts value");
      break;
  }
  output(OperationalModeSts_Sig);
}
//testcase poweronreset_Master()
//{
//  testStep ("","Set battery voltage to 0v");
//  LIB_SetBattON(0);
//  testWaitForTimeout(2000);
//  testStep ("","Set battery voltage to 12.5v");
//  LIB_SetBattON(13);
//  testWaitForTimeout(1000);
//}

//MainTest()
//{ poweronreset_Master();}
  

      
  //CheckProgrammingSession();
//}


//testcase CheckProgrammingSession()
//{
//  Security_Seed_11_Key_12();
////  char ECU_Qualifier[24]="SPAAK_0002_00000000_014";
////  TestStep("1","Send request 10 02 to enter Programming Diagnostic Session");
////	SendDiag_Request_Verify_Response(ECU_Qualifier,"10 02","50 02 00 32 01 F4");
//}


///////////////////////////////Anchor_ReadDataByIdentifer_Pos///////////////////////////////////


testcase TCS_PK_FCA_AnchorUDSServer_ReadDataByIdentifier_DIDF180_BootSoftwareIdentificationDataIdentifier_DefaultSession_54340()
{
	testCaseComment("Precondition");
	TestStep("1","Send TesterPresent 3E 00 every 4000ms");
	SendDiag_Request_Verify_Response(DiagAnchor3,"3E 00","7E 00");
  testCaseComment("Actions");
  TestStep("2","Send request 10 01 to enter Default Diagnostic Session");
	SendDiag_Request_Verify_Response(DiagAnchor3,"10 01","50 01");
  TestStep("3","Send request 22 F1 80 to request ReadDataByIdentifier Service ");
	SendDiag_Request_Verify_Response_Length(DiagAnchor3,"22 F1 80",17);
  TestCaseComment("Postcondition");
	TestStep("4","Send request 10 01 to enter default diagnostic session");
	SendDiag_Request_Verify_Response(DiagAnchor3,"10 01","50 01 00 32 01 F4");
  TestStep("5"," Stop Sending TesterPresent 3E 00 every 4000ms");
} 


testcase TCS_PK_FCA_AnchorUDSServer_ReadDataByID_DIDF180_BootSoftwareIdentificationDataID_Extended_0x61SecurityLevel_54442()
{
	testCaseComment("Precondition");
	TestStep("1","Send TesterPresent 3E 00 every 4000ms");
	SendDiag_Request_Verify_Response(DiagAnchor3,"3E 00","7E 00");
	TestStep("2","Send request 10 01 to enter default diagnostic session");
	SendDiag_Request_Verify_Response(DiagAnchor3,"10 01","50 01 00 32 01 F4");
  testCaseComment("Actions");
  TestStep("3","Send request 10 03 to enter Extended Diagnostic Session");
	SendDiag_Request_Verify_Response(DiagAnchor3,"10 03","50 03 00 32 01 F4");
  TestStep("4,5","Send Security Seed Request 61 and Key 62 in DiagAnchor");  
  Security_Seed_Key_Access(Anch3,Physical,Bosch);
  TestStep("6","Send 22 F1 80 to request ReadDataByIdentifier Service");
	SendDiag_Request_Verify_Response_Length(DiagAnchor3,"22 F1 80",17);
  TestCaseComment("Postcondition");
	TestStep("7","Send request 10 01 to enter default diagnostic session");
	SendDiag_Request_Verify_Response(DiagAnchor3,"10 01","50 01 00 32 01 F4");
}


testcase TCS_PK_FCA_AnchorUDSServer_ReadDataByID_DIDF180_BootSoftwareIdentificationDataID_ExtendedSession_0x65SecurityLevel_54444()
{
	testCaseComment("Precondition");
	TestStep("1","Send TesterPresent 3E 00 every 4000ms");
	SendDiag_Request_Verify_Response(DiagAnchor3,"3E 00","7E 00");
	TestStep("2","Send request 10 01 to enter default diagnostic session");
	SendDiag_Request_Verify_Response(DiagAnchor3,"10 01","50 01 00 32 01 F4");
  testCaseComment("Actions");
  TestStep("3","Send request 10 03 to enter Extended Diagnostic Session");
	SendDiag_Request_Verify_Response(DiagAnchor3,"10 03","50 03 00 32 01 F4");
  TestStep("4,5","Send Security Seed Request 65 and Key 66 in DiagAnchor");  
  Security_Seed_Key_Access(Anch3,Physical,Incar_1);
  TestStep("6","Send 22 F1 80 to request ReadDataByIdentifier Service");
	SendDiag_Request_Verify_Response_Length(DiagAnchor3,"22 F1 80",17);
  TestCaseComment("Postcondition");
	TestStep("7","Send request 10 01 to enter default diagnostic session");
	SendDiag_Request_Verify_Response(DiagAnchor3,"10 01","50 01 00 32 01 F4");
}


testcase TCS_PK_FCA_AnchorUDSServer_ReadDataByIDSS_DIDF180_BootSoftwareIdentificationDataID_ExtendedSession_NoSecurityLevel_54445()
{
	testCaseComment("Precondition");
	TestStep("1","Send TesterPresent 3E 00 every 4000ms");
	SendDiag_Request_Verify_Response(DiagAnchor3,"3E 00","7E 00");
	TestStep("2","Send request 10 01 to enter default diagnostic session");
	SendDiag_Request_Verify_Response(DiagAnchor3,"10 01","50 01 00 32 01 F4");
  testCaseComment("Actions");
  TestStep("3","Send request 10 03 to enter Extended Diagnostic Session");
	SendDiag_Request_Verify_Response(DiagAnchor3,"10 03","50 03");
  TestStep("4","Send request 22 F1 80 to request ReadDataByIdentifier Service ");
	SendDiag_Request_Verify_Response_Length(DiagAnchor3,"22 F1 80",17);
  TestCaseComment("Postcondition");
	TestStep("5","Send request 10 01 to enter default diagnostic session");
	SendDiag_Request_Verify_Response(DiagAnchor3,"10 01","50 01 00 32 01 F4");
  TestStep("6"," Stop Sending TesterPresent 3E 00 every 4000ms");
} 


testcase TCS_PK_FCA_AnchorUDSServer_ReadDataByID_DIDF180_BootSoftwareIdentificationDataID_ProgrammingSession_0x61SecurityLevel_54441()
{
	testCaseComment("Precondition");
	TestStep("1","Send TesterPresent 3E 00 every 4000ms");
	SendDiag_Request_Verify_Response(DiagAnchor3,"3E 00","7E 00");
	TestStep("2","Send request 10 01 to enter default diagnostic session");
	SendDiag_Request_Verify_Response(DiagAnchor3,"10 01","50 01 00 32 01 F4");
  TestStep("3","Send request 10 03 to enter Extended Diagnostic Session");
	SendDiag_Request_Verify_Response(DiagAnchor3,"10 03","50 03 00 32 01 F4");
  TestStep("4,5","Send Security Seed Request 61 and Key 62 in DiagAnchor");  
  Security_Seed_Key_Access(Anch3,Physical,Bosch);
  testCaseComment("Actions");
  TestStep("6","Send request 10 02 to enter Programming Diagnostic Session");
	SendDiag_Request_Verify_Response(DiagAnchor3,"10 02","50 02 00 32 01 F4");
	TestStep("7,8","Send Security Seed Request 61 and Key 62 in DiagAnchor");  
  Security_Seed_Key_Access(Anch3,Physical,Bosch);
  TestStep("9","Send request 22 F1 80 to request ReadDataByIdentifier Service");
	SendDiag_Request_Verify_Response_Length(DiagAnchor3,"22 F1 80",17);
	TestCaseComment("Postcondition");
	TestStep("10","Send request 10 01 to enter default diagnostic session");
	SendDiag_Request_Verify_Response(DiagAnchor3,"10 01","50 01 00 32 01 F4");
}

	
testcase TCS_PK_FCA_AnchorUDSServer_ReadDataByID_DIDF180_BootSoftwareIdentificationDataID_ProgrammingSession_0x65SecurityLevel_54447()
{
	testCaseComment("Precondition");
	TestStep("1","Send TesterPresent 3E 00 every 4000ms");
	SendDiag_Request_Verify_Response(DiagAnchor3,"3E 00","7E 00");
	TestStep("2","Send request 10 01 to enter default diagnostic session");
	SendDiag_Request_Verify_Response(DiagAnchor3,"10 01","50 01 00 32 01 F4");
  TestStep("3","Send request 10 03 to enter Extended Diagnostic Session");
	SendDiag_Request_Verify_Response(DiagAnchor3,"10 03","50 03 00 32 01 F4");
  TestStep("4,5","Send Security Seed Request 61 and Key 62 in DiagAnchor");  
  Security_Seed_Key_Access(Anch3,Physical,Bosch);
  testCaseComment("Actions");
  TestStep("6","Send request 10 02 to enter Programming Diagnostic Session");
	SendDiag_Request_Verify_Response(DiagAnchor3,"10 02","50 02 00 32 01 F4");
	TestStep("7,8","Send Security Seed Request 65 and Key 66 in DiagAnchor");  
  Security_Seed_Key_Access(Anch3,Physical,Incar_1);
  TestStep("9","Send request 22 F1 80 to request ReadDataByIdentifier Service");
	SendDiag_Request_Verify_Response_Length(DiagAnchor3,"22 F1 80",17);
	TestCaseComment("Postcondition");
	TestStep("10","Send request 10 01 to enter default diagnostic session");
	SendDiag_Request_Verify_Response(DiagAnchor3,"10 01","50 01 00 32 01 F4");
	}	
	
			
  
testcase TCS_PK_FCA_AnchorUDSServer_ReadDataByID_DIDF180_BootSoftwareIdentificationDataID_ProgrammingSession_NoSecurityLevel_54448()
{
	testCaseComment("Precondition");
	TestStep("1","Send TesterPresent 3E 00 every 4000ms");
	SendDiag_Request_Verify_Response(DiagAnchor3,"3E 00","7E 00");
	TestStep("2","Send request 10 01 to enter default diagnostic session");
	SendDiag_Request_Verify_Response(DiagAnchor3,"10 01","50 01 00 32 01 F4");
  TestStep("3","Send request 10 03 to enter Extended Diagnostic Session");
	SendDiag_Request_Verify_Response(DiagAnchor3,"10 03","50 03 00 32 01 F4");
  TestStep("4,5","Send Security Seed Request 61 and Key 62 in DiagAnchor");  
  Security_Seed_Key_Access(Anch3,Physical,Bosch);
  testCaseComment("Actions");
  TestStep("6","Send request 10 02 to enter Programming Diagnostic Session");
	SendDiag_Request_Verify_Response(DiagAnchor3,"10 02","50 02 00 32 01 F4");
  TestStep("7","Send request 22 F1 80 to request ReadDataByIdentifier Service");
	SendDiag_Request_Verify_Response_Length(DiagAnchor3,"22 F1 80",17);
	TestCaseComment("Postcondition");
	TestStep("8","Send request 10 01 to enter default diagnostic session");
	SendDiag_Request_Verify_Response(DiagAnchor3,"10 01","50 01 00 32 01 F4");
	}
	
testcase TCS_PK_FCA_AnchorUDSServer_ReadDataByID_DIDF181_ApplicationSoftwareIdentificationDataID_DefaultSession_54449()
{
	testCaseComment("Precondition");
	TestStep("1","Send TesterPresent 3E 00 every 4000ms");
	SendDiag_Request_Verify_Response(DiagAnchor3,"3E 00","7E 00");
	 testCaseComment("Actions");
  TestStep("2","Send request 10 01 to enter Default Diagnostic Session");
	SendDiag_Request_Verify_Response(DiagAnchor3,"10 01","50 01");
  TestStep("3","Send request 22 F1 81 to request ReadDataByIdentifier Service ");
	SendDiag_Request_Verify_Response_Length(DiagAnchor3,"22 F1 81",30);
  TestCaseComment("Postcondition");
	TestStep("4","Send request 10 01 to enter default diagnostic session");
	SendDiag_Request_Verify_Response(DiagAnchor3,"10 01","50 01 00 32 01 F4");
	}
	
	
testcase TCS_PK_FCA_AnchorUDSServer_ReadDataByID_DIDF181_ApplicationSoftwareIdentificationDataID_ExtendedSession_0x61SecurityLevell_54446()
{
	testCaseComment("Precondition");
	TestStep("1","Send TesterPresent 3E 00 every 4000ms");
	SendDiag_Request_Verify_Response(DiagAnchor3,"3E 00","7E 00");
  TestStep("2","Send request 10 01 to enter Default Diagnostic Session");
	SendDiag_Request_Verify_Response(DiagAnchor3,"10 01","50 01");	
  testCaseComment("Actions");
  TestStep("3","Send request 10 03 to enter Extended Diagnostic Session");
	SendDiag_Request_Verify_Response(DiagAnchor3,"10 03","50 03 00 32 01 F4");
  TestStep("4,5","Send Security Seed Request 61 and Key 62 in DiagAnchor");  
  Security_Seed_Key_Access(Anch3,Physical,Bosch);
  TestStep("6","Send request 22 F1 81 to request ReadDataByIdentifier Service ");
	SendDiag_Request_Verify_Response_Length(DiagAnchor3,"22 F1 81",30);
  TestCaseComment("Postcondition");
	TestStep("7","Send request 10 01 to enter default diagnostic session");
	SendDiag_Request_Verify_Response(DiagAnchor3,"10 01","50 01 00 32 01 F4");
	}
	
	
	testcase TCS_PK_FCA_AnchorUDSServer_ReadDataByID_DIDF181_ApplicationSoftwareIdentificationDataID_ExtendedSession_0x65SecurityLevel_54451()
{
	testCaseComment("Precondition");
	TestStep("1","Send TesterPresent 3E 00 every 4000ms");
	SendDiag_Request_Verify_Response(DiagAnchor3,"3E 00","7E 00");
  TestStep("2","Send request 10 01 to enter Default Diagnostic Session");
	SendDiag_Request_Verify_Response(DiagAnchor3,"10 01","50 01");	
  testCaseComment("Actions");
  TestStep("3","Send request 10 03 to enter Extended Diagnostic Session");
	SendDiag_Request_Verify_Response(DiagAnchor3,"10 03","50 03 00 32 01 F4");
  TestStep("4,5","Send Security Seed Request 65 and Key 66 in DiagAnchor");  
  Security_Seed_Key_Access(Anch3,Physical,Incar_1);
  TestStep("6","Send request 22 F1 81 to request ReadDataByIdentifier Service ");
	SendDiag_Request_Verify_Response_Length(DiagAnchor3,"22 F1 81",30);
  TestCaseComment("Postcondition");
	TestStep("7","Send request 10 01 to enter default diagnostic session");
	SendDiag_Request_Verify_Response(DiagAnchor3,"10 01","50 01 00 32 01 F4");
	}
	
	
testcase TCS_PK_FCA_AnchorUDSServer_ReadDataByID_DIDF181_ApplicationSoftwareIdentificationDataID_ExtendedSession_NoSecurityLevel_54453()
{
	testCaseComment("Precondition");
	TestStep("1","Send TesterPresent 3E 00 every 4000ms");
	SendDiag_Request_Verify_Response(DiagAnchor3,"3E 00","7E 00");
  TestStep("2","Send request 10 01 to enter Default Diagnostic Session");
	SendDiag_Request_Verify_Response(DiagAnchor3,"10 01","50 01");	
  testCaseComment("Actions");
  TestStep("3","Send request 10 03 to enter Extended Diagnostic Session");
	SendDiag_Request_Verify_Response(DiagAnchor3,"10 03","50 03 00 32 01 F4");
  TestStep("4","Send request 22 F1 81 to request ReadDataByIdentifier Service ");
	SendDiag_Request_Verify_Response_Length(DiagAnchor3,"22 F1 81",30);
  TestCaseComment("Postcondition");
	TestStep("5","Send request 10 01 to enter default diagnostic session");
	SendDiag_Request_Verify_Response(DiagAnchor3,"10 01","50 01 00 32 01 F4");
	}	
	
	
	testcase TCS_PK_FCA_AnchorUDSServer_ReadDataByID_DIDF181_ApplicationSoftwareIdentificationDataID_Programming_0x61SecurityLevel_54450()
{
	testCaseComment("Precondition");
	TestStep("1","Send TesterPresent 3E 00 every 4000ms");
	SendDiag_Request_Verify_Response(DiagAnchor3,"3E 00","7E 00");
	TestStep("2","Send request 10 01 to enter default diagnostic session");
	SendDiag_Request_Verify_Response(DiagAnchor3,"10 01","50 01 00 32 01 F4");
  TestStep("3","Send request 10 03 to enter Extended Diagnostic Session");
	SendDiag_Request_Verify_Response(DiagAnchor3,"10 03","50 03 00 32 01 F4");
  TestStep("4,5","Send Security Seed Request 61 and Key 62 in DiagAnchor");  
  Security_Seed_Key_Access(Anch3,Physical,Bosch);
  testCaseComment("Actions");
  TestStep("6","Send request 10 02 to enter Programming Diagnostic Session");
	SendDiag_Request_Verify_Response(DiagAnchor3,"10 02","50 02 00 32 01 F4");
	TestStep("7,8","Send Security Seed Request 61 and Key 62 in DiagAnchor");  
  Security_Seed_Key_Access(Anch3,Physical,Bosch);
  TestStep("9","Send request 22 F1 81 to request ReadDataByIdentifier Service");
	SendDiag_Request_Verify_Response_Length(DiagAnchor3,"22 F1 81",30);
	TestCaseComment("Postcondition");
	TestStep("10","Send request 10 01 to enter default diagnostic session");
	SendDiag_Request_Verify_Response(DiagAnchor3,"10 01","50 01 00 32 01 F4");
	}
	
	
testcase TCS_PK_FCA_AnchorUDSServer_ReadDataByID_DIDF181_ApplicationSoftwareIdentificationDataID_Programming_0x65SecurityLevel_54456()
{
	testCaseComment("Precondition");
	TestStep("1","Send TesterPresent 3E 00 every 4000ms");
	SendDiag_Request_Verify_Response(DiagAnchor3,"3E 00","7E 00");
	TestStep("2","Send request 10 01 to enter default diagnostic session");
	SendDiag_Request_Verify_Response(DiagAnchor3,"10 01","50 01 00 32 01 F4");
  TestStep("3","Send request 10 03 to enter Extended Diagnostic Session");
	SendDiag_Request_Verify_Response(DiagAnchor3,"10 03","50 03 00 32 01 F4");
  TestStep("4,5","Send Security Seed Request 61 and Key 62 in DiagAnchor");  
  Security_Seed_Key_Access(Anch3,Physical,Bosch);
  testCaseComment("Actions");
  TestStep("6","Send request 10 02 to enter Programming Diagnostic Session");
	SendDiag_Request_Verify_Response(DiagAnchor3,"10 02","50 02 00 32 01 F4");
	TestStep("7,8","Send Security Seed Request 65 and Key 66 in DiagAnchor");  
  Security_Seed_Key_Access(Anch3,Physical,Incar_1);
  TestStep("9","Send request 22 F1 81 to request ReadDataByIdentifier Service");
	SendDiag_Request_Verify_Response_Length(DiagAnchor3,"22 F1 81",30);
	TestCaseComment("Postcondition");
	TestStep("10","Send request 10 01 to enter default diagnostic session");
	SendDiag_Request_Verify_Response(DiagAnchor3,"10 01","50 01 00 32 01 F4");
	}	
	
	
	testcase TCS_PK_FCA_AnchorUDSServer_ReadDataByID_DIDF181_ApplicationSoftwareIdentificationDataID_Programming_NoSecurityLevel_54457()
{
	testCaseComment("Precondition");
	TestStep("1","Send TesterPresent 3E 00 every 4000ms");
	SendDiag_Request_Verify_Response(DiagAnchor3,"3E 00","7E 00");
	TestStep("2","Send request 10 01 to enter default diagnostic session");
	SendDiag_Request_Verify_Response(DiagAnchor3,"10 01","50 01 00 32 01 F4");
  TestStep("3","Send request 10 03 to enter Extended Diagnostic Session");
	SendDiag_Request_Verify_Response(DiagAnchor3,"10 03","50 03 00 32 01 F4");
  TestStep("4,5","Send Security Seed Request 61 and Key 62 in DiagAnchor");  
  Security_Seed_Key_Access(Anch3,Physical,Bosch);
  testCaseComment("Actions");
  TestStep("6","Send request 10 02 to enter Programming Diagnostic Session");
	SendDiag_Request_Verify_Response(DiagAnchor3,"10 02","50 02 00 32 01 F4");
  TestStep("7","Send request 22 F1 81 to request ReadDataByIdentifier Service");
	SendDiag_Request_Verify_Response_Length(DiagAnchor3,"22 F1 81",30);
	TestCaseComment("Postcondition");
	TestStep("8","Send request 10 01 to enter default diagnostic session");
	SendDiag_Request_Verify_Response(DiagAnchor3,"10 01","50 01 00 32 01 F4");
	}


testcase TCS_PK_FCA_AnchorUDSServer_ReadDataByIdentifier_DIDF186_ActiveDiagSessDataID_DefaultSession_54458()
{
	testCaseComment("Precondition");
	TestStep("1","Send TesterPresent 3E 00 every 4000ms");
	SendDiag_Request_Verify_Response(DiagAnchor3,"3E 00","7E 00");
  testCaseComment("Actions");
  TestStep("2","Send request 10 01 to enter Default Diagnostic Session");
	SendDiag_Request_Verify_Response(DiagAnchor3,"10 01","50 01");
  TestStep("3","Send request 22 F1 86 to request ReadDataByIdentifier Service ");
	SendDiag_Request_Verify_Response(DiagAnchor3,"22 F1 86","62 F1 86 01");
  TestCaseComment("Postcondition");
	TestStep("4","Send request 10 01 to enter default diagnostic session");
	SendDiag_Request_Verify_Response(DiagAnchor3,"10 01","50 01 00 32 01 F4");
  TestStep("5"," Stop Sending TesterPresent 3E 00 every 4000ms");
} 


testcase TCS_PK_FCA_AnchorUDSServer_ReadDataByIdentifier_DIDF186_ActiveDiagSessDataID_ExtendedSession_0x61SecurityLevel_54454()
{
	testCaseComment("Precondition");
	TestStep("1","Send TesterPresent 3E 00 every 4000ms");
	SendDiag_Request_Verify_Response(DiagAnchor3,"3E 00","7E 00");
	TestStep("2","Send request 10 01 to enter default diagnostic session");
	SendDiag_Request_Verify_Response(DiagAnchor3,"10 01","50 01 00 32 01 F4");
	testCaseComment("Actions");
  TestStep("3","Send request 10 03 to enter Extended Diagnostic Session");
	SendDiag_Request_Verify_Response(DiagAnchor3,"10 03","50 03 00 32 01 F4");
  TestStep("4,5","Send Security Seed Request 61 and Key 62 in DiagAnchor");  
  Security_Seed_Key_Access(Anch3,Physical,Bosch);
  TestStep("6","Send request 22 F1 86 to request ReadDataByIdentifier Service");
	SendDiag_Request_Verify_Response(DiagAnchor3,"22 F1 86","62 F1 86 03");
	TestCaseComment("Postcondition");
	TestStep("7","Send request 10 01 to enter default diagnostic session");
	SendDiag_Request_Verify_Response(DiagAnchor3,"10 01","50 01 00 32 01 F4");
	}


testcase TCS_PK_FCA_AnchorUDSServer_ReadDataByIdentifier_DIDF186_ActiveDiagSessDataID_ExtendedSession_0x65SecurityLevel_54462()
{
	testCaseComment("Precondition");
	TestStep("1","Send TesterPresent 3E 00 every 4000ms");
	SendDiag_Request_Verify_Response(DiagAnchor3,"3E 00","7E 00");
	TestStep("2","Send request 10 01 to enter default diagnostic session");
	SendDiag_Request_Verify_Response(DiagAnchor3,"10 01","50 01 00 32 01 F4");
	testCaseComment("Actions");
  TestStep("3","Send request 10 03 to enter Extended Diagnostic Session");
	SendDiag_Request_Verify_Response(DiagAnchor3,"10 03","50 03 00 32 01 F4");
  TestStep("4,5","Send Security Seed Request 65 and Key 66 in DiagAnchor");  
  Security_Seed_Key_Access(Anch3,Physical,Incar_1);
  TestStep("6","Send request 22 F1 86 to request ReadDataByIdentifier Service");
	SendDiag_Request_Verify_Response(DiagAnchor3,"22 F1 86","62 F1 86 03");
	TestCaseComment("Postcondition");
	TestStep("7","Send request 10 01 to enter default diagnostic session");
	SendDiag_Request_Verify_Response(DiagAnchor3,"10 01","50 01 00 32 01 F4");
	}


	
testcase TCS_PK_FCA_AnchorUDSServer_ReadDataByIdentifier_DIDF186_ActiveDiagSessDataID_ExtendedSession_NoSecurityLevel_54463()
{
	testCaseComment("Precondition");
	TestStep("1","Send TesterPresent 3E 00 every 4000ms");
	SendDiag_Request_Verify_Response(DiagAnchor3,"3E 00","7E 00");
	TestStep("2","Send request 10 01 to enter default diagnostic session");
	SendDiag_Request_Verify_Response(DiagAnchor3,"10 01","50 01 00 32 01 F4");
	testCaseComment("Actions");
  TestStep("3","Send request 10 03 to enter Extended Diagnostic Session");
	SendDiag_Request_Verify_Response(DiagAnchor3,"10 03","50 03 00 32 01 F4");
  TestStep("4","Send request 22 F1 86 to request ReadDataByIdentifier Service");
	SendDiag_Request_Verify_Response(DiagAnchor3,"22 F1 86","62 F1 86 03");
	TestCaseComment("Postcondition");
	TestStep("5","Send request 10 01 to enter default diagnostic session");
	SendDiag_Request_Verify_Response(DiagAnchor3,"10 01","50 01 00 32 01 F4");
	}


testcase TCS_PK_FCA_AnchorUDSServer_ReadDataByIdentifier_DIDF186_ActiveDiagSessDataID_ProgrammingSession_0x61SecurityLevel_54460()
{
	testCaseComment("Precondition");
	TestStep("1","Send TesterPresent 3E 00 every 4000ms");
	SendDiag_Request_Verify_Response(DiagAnchor3,"3E 00","7E 00");
	TestStep("2","Send request 10 01 to enter default diagnostic session");
	SendDiag_Request_Verify_Response(DiagAnchor3,"10 01","50 01 00 32 01 F4");
  TestStep("3","Send request 10 03 to enter Extended Diagnostic Session");
	SendDiag_Request_Verify_Response(DiagAnchor3,"10 03","50 03 00 32 01 F4");
  TestStep("4,5","Send Security Seed Request 61 and Key 62 in DiagAnchor");  
  Security_Seed_Key_Access(Anch3,Physical,Bosch);
  testCaseComment("Actions");
  TestStep("6","Send request 10 02 to enter Programming Diagnostic Session");
	SendDiag_Request_Verify_Response(DiagAnchor3,"10 02","50 02 00 32 01 F4");
	TestStep("7,8","Send Security Seed Request 61 and Key 62 in DiagAnchor");  
  Security_Seed_Key_Access(Anch3,Physical,Bosch);
  TestStep("9","Send request 22 F1 86 to request ReadDataByIdentifier Service");
	SendDiag_Request_Verify_Response(DiagAnchor3,"22 F1 86","62 F1 86 02");
	TestCaseComment("Postcondition");
	TestStep("10","Send request 10 01 to enter default diagnostic session");
	SendDiag_Request_Verify_Response(DiagAnchor3,"10 01","50 01 00 32 01 F4");
	}	


testcase TCS_PK_FCA_AnchorUDSServer_ReadDataByIdentifier_DIDF186_ActiveDiagSessDataID_ProgrammingSession_0x65SecurityLevel_54465()
{
	testCaseComment("Precondition");
	TestStep("1","Send TesterPresent 3E 00 every 4000ms");
	SendDiag_Request_Verify_Response(DiagAnchor3,"3E 00","7E 00");
	TestStep("2","Send request 10 01 to enter default diagnostic session");
	SendDiag_Request_Verify_Response(DiagAnchor3,"10 01","50 01 00 32 01 F4");
  TestStep("3","Send request 10 03 to enter Extended Diagnostic Session");
	SendDiag_Request_Verify_Response(DiagAnchor3,"10 03","50 03 00 32 01 F4");
  TestStep("4,5","Send Security Seed Request 61 and Key 62 in DiagAnchor");  
  Security_Seed_Key_Access(Anch3,Physical,Bosch);
  testCaseComment("Actions");
  TestStep("6","Send request 10 02 to enter Programming Diagnostic Session");
	SendDiag_Request_Verify_Response(DiagAnchor3,"10 02","50 02 00 32 01 F4");
	TestStep("7,8","Send Security Seed Request 65 and Key 66 in DiagAnchor");  
  Security_Seed_Key_Access(Anch3,Physical,Incar_1);
  TestStep("9","Send request 22 F1 86 to request ReadDataByIdentifier Service");
	SendDiag_Request_Verify_Response(DiagAnchor3,"22 F1 86","62 F1 86 02");
	TestCaseComment("Postcondition");
	TestStep("10","Send request 10 01 to enter default diagnostic session");
	SendDiag_Request_Verify_Response(DiagAnchor3,"10 01","50 01 00 32 01 F4");
	}	


testcase TCS_PK_FCA_AnchorUDSServer_ReadDataByIdentifier_DIDF186_ActiveDiagSessDataID_ProgrammingSession_NoSecurityLevel_54467()
{
	testCaseComment("Precondition");
	TestStep("1","Send TesterPresent 3E 00 every 4000ms");
	SendDiag_Request_Verify_Response(DiagAnchor3,"3E 00","7E 00");
	TestStep("2","Send request 10 01 to enter default diagnostic session");
	SendDiag_Request_Verify_Response(DiagAnchor3,"10 01","50 01 00 32 01 F4");
  TestStep("3","Send request 10 03 to enter Extended Diagnostic Session");
	SendDiag_Request_Verify_Response(DiagAnchor3,"10 03","50 03 00 32 01 F4");
  TestStep("4,5","Send Security Seed Request 61 and Key 62 in DiagAnchor");  
  Security_Seed_Key_Access(Anch3,Physical,Bosch);
  testCaseComment("Actions");
  TestStep("6","Send request 10 02 to enter Programming Diagnostic Session");
	SendDiag_Request_Verify_Response(DiagAnchor3,"10 02","50 02 00 32 01 F4");
  TestStep("7","Send request 22 F1 86 to request ReadDataByIdentifier Service");
	SendDiag_Request_Verify_Response(DiagAnchor3,"22 F1 86","62 F1 86 02");
	TestCaseComment("Postcondition");
	TestStep("8","Send request 10 01 to enter default diagnostic session");
	SendDiag_Request_Verify_Response(DiagAnchor3,"10 01","50 01 00 32 01 F4");
	}


testcase TCS_PK_FCA_AnchorUDSServer_ReadDataByIdentifier_DIDF188_VehicleManufacturerECUSoftwareNumberDataIdentifier_DefaultSession_54464()
{
	testCaseComment("Precondition");
	TestStep("1","Send TesterPresent 3E 00 every 4000ms");
	SendDiag_Request_Verify_Response(DiagAnchor3,"3E 00","7E 00");
  testCaseComment("Actions");
  TestStep("2","Send request 10 01 to enter Default Diagnostic Session");
	SendDiag_Request_Verify_Response(DiagAnchor3,"10 01","50 01");
  TestStep("3","Send request 22 F1 88 to request ReadDataByIdentifier Service ");
	SendDiag_Request_Verify_Response_Length(DiagAnchor3,"22 F1 88",10);
  TestCaseComment("Postcondition");
	TestStep("4","Send request 10 01 to enter default diagnostic session");
	SendDiag_Request_Verify_Response(DiagAnchor3,"10 01","50 01 00 32 01 F4");
  TestStep("5"," Stop Sending TesterPresent 3E 00 every 4000ms");
} 


testcase TCS_PK_FCA_AnchorUDSServer_ReadDataByID_DIDF188_VehicleManufacturerECUSoftwareNumberDataID_Extended_0x61SecurityLevel_54472()
{
	testCaseComment("Precondition");
	TestStep("1","Send TesterPresent 3E 00 every 4000ms");
	SendDiag_Request_Verify_Response(DiagAnchor3,"3E 00","7E 00");
	TestStep("2","Send request 10 01 to enter default diagnostic session");
	SendDiag_Request_Verify_Response(DiagAnchor3,"10 01","50 01 00 32 01 F4");
  testCaseComment("Actions");
  TestStep("3","Send request 10 03 to enter Extended Diagnostic Session");
	SendDiag_Request_Verify_Response(DiagAnchor3,"10 03","50 03 00 32 01 F4");
  TestStep("4,5","Send Security Seed Request 61 and Key 62 in DiagAnchor");  
  Security_Seed_Key_Access(Anch3,Physical,Bosch);
  TestStep("6","Send 22 F1 88 to request ReadDataByIdentifier Service");
	SendDiag_Request_Verify_Response_Length(DiagAnchor3,"22 F1 88",10);
  TestCaseComment("Postcondition");
	TestStep("7","Send request 10 01 to enter default diagnostic session");
	SendDiag_Request_Verify_Response(DiagAnchor3,"10 01","50 01 00 32 01 F4");
}	


testcase TCS_PK_FCA_AnchorUDSServer_ReadDataByID_DIDF188_VehicleManufacturerECUSoftwareNumberDataID_Extended_0x65SecurityLevel_54473()
{
	testCaseComment("Precondition");
	TestStep("1","Send TesterPresent 3E 00 every 4000ms");
	SendDiag_Request_Verify_Response(DiagAnchor3,"3E 00","7E 00");
	TestStep("2","Send request 10 01 to enter default diagnostic session");
	SendDiag_Request_Verify_Response(DiagAnchor3,"10 01","50 01 00 32 01 F4");
  testCaseComment("Actions");
  TestStep("3","Send request 10 03 to enter Extended Diagnostic Session");
	SendDiag_Request_Verify_Response(DiagAnchor3,"10 03","50 03 00 32 01 F4");
  TestStep("4,5","Send Security Seed Request 65 and Key 66 in DiagAnchor");  
  Security_Seed_Key_Access(Anch3,Physical,Incar_1);
  TestStep("6","Send 22 F1 88 to request ReadDataByIdentifier Service");
	SendDiag_Request_Verify_Response_Length(DiagAnchor3,"22 F1 88",10);
  TestCaseComment("Postcondition");
	TestStep("7","Send request 10 01 to enter default diagnostic session");
	SendDiag_Request_Verify_Response(DiagAnchor3,"10 01","50 01 00 32 01 F4");
}	



testcase TCS_PK_FCA_AnchorUDSServer_ReadDataByID_DIDF188_VehicleManufacturerECUSoftwareNumberDataID_Extended_NoSecurityLevel_54469()
{
	testCaseComment("Precondition");
	TestStep("1","Send TesterPresent 3E 00 every 4000ms");
	SendDiag_Request_Verify_Response(DiagAnchor3,"3E 00","7E 00");
	TestStep("2","Send request 10 01 to enter default diagnostic session");
	SendDiag_Request_Verify_Response(DiagAnchor3,"10 01","50 01 00 32 01 F4");
  testCaseComment("Actions");
  TestStep("3","Send request 10 03 to enter Extended Diagnostic Session");
	SendDiag_Request_Verify_Response(DiagAnchor3,"10 03","50 03 00 32 01 F4");
  TestStep("4","Send 22 F1 88 to request ReadDataByIdentifier Service");
	SendDiag_Request_Verify_Response_Length(DiagAnchor3,"22 F1 88",10);
  TestCaseComment("Postcondition");
	TestStep("5","Send request 10 01 to enter default diagnostic session");
	SendDiag_Request_Verify_Response(DiagAnchor3,"10 01","50 01 00 32 01 F4");
}	



testcase TCS_PK_FCA_AnchorUDSServer_ReadDataByID_DIDF188_VehicleManufacturerECUSoftwareNumberDataID_Programming_0x61SecurityLevel_54474()
{
	testCaseComment("Precondition");
	TestStep("1","Send TesterPresent 3E 00 every 4000ms");
	SendDiag_Request_Verify_Response(DiagAnchor3,"3E 00","7E 00");
	TestStep("2","Send request 10 01 to enter default diagnostic session");
	SendDiag_Request_Verify_Response(DiagAnchor3,"10 01","50 01 00 32 01 F4");
  TestStep("3","Send request 10 03 to enter Extended Diagnostic Session");
	SendDiag_Request_Verify_Response(DiagAnchor3,"10 03","50 03 00 32 01 F4");
  TestStep("4,5","Send Security Seed Request 61 and Key 62 in DiagAnchor");  
  Security_Seed_Key_Access(Anch3,Physical,Bosch);
  testCaseComment("Actions");
  TestStep("6","Send request 10 02 to enter Programming Diagnostic Session");
	SendDiag_Request_Verify_Response(DiagAnchor3,"10 02","50 02 00 32 01 F4");
	TestStep("7,8","Send Security Seed Request 61 and Key 62 in DiagAnchor");  
  Security_Seed_Key_Access(Anch3,Physical,Bosch);
  TestStep("9","Send request 22 F1 88 to request ReadDataByIdentifier Service");
	SendDiag_Request_Verify_Response_Length(DiagAnchor3,"22 F1 88",10);
	TestCaseComment("Postcondition");
	TestStep("10","Send request 10 01 to enter default diagnostic session");
	SendDiag_Request_Verify_Response(DiagAnchor3,"10 01","50 01 00 32 01 F4");
	}
	
	
	
testcase TCS_PK_FCA_AnchorUDSServer_ReadDataByID_DIDF188_ManufacturerECUSoftwareNumberDataID_Programming_0x65SecurityLevel_54475()
{
	testCaseComment("Precondition");
	TestStep("1","Send TesterPresent 3E 00 every 4000ms");
	SendDiag_Request_Verify_Response(DiagAnchor3,"3E 00","7E 00");
	TestStep("2","Send request 10 01 to enter default diagnostic session");
	SendDiag_Request_Verify_Response(DiagAnchor3,"10 01","50 01 00 32 01 F4");
  TestStep("3","Send request 10 03 to enter Extended Diagnostic Session");
	SendDiag_Request_Verify_Response(DiagAnchor3,"10 03","50 03 00 32 01 F4");
  TestStep("4,5","Send Security Seed Request 61 and Key 62 in DiagAnchor");  
  Security_Seed_Key_Access(Anch3,Physical,Bosch);
  testCaseComment("Actions");
  TestStep("6","Send request 10 02 to enter Programming Diagnostic Session");
	SendDiag_Request_Verify_Response(DiagAnchor3,"10 02","50 02 00 32 01 F4");
	TestStep("7,8","Send Security Seed Request 65 and Key 66 in DiagAnchor");  
  Security_Seed_Key_Access(Anch3,Physical,Incar_1);
  TestStep("9","Send request 22 F1 88 to request ReadDataByIdentifier Service");
	SendDiag_Request_Verify_Response_Length(DiagAnchor3,"22 F1 88",10);
	TestCaseComment("Postcondition");
	TestStep("10","Send request 10 01 to enter default diagnostic session");
	SendDiag_Request_Verify_Response(DiagAnchor3,"10 01","50 01 00 32 01 F4");
	}
	
	
	
testcase TCS_PK_FCA_AnchorUDSServer_ReadDataByID_DIDF188_VehicleManufacturerECUSoftwareNumberDataID_Programming_NoSecurityLevel_54477()
{
	testCaseComment("Precondition");
	TestStep("1","Send TesterPresent 3E 00 every 4000ms");
	SendDiag_Request_Verify_Response(DiagAnchor3,"3E 00","7E 00");
	TestStep("2","Send request 10 01 to enter default diagnostic session");
	SendDiag_Request_Verify_Response(DiagAnchor3,"10 01","50 01 00 32 01 F4");
  TestStep("3","Send request 10 03 to enter Extended Diagnostic Session");
	SendDiag_Request_Verify_Response(DiagAnchor3,"10 03","50 03 00 32 01 F4");
  TestStep("4,5","Send Security Seed Request 61 and Key 62 in DiagAnchor");  
  Security_Seed_Key_Access(Anch3,Physical,Bosch);
  testCaseComment("Actions");
  TestStep("6","Send request 10 02 to enter Programming Diagnostic Session");
	SendDiag_Request_Verify_Response(DiagAnchor3,"10 02","50 02 00 32 01 F4");
  TestStep("7","Send request 22 F1 88 to request ReadDataByIdentifier Service");
	SendDiag_Request_Verify_Response_Length(DiagAnchor3,"22 F1 88",10);
	TestCaseComment("Postcondition");
	TestStep("8","Send request 10 01 to enter default diagnostic session");
	SendDiag_Request_Verify_Response(DiagAnchor3,"10 01","50 01 00 32 01 F4");
	}
	
	
	
testcase TCS_PK_FCA_AnchorUDSServer_ReadDataByIdentifier_DIDF18C_ECUSerialNumber_DefaultSession_54480()
{
	testCaseComment("Precondition");
	TestStep("1","Send TesterPresent 3E 00 every 4000ms");
	SendDiag_Request_Verify_Response(DiagAnchor3,"3E 00","7E 00");
  testCaseComment("Actions");
  TestStep("2","Send request 10 01 to enter Default Diagnostic Session");
	SendDiag_Request_Verify_Response(DiagAnchor3,"10 01","50 01");
  TestStep("3","Send request 22 F1 8C to request ReadDataByIdentifier Service ");
	SendDiag_Request_Verify_Response(DiagAnchor3,"22 F1 8C","62 F1 8C 46 43 41 5F 54 52 41 43 45 4E 55 4D 42 45 52");
  TestCaseComment("Postcondition");
	TestStep("4","Send request 10 01 to enter default diagnostic session");
	SendDiag_Request_Verify_Response(DiagAnchor3,"10 01","50 01 00 32 01 F4");
  TestStep("5"," Stop Sending TesterPresent 3E 00 every 4000ms");
} 


testcase TCS_PK_FCA_AnchorUDSServer_ReadDataByIdentifier_DIDF18C_ECUSerialNumber_ExtendedSession_0x61SecurityLevel_54481()
{
	testCaseComment("Precondition");
	TestStep("1","Send TesterPresent 3E 00 every 4000ms");
	SendDiag_Request_Verify_Response(DiagAnchor3,"3E 00","7E 00");
	TestStep("2","Send request 10 01 to enter default diagnostic session");
	SendDiag_Request_Verify_Response(DiagAnchor3,"10 01","50 01 00 32 01 F4");
  testCaseComment("Actions");
  TestStep("3","Send request 10 03 to enter Extended Diagnostic Session");
	SendDiag_Request_Verify_Response(DiagAnchor3,"10 03","50 03 00 32 01 F4");
  TestStep("4,5","Send Security Seed Request 61 and Key 62 in DiagAnchor");  
  Security_Seed_Key_Access(Anch3,Physical,Bosch);
  TestStep("6","Send 22 F1 8C to request ReadDataByIdentifier Service");
	SendDiag_Request_Verify_Response(DiagAnchor3,"22 F1 8C","62 F1 8C 46 43 41 5F 54 52 41 43 45 4E 55 4D 42 45 52");
  TestCaseComment("Postcondition");
	TestStep("7","Send request 10 01 to enter default diagnostic session");
	SendDiag_Request_Verify_Response(DiagAnchor3,"10 01","50 01 00 32 01 F4");
}


testcase TCS_PK_FCA_AnchorUDSServer_ReadDataByIdentifier_DIDF18C_ECUSerialNumber_ExtendedSession_0x65SecurityLevel_54478()
{
	testCaseComment("Precondition");
	TestStep("1","Send TesterPresent 3E 00 every 4000ms");
	SendDiag_Request_Verify_Response(DiagAnchor3,"3E 00","7E 00");
	TestStep("2","Send request 10 01 to enter default diagnostic session");
	SendDiag_Request_Verify_Response(DiagAnchor3,"10 01","50 01 00 32 01 F4");
  testCaseComment("Actions");
  TestStep("3","Send request 10 03 to enter Extended Diagnostic Session");
	SendDiag_Request_Verify_Response(DiagAnchor3,"10 03","50 03 00 32 01 F4");
  TestStep("4,5","Send Security Seed Request 65 and Key 66 in DiagAnchor");  
  Security_Seed_Key_Access(Anch3,Physical,Incar_1);
  TestStep("6","Send 22 F1 8C to request ReadDataByIdentifier Service");
	SendDiag_Request_Verify_Response(DiagAnchor3,"22 F1 8C","62 F1 8C 46 43 41 5F 54 52 41 43 45 4E 55 4D 42 45 52");
  TestCaseComment("Postcondition");
	TestStep("7","Send request 10 01 to enter default diagnostic session");
	SendDiag_Request_Verify_Response(DiagAnchor3,"10 01","50 01 00 32 01 F4");
}	



testcase TCS_PK_FCA_AnchorUDSServer_ReadDataByIdentifier_DIDF18C_ECUSerialNumber_ExtendedSession_NoSecurityLevel_54484()
{
	testCaseComment("Precondition");
	TestStep("1","Send TesterPresent 3E 00 every 4000ms");
	SendDiag_Request_Verify_Response(DiagAnchor3,"3E 00","7E 00");
	TestStep("2","Send request 10 01 to enter default diagnostic session");
	SendDiag_Request_Verify_Response(DiagAnchor3,"10 01","50 01 00 32 01 F4");
  testCaseComment("Actions");
  TestStep("3","Send request 10 03 to enter Extended Diagnostic Session");
	SendDiag_Request_Verify_Response(DiagAnchor3,"10 03","50 03 00 32 01 F4");
  TestStep("4","Send 22 F1 8C to request ReadDataByIdentifier Service");
	SendDiag_Request_Verify_Response(DiagAnchor3,"22 F1 8C","62 F1 8C 46 43 41 5F 54 52 41 43 45 4E 55 4D 42 45 52");
  TestCaseComment("Postcondition");
	TestStep("5","Send request 10 01 to enter default diagnostic session");
	SendDiag_Request_Verify_Response(DiagAnchor3,"10 01","50 01 00 32 01 F4");
}



testcase TCS_PK_FCA_AnchorUDSServer_ReadDataByIdentifier_DIDF18C_ECUSerialNumber_ProgrammingSession_0x61SecurityLevel_54485()
{
	testCaseComment("Precondition");
	TestStep("1","Send TesterPresent 3E 00 every 4000ms");
	SendDiag_Request_Verify_Response(DiagAnchor3,"3E 00","7E 00");
	TestStep("2","Send request 10 01 to enter default diagnostic session");
	SendDiag_Request_Verify_Response(DiagAnchor3,"10 01","50 01 00 32 01 F4");
  TestStep("3","Send request 10 03 to enter Extended Diagnostic Session");
	SendDiag_Request_Verify_Response(DiagAnchor3,"10 03","50 03 00 32 01 F4");
  TestStep("4,5","Send Security Seed Request 61 and Key 62 in DiagAnchor");  
  Security_Seed_Key_Access(Anch3,Physical,Bosch);
  testCaseComment("Actions");
  TestStep("6","Send request 10 02 to enter Programming Diagnostic Session");
	SendDiag_Request_Verify_Response(DiagAnchor3,"10 02","50 02 00 32 01 F4");
	TestStep("7,8","Send Security Seed Request 61 and Key 62 in DiagAnchor");  
  Security_Seed_Key_Access(Anch3,Physical,Bosch);
  TestStep("9","Send request 22 F1 8C to request ReadDataByIdentifier Service");
	SendDiag_Request_Verify_Response(DiagAnchor3,"22 F1 8C","62 F1 8C 46 43 41 5F 54 52 41 43 45 4E 55 4D 42 45 52");
	TestCaseComment("Postcondition");
	TestStep("10","Send request 10 01 to enter default diagnostic session");
	SendDiag_Request_Verify_Response(DiagAnchor3,"10 01","50 01 00 32 01 F4");
}



testcase TCS_PK_FCA_AnchorUDSServer_ReadDataByIdentifier_DIDF18C_ECUSerialNumber_ProgrammingSession_0x65SecurityLevel_54487()
{
	testCaseComment("Precondition");
	TestStep("1","Send TesterPresent 3E 00 every 4000ms");
	SendDiag_Request_Verify_Response(DiagAnchor3,"3E 00","7E 00");
	TestStep("2","Send request 10 01 to enter default diagnostic session");
	SendDiag_Request_Verify_Response(DiagAnchor3,"10 01","50 01 00 32 01 F4");
  TestStep("3","Send request 10 03 to enter Extended Diagnostic Session");
	SendDiag_Request_Verify_Response(DiagAnchor3,"10 03","50 03 00 32 01 F4");
  TestStep("4,5","Send Security Seed Request 61 and Key 62 in DiagAnchor");  
  Security_Seed_Key_Access(Anch3,Physical,Bosch);
  testCaseComment("Actions");
  TestStep("6","Send request 10 02 to enter Programming Diagnostic Session");
	SendDiag_Request_Verify_Response(DiagAnchor3,"10 02","50 02 00 32 01 F4");
	TestStep("7,8","Send Security Seed Request 65 and Key 66 in DiagAnchor");  
  Security_Seed_Key_Access(Anch3,Physical,Incar_1);
  TestStep("9","Send request 22 F1 8C to request ReadDataByIdentifier Service");
	SendDiag_Request_Verify_Response(DiagAnchor3,"22 F1 8C","62 F1 8C 46 43 41 5F 54 52 41 43 45 4E 55 4D 42 45 52");
	TestCaseComment("Postcondition");
	TestStep("10","Send request 10 01 to enter default diagnostic session");
	SendDiag_Request_Verify_Response(DiagAnchor3,"10 01","50 01 00 32 01 F4");
	}	
	
	
	
	testcase TCS_PK_FCA_AnchorUDSServer_ReadDataByIdentifier_DIDF18C_ECUSerialNumber_ProgrammingSession_NoSecurityLevel_54489()
	{
	testCaseComment("Precondition");
	TestStep("1","Send TesterPresent 3E 00 every 4000ms");
	SendDiag_Request_Verify_Response(DiagAnchor3,"3E 00","7E 00");
	TestStep("2","Send request 10 01 to enter default diagnostic session");
	SendDiag_Request_Verify_Response(DiagAnchor3,"10 01","50 01 00 32 01 F4");
  TestStep("3","Send request 10 03 to enter Extended Diagnostic Session");
	SendDiag_Request_Verify_Response(DiagAnchor3,"10 03","50 03 00 32 01 F4");
  TestStep("4,5","Send Security Seed Request 61 and Key 62 in DiagAnchor");  
  Security_Seed_Key_Access(Anch3,Physical,Bosch);
  testCaseComment("Actions");
  TestStep("6","Send request 10 02 to enter Programming Diagnostic Session");
	SendDiag_Request_Verify_Response(DiagAnchor3,"10 02","50 02 00 32 01 F4");
  TestStep("7","Send request 22 F1 8C to request ReadDataByIdentifier Service");
	SendDiag_Request_Verify_Response(DiagAnchor3,"22 F1 8C","62 F1 8C 46 43 41 5F 54 52 41 43 45 4E 55 4D 42 45 52");
	TestCaseComment("Postcondition");
	TestStep("8","Send request 10 01 to enter default diagnostic session");
	SendDiag_Request_Verify_Response(DiagAnchor3,"10 01","50 01 00 32 01 F4");
	}	
	
	
	
testcase TCS_PK_FCA_AnchorUDSServer_ReadDataByIdentifier_DIDF192_systemSupplierECUHardwareNumber_54490()
	{
	testCaseComment("Precondition");
	TestStep("1","Send TesterPresent 3E 00 every 4000ms");
	SendDiag_Request_Verify_Response(DiagAnchor3,"3E 00","7E 00");
	TestStep("2","Send request 10 01 to enter default diagnostic session");
	SendDiag_Request_Verify_Response(DiagAnchor3,"10 01","50 01 00 32 01 F4");
	testCaseComment("Actions");
	TestStep("3","Send request 22 F1 92 to request ReadDataByIdentifier Service");
	SendDiag_Request_Verify_Response_Length(DiagAnchor3,"22 F1 92",14);
  TestStep("4","Send request 10 03 to enter Extended Diagnostic Session");
	SendDiag_Request_Verify_Response(DiagAnchor3,"10 03","50 03 00 32 01 F4");
	TestStep("5","Send request 22 F1 92 to request ReadDataByIdentifier Service");
	SendDiag_Request_Verify_Response_Length(DiagAnchor3,"22 F1 92",14);
  TestStep("6,7","Send Security Seed Request 61 and Key 62 in DiagAnchor");  
  Security_Seed_Key_Access(Anch3,Physical,Bosch);
  TestStep("8","Send request 10 02 to enter Programming Diagnostic Session");
	SendDiag_Request_Verify_Response(DiagAnchor3,"10 02","50 02 00 32 01 F4");
	TestStep("9","Send request 22 F1 92 to request ReadDataByIdentifier Service");
	SendDiag_Request_Verify_Response_Length(DiagAnchor3,"22 F1 92",14);
  TestCaseComment("Postcondition");
	TestStep("10","Send request 10 01 to enter default diagnostic session");
	SendDiag_Request_Verify_Response(DiagAnchor3,"10 01","50 01 00 32 01 F4");
	}	
	
	
	
testcase TCS_PK_FCA_AnchorUDSServer_ReadDataByIdentifier_DIDF195_SystemSupplierECUSoftwareVersionNumber_54492()
	{
	testCaseComment("Precondition");
	TestStep("1","Send TesterPresent 3E 00 every 4000ms");
	SendDiag_Request_Verify_Response(DiagAnchor3,"3E 00","7E 00");
	TestStep("2","Send request 10 01 to enter default diagnostic session");
	SendDiag_Request_Verify_Response(DiagAnchor3,"10 01","50 01 00 32 01 F4");
	testCaseComment("Actions");
	TestStep("3","Send request 22 F1 95 to request ReadDataByIdentifier Service");
	SendDiag_Request_Verify_Response_Length(DiagAnchor3,"22 F1 95",14);
  TestStep("4","Send request 10 03 to enter Extended Diagnostic Session");
	SendDiag_Request_Verify_Response(DiagAnchor3,"10 03","50 03 00 32 01 F4");
	TestStep("5","Send request 22 F1 95 to request ReadDataByIdentifier Service");
	SendDiag_Request_Verify_Response_Length(DiagAnchor3,"22 F1 95",14);
  TestStep("6,7","Send Security Seed Request 61 and Key 62 in DiagAnchor");  
  Security_Seed_Key_Access(Anch3,Physical,Bosch);
  TestStep("8","Send request 10 02 to enter Programming Diagnostic Session");
	SendDiag_Request_Verify_Response(DiagAnchor3,"10 02","50 02 00 32 01 F4");
	TestStep("9","Send request 22 F1 95 to request ReadDataByIdentifier Service");
	SendDiag_Request_Verify_Response_Length(DiagAnchor3,"22 F1 95",14);
  TestCaseComment("Postcondition");
	TestStep("10","Send request 10 01 to enter default diagnostic session");
	SendDiag_Request_Verify_Response(DiagAnchor3,"10 01","50 01 00 32 01 F4");
	}	
	
	
	
testcase TCS_PK_FCA_AnchorUDSServer_ReadDataByIdentifier_DIDFE03_BLEAddress_ExtendedSession_0x61SecurityLevel_54495()
{
	testCaseComment("Precondition");
	TestStep("1","Send TesterPresent 3E 00 every 4000ms");
	SendDiag_Request_Verify_Response(DiagAnchor3,"3E 00","7E 00");
	TestStep("2","Send request 10 01 to enter default diagnostic session");
	SendDiag_Request_Verify_Response(DiagAnchor3,"10 01","50 01 00 32 01 F4");
  testCaseComment("Actions");
  TestStep("3","Send request 10 03 to enter Extended Diagnostic Session");
	SendDiag_Request_Verify_Response(DiagAnchor3,"10 03","50 03 00 32 01 F4");
  TestStep("4,5","Send Security Seed Request 61 and Key 62 in DiagAnchor");  
  Security_Seed_Key_Access(Anch3,Physical,Bosch);
  TestStep("6","Send 22 FE 03 to request ReadDataByIdentifier Service");
	SendDiag_Request_Verify_Response(DiagAnchor3,"22 FE 03","62 FE 03 FF FF FF FF FF FF");
  TestCaseComment("Postcondition");
	TestStep("7","Send request 10 01 to enter default diagnostic session");
	SendDiag_Request_Verify_Response(DiagAnchor3,"10 01","50 01 00 32 01 F4");
}	



testcase TCS_PK_FCA_AnchorUDSServer_ReadDataByIdentifier_DIDFE04_BoschEOLLock_ExtendedSession_0x61SecurityLevel_54496()
{
	testCaseComment("Precondition");
	TestStep("1","Send TesterPresent 3E 00 every 4000ms");
	SendDiag_Request_Verify_Response(DiagAnchor3,"3E 00","7E 00");
	TestStep("2","Send request 10 01 to enter default diagnostic session");
	SendDiag_Request_Verify_Response(DiagAnchor3,"10 01","50 01 00 32 01 F4");
  testCaseComment("Actions");
  TestStep("3","Send request 10 03 to enter Extended Diagnostic Session");
	SendDiag_Request_Verify_Response(DiagAnchor3,"10 03","50 03 00 32 01 F4");
  TestStep("4,5","Send Security Seed Request 61 and Key 62 in DiagAnchor");  
  Security_Seed_Key_Access(Anch3,Physical,Bosch);
  TestStep("6","Send 2E FE 04 01 to request WriteDataByIdentifier Service");
	SendDiag_Request_Verify_Response(DiagAnchor3,"2E FE 04 01","6E FE 04");
	 TestStep("7","Send 22 FE 04 to request ReadDataByIdentifier Service");
	SendDiag_Request_Verify_Response(DiagAnchor3,"22 FE 04","62 FE 04 01");
	 TestStep("8","Send 2E FE 04 00 to request WriteDataByIdentifier Service");
	SendDiag_Request_Verify_Response(DiagAnchor3,"2E FE 04 00","6E FE 04");
	TestStep("9","Send 22 FE 04 to request ReadDataByIdentifier Service");
	SendDiag_Request_Verify_Response(DiagAnchor3,"22 FE 04","62 FE 04 00");
	TestCaseComment("Postcondition");
	TestStep("10","Send request 10 01 to enter default diagnostic session");
	SendDiag_Request_Verify_Response(DiagAnchor3,"10 01","50 01 00 32 01 F4");
}	
	
	
	
testcase TCS_PK_FCA_AnchorUDSServer_ReadDataByIdentifier_DIDFE04_BoschEOLLock_ExtendedSession_0x61SecurityLevel_54497()
{
	testCaseComment("Precondition");
	TestStep("1","Send TesterPresent 3E 00 every 4000ms");
	SendDiag_Request_Verify_Response(DiagAnchor3,"3E 00","7E 00");
	TestStep("2","Send request 10 01 to enter default diagnostic session");
	SendDiag_Request_Verify_Response(DiagAnchor3,"10 01","50 01 00 32 01 F4");
  testCaseComment("Actions");
  TestStep("3","Send request 10 03 to enter Extended Diagnostic Session");
	SendDiag_Request_Verify_Response(DiagAnchor3,"10 03","50 03 00 32 01 F4");
  TestStep("4,5","Send Security Seed Request 61 and Key 62 in DiagAnchor");  
  Security_Seed_Key_Access(Anch3,Physical,Bosch);
  TestStep("6","Send 22 FE 04 to request ReadDataByIdentifier Service");
	SendDiag_Request_Verify_Response(DiagAnchor3,"22 FE 04","62 FE 04 00");
  TestCaseComment("Postcondition");
	TestStep("7","Send request 10 01 to enter default diagnostic session");
	SendDiag_Request_Verify_Response(DiagAnchor3,"10 01","50 01 00 32 01 F4");
}	



testcase TCS_PK_FCA_AnchorUDSServer_ReadDataByIdentifier_DIDFE06_TimeSinceReset_ExtendedSession_0x61SecurityLevel_54493()
{
	testCaseComment("Precondition");
	TestStep("1","Send TesterPresent 3E 00 every 4000ms");
	SendDiag_Request_Verify_Response(DiagAnchor3,"3E 00","7E 00");
	TestStep("2","Send request 10 01 to enter default diagnostic session");
	SendDiag_Request_Verify_Response(DiagAnchor3,"10 01","50 01 00 32 01 F4");
  testCaseComment("Actions");
  TestStep("3","Send request 10 03 to enter Extended Diagnostic Session");
	SendDiag_Request_Verify_Response(DiagAnchor3,"10 03","50 03 00 32 01 F4");
  TestStep("4,5","Send Security Seed Request 61 and Key 62 in DiagAnchor");  
  Security_Seed_Key_Access(Anch3,Physical,Bosch);
  TestStep("6","Send 22 FE 06 to request ReadDataByIdentifier Service");
	SendDiag_Request_Verify_Response_Length(DiagAnchor3,"22 FE 06",7);
  TestCaseComment("Postcondition");
	TestStep("7","Send request 10 01 to enter default diagnostic session");
	SendDiag_Request_Verify_Response(DiagAnchor3,"10 01","50 01 00 32 01 F4");
}		



testcase TCS_PK_FCA_AnchorUDSServer_ReadDataByIdentifier_DIDFE08_IDPinRead_ExtendedSession_0x61SecurityLevel_54499()
{
	testCaseComment("Precondition");
	TestStep("1","Send TesterPresent 3E 00 every 4000ms");
	SendDiag_Request_Verify_Response(DiagAnchor3,"3E 00","7E 00");
	TestStep("2","Send request 10 01 to enter default diagnostic session");
	SendDiag_Request_Verify_Response(DiagAnchor3,"10 01","50 01 00 32 01 F4");
  testCaseComment("Actions");
  TestStep("3","Send request 10 03 to enter Extended Diagnostic Session");
	SendDiag_Request_Verify_Response(DiagAnchor3,"10 03","50 03 00 32 01 F4");
  TestStep("4,5","Send Security Seed Request 61 and Key 62 in DiagAnchor");  
  Security_Seed_Key_Access(Anch3,Physical,Bosch);
  TestStep("6","Send 22 FE 08 to request ReadDataByIdentifier Service");
	SendDiag_Request_Verify_Response(DiagAnchor3,"22 FE 08","62 FE 08 00 00");
  TestCaseComment("Postcondition");
	TestStep("7","Send request 10 01 to enter default diagnostic session");
	SendDiag_Request_Verify_Response(DiagAnchor3,"10 01","50 01 00 32 01 F4");
}	



	
testcase TCS_PK_FCA_AnchorUDSServer_ReadDataByIdentifier_DIDFE08_IDPinRead_ExtendedSession_0x65SecurityLevel_54500()
{
	testCaseComment("Precondition");
	TestStep("1","Send TesterPresent 3E 00 every 4000ms");
	SendDiag_Request_Verify_Response(DiagAnchor3,"3E 00","7E 00");
	TestStep("2","Send request 10 01 to enter default diagnostic session");
	SendDiag_Request_Verify_Response(DiagAnchor3,"10 01","50 01 00 32 01 F4");
  testCaseComment("Actions");
  TestStep("3","Send request 10 03 to enter Extended Diagnostic Session");
	SendDiag_Request_Verify_Response(DiagAnchor3,"10 03","50 03 00 32 01 F4");
  TestStep("4,5","Send Security Seed Request 65 and Key 66 in DiagAnchor");  
  Security_Seed_Key_Access(Anch3,Physical,Incar_1);
  TestStep("6","Send 22 FE 08 to request ReadDataByIdentifier Service");
	SendDiag_Request_Verify_Response(DiagAnchor3,"22 FE 08","62 FE 08 00 00");
  TestCaseComment("Postcondition");
	TestStep("7","Send request 10 01 to enter default diagnostic session");
	SendDiag_Request_Verify_Response(DiagAnchor3,"10 01","50 01 00 32 01 F4");
}	


testcase TCS_PK_FCA_AnchorUDSServer_ReadDataByIdentifier_DIDFE08_IDPinRead_ExtendedSession_NoSecurityLevel_54503()
{
	testCaseComment("Precondition");
	TestStep("1","Send TesterPresent 3E 00 every 4000ms");
	SendDiag_Request_Verify_Response(DiagAnchor3,"3E 00","7E 00");
	TestStep("2","Send request 10 01 to enter default diagnostic session");
	SendDiag_Request_Verify_Response(DiagAnchor3,"10 01","50 01 00 32 01 F4");
  testCaseComment("Actions");
  TestStep("3","Send request 10 03 to enter Extended Diagnostic Session");
	SendDiag_Request_Verify_Response(DiagAnchor3,"10 03","50 03 00 32 01 F4");
  TestStep("4","Send 22 FE 08 to request ReadDataByIdentifier Service");
	SendDiag_Request_Verify_Response(DiagAnchor3,"22 FE 08","62 FE 08 00 00");
  TestCaseComment("Postcondition");
	TestStep("5","Send request 10 01 to enter default diagnostic session");
	SendDiag_Request_Verify_Response(DiagAnchor3,"10 01","50 01 00 32 01 F4");
}


testcase TCS_PK_FCA_AnchorUDSServer_ReadDataByIdentifier_DIDFE0E_SupplyVoltage_ExtendedSession_0x61SecurityLevel_54504()
{
	testCaseComment("Precondition");
	TestStep("1","Send TesterPresent 3E 00 every 4000ms");
	SendDiag_Request_Verify_Response(DiagAnchor3,"3E 00","7E 00");
	TestStep("2","Send request 10 01 to enter default diagnostic session");
	SendDiag_Request_Verify_Response(DiagAnchor3,"10 01","50 01 00 32 01 F4");
  testCaseComment("Actions");
  TestStep("3","Send request 10 03 to enter Extended Diagnostic Session");
	SendDiag_Request_Verify_Response(DiagAnchor3,"10 03","50 03 00 32 01 F4");
  TestStep("4,5","Send Security Seed Request 61 and Key 62 in DiagAnchor");  
  Security_Seed_Key_Access(Anch3,Physical,Bosch);
  TestStep("6","Send 22 FE 0E to request ReadDataByIdentifier Service");
	SendDiag_Request_Verify_Response_Length(DiagAnchor3,"22 FE 0E",5);
  TestCaseComment("Postcondition");
	TestStep("7","Send request 10 01 to enter default diagnostic session");
	SendDiag_Request_Verify_Response(DiagAnchor3,"10 01","50 01 00 32 01 F4");
}	


	
testcase TCS_PK_FCA_AnchorUDSServer_ReadDataByIdentifier_DIDFE11_SWInformation_ExtendedSession_0x61SecurityLevel_54506()
{
	testCaseComment("Precondition");
	TestStep("1","Send TesterPresent 3E 00 every 4000ms");
	SendDiag_Request_Verify_Response(DiagAnchor3,"3E 00","7E 00");
	TestStep("2","Send request 10 01 to enter default diagnostic session");
	SendDiag_Request_Verify_Response(DiagAnchor3,"10 01","50 01 00 32 01 F4");
  testCaseComment("Actions");
  TestStep("3","Send request 10 03 to enter Extended Diagnostic Session");
	SendDiag_Request_Verify_Response(DiagAnchor3,"10 03","50 03 00 32 01 F4");
  TestStep("4,5","Send Security Seed Request 61 and Key 62 in DiagAnchor");  
  Security_Seed_Key_Access(Anch3,Physical,Bosch);
  TestStep("6","Send 22 FE 11");
	SendDiag_Request_Verify_Response_Length(DiagAnchor3,"22 FE 11",86);
  TestCaseComment("Postcondition");
	TestStep("7","Send request 10 01 to enter default diagnostic session");
	SendDiag_Request_Verify_Response(DiagAnchor3,"10 01","50 01 00 32 01 F4");
}	


	
testcase TCS_PK_FCA_AnchorUDSServer_ReadDataByIdentifier_DIDFE11_SWInformation_ExtendedSession_0x65SecurityLevel_54501()
{
	testCaseComment("Precondition");
	TestStep("1","Send TesterPresent 3E 00 every 4000ms");
	SendDiag_Request_Verify_Response(DiagAnchor3,"3E 00","7E 00");
	TestStep("2","Send request 10 01 to enter default diagnostic session");
	SendDiag_Request_Verify_Response(DiagAnchor3,"10 01","50 01 00 32 01 F4");
  testCaseComment("Actions");
  TestStep("3","Send request 10 03 to enter Extended Diagnostic Session");
	SendDiag_Request_Verify_Response(DiagAnchor3,"10 03","50 03 00 32 01 F4");
  TestStep("4,5","Send Security Seed Request 65 and Key 66 in DiagAnchor");  
  Security_Seed_Key_Access(Anch3,Physical,Incar_1);
  TestStep("6","Send 22 FE 11");
	SendDiag_Request_Verify_Response_Length(DiagAnchor3,"22 FE 11",86);
  TestCaseComment("Postcondition");
	TestStep("7","Send request 10 01 to enter default diagnostic session");
	SendDiag_Request_Verify_Response(DiagAnchor3,"10 01","50 01 00 32 01 F4");
}


	
testcase TCS_PK_FCA_AnchorUDSServer_ReadDataByID_DIDFE11_SWInformation_Programming_0x61SecurityLevel_54509()
{
	testCaseComment("Precondition");
	TestStep("1","Send TesterPresent 3E 00 every 4000ms");
	SendDiag_Request_Verify_Response(DiagAnchor3,"3E 00","7E 00");
	TestStep("2","Send request 10 01 to enter default diagnostic session");
	SendDiag_Request_Verify_Response(DiagAnchor3,"10 01","50 01 00 32 01 F4");
  TestStep("3","Send request 10 03 to enter Extended Diagnostic Session");
	SendDiag_Request_Verify_Response(DiagAnchor3,"10 03","50 03 00 32 01 F4");
  TestStep("4,5","Send Security Seed Request 61 and Key 62 in DiagAnchor");  
  Security_Seed_Key_Access(Anch3,Physical,Bosch);
  testCaseComment("Actions");
  TestStep("6","Send request 10 02 to enter Programming Diagnostic Session");
	SendDiag_Request_Verify_Response(DiagAnchor3,"10 02","50 02 00 32 01 F4");
	TestStep("7,8","Send Security Seed Request 61 and Key 62 in DiagAnchor");  
  Security_Seed_Key_Access(Anch3,Physical,Bosch);
  TestStep("9","Send 22 FE 11");
	SendDiag_Request_Verify_Response_Length(DiagAnchor3,"22 FE 11",86);
  TestCaseComment("Postcondition");
	TestStep("10","Send request 10 01 to enter default diagnostic session");
	SendDiag_Request_Verify_Response(DiagAnchor3,"10 01","50 01 00 32 01 F4");
}



testcase TCS_PK_FCA_AnchorUDSServer_ReadDataByIdentifier_DIDFE11_SWInformation_ProgrammingSession_0x65SecurityLevel_54511()
{
	testCaseComment("Precondition");
	TestStep("1","Send TesterPresent 3E 00 every 4000ms");
	SendDiag_Request_Verify_Response(DiagAnchor3,"3E 00","7E 00");
	TestStep("2","Send request 10 01 to enter default diagnostic session");
	SendDiag_Request_Verify_Response(DiagAnchor3,"10 01","50 01 00 32 01 F4");
  TestStep("3","Send request 10 03 to enter Extended Diagnostic Session");
	SendDiag_Request_Verify_Response(DiagAnchor3,"10 03","50 03 00 32 01 F4");
  TestStep("4,5","Send Security Seed Request 61 and Key 62 in DiagAnchor");  
  Security_Seed_Key_Access(Anch3,Physical,Bosch);
  testCaseComment("Actions");
  TestStep("6","Send request 10 02 to enter Programming Diagnostic Session");
	SendDiag_Request_Verify_Response(DiagAnchor3,"10 02","50 02 00 32 01 F4");
	TestStep("7,8","Send Security Seed Request 65 and Key 66 in DiagAnchor");  
  Security_Seed_Key_Access(Anch3,Physical,Incar_1);
  TestStep("9","Send 22 FE 11");
	SendDiag_Request_Verify_Response_Length(DiagAnchor3,"22 FE 11",86);
  TestCaseComment("Postcondition");
	TestStep("10","Send request 10 01 to enter default diagnostic session");
	SendDiag_Request_Verify_Response(DiagAnchor3,"10 01","50 01 00 32 01 F4");
}



testcase TCS_PK_FCA_AnchorUDSServer_ReadDataByIdentifier_DIDFE13_UWBChipVersion_ExtendedSession_0x61SecurityLevel_54512()
{
	testCaseComment("Precondition");
	TestStep("1","Send TesterPresent 3E 00 every 4000ms");
	SendDiag_Request_Verify_Response(DiagAnchor3,"3E 00","7E 00");
	TestStep("2","Send request 10 01 to enter default diagnostic session");
	SendDiag_Request_Verify_Response(DiagAnchor3,"10 01","50 01 00 32 01 F4");
  testCaseComment("Actions");
  TestStep("3","Send request 10 03 to enter Extended Diagnostic Session");
	SendDiag_Request_Verify_Response(DiagAnchor3,"10 03","50 03 00 32 01 F4");
  TestStep("4,5","Send Security Seed Request 61 and Key 62 in DiagAnchor");  
  Security_Seed_Key_Access(Anch3,Physical,Bosch);
  TestStep("6","Send 22 FE 13");
	SendDiag_Request_Verify_Response_Length(DiagAnchor3,"22 FE 13",57);
  TestCaseComment("Postcondition");
	TestStep("7","Send request 10 01 to enter default diagnostic session");
	SendDiag_Request_Verify_Response(DiagAnchor3,"10 01","50 01 00 32 01 F4");
}	



testcase TCS_PK_FCA_AnchorUDSServer_ReadDataByIdentifier_DIDFE14_SourceControlCommitID_ExtendedSession_0x61SecurityLevel_54508()
{
	testCaseComment("Precondition");
	TestStep("1","Send TesterPresent 3E 00 every 4000ms");
	SendDiag_Request_Verify_Response(DiagAnchor3,"3E 00","7E 00");
	TestStep("2","Send request 10 01 to enter default diagnostic session");
	SendDiag_Request_Verify_Response(DiagAnchor3,"10 01","50 01 00 32 01 F4");
  testCaseComment("Actions");
  TestStep("3","Send request 10 03 to enter Extended Diagnostic Session");
	SendDiag_Request_Verify_Response(DiagAnchor3,"10 03","50 03 00 32 01 F4");
  TestStep("4,5","Send Security Seed Request 61 and Key 62 in DiagAnchor");  
  Security_Seed_Key_Access(Anch3,Physical,Bosch);
  TestStep("6","Send 22 FE 14");
	SendDiag_Request_Verify_Response_Length(DiagAnchor3,"22 FE 14",87);
  TestCaseComment("Postcondition");
	TestStep("7","Send request 10 01 to enter default diagnostic session");
	SendDiag_Request_Verify_Response(DiagAnchor3,"10 01","50 01 00 32 01 F4");
}



testcase TCS_PK_FCA_AnchorUDSServer_ReadDataByIdentifier_DIDFE1A_BLEorMiniMCURuntimeStats_ExtendedSession_0x61SecurityLevel_54514()
{
	testCaseComment("Precondition");
	TestStep("1","Send TesterPresent 3E 00 every 4000ms");
	SendDiag_Request_Verify_Response(DiagAnchor3,"3E 00","7E 00");
	TestStep("2","Send request 10 01 to enter default diagnostic session");
	SendDiag_Request_Verify_Response(DiagAnchor3,"10 01","50 01 00 32 01 F4");
  testCaseComment("Actions");
  TestStep("3","Send request 10 03 to enter Extended Diagnostic Session");
	SendDiag_Request_Verify_Response(DiagAnchor3,"10 03","50 03 00 32 01 F4");
  TestStep("4,5","Send Security Seed Request 61 and Key 62 in DiagAnchor");  
  Security_Seed_Key_Access(Anch3,Physical,Bosch);
  TestStep("6","Send 22 FE 1A");
	SendDiag_Request_Verify_Response_Length(DiagAnchor3,"22 FE 1A",123);
  TestCaseComment("Postcondition");
	TestStep("7","Send request 10 01 to enter default diagnostic session");
	SendDiag_Request_Verify_Response(DiagAnchor3,"10 01","50 01 00 32 01 F4");
}		



testcase TCS_PK_FCA_AnchorUDSServer_ReadDataByIdentifier_DIDFE1C_UWBRuntimeStats_ExtendedSession_0x61SecurityLevel_54515()
{
	testCaseComment("Precondition");
	TestStep("1","Send TesterPresent 3E 00 every 4000ms");
	SendDiag_Request_Verify_Response(DiagAnchor3,"3E 00","7E 00");
	TestStep("2","Send request 10 01 to enter default diagnostic session");
	SendDiag_Request_Verify_Response(DiagAnchor3,"10 01","50 01 00 32 01 F4");
  testCaseComment("Actions");
  TestStep("3","Send request 10 03 to enter Extended Diagnostic Session");
	SendDiag_Request_Verify_Response(DiagAnchor3,"10 03","50 03 00 32 01 F4");
  TestStep("4,5","Send Security Seed Request 61 and Key 62 in DiagAnchor");  
  Security_Seed_Key_Access(Anch3,Physical,Bosch);
  TestStep("6","Send 22 FE 1C");
	SendDiag_Request_Verify_Response_Length(DiagAnchor3,"22 FE 1C",23);
  TestCaseComment("Postcondition");
	TestStep("7","Send request 10 01 to enter default diagnostic session");
	SendDiag_Request_Verify_Response(DiagAnchor3,"10 01","50 01 00 32 01 F4");
}



testcase TCS_PK_FCA_AnchorUDSServer_ReadDataByIdentifier_DIDFE25_SwupStatus_ProgrammingSession_0x61SecurityLevel_54513()
{
	testCaseComment("Precondition");
	TestStep("1","Send TesterPresent 3E 00 every 4000ms");
	SendDiag_Request_Verify_Response(DiagAnchor3,"3E 00","7E 00");
	TestStep("2","Send request 10 01 to enter default diagnostic session");
	SendDiag_Request_Verify_Response(DiagAnchor3,"10 01","50 01 00 32 01 F4");
  TestStep("3","Send request 10 03 to enter Extended Diagnostic Session");
	SendDiag_Request_Verify_Response(DiagAnchor3,"10 03","50 03 00 32 01 F4");
  TestStep("4,5","Send Security Seed Request 61 and Key 62 in DiagAnchor");  
  Security_Seed_Key_Access(Anch3,Physical,Bosch);
  testCaseComment("Actions");
  TestStep("6","Send request 10 02 to enter Programming Diagnostic Session");
	SendDiag_Request_Verify_Response(DiagAnchor3,"10 02","50 02 00 32 01 F4");
	TestStep("7,8","Send Security Seed Request 61 and Key 62 in DiagAnchor");  
  Security_Seed_Key_Access(Anch3,Physical,Bosch);
  TestStep("9","Send 22 FE 25");
	SendDiag_Request_Verify_Response_Length(DiagAnchor3,"22 FE 25",50);
  TestCaseComment("Postcondition");
	TestStep("10","Send request 10 01 to enter default diagnostic session");
	SendDiag_Request_Verify_Response(DiagAnchor3,"10 01","50 01 00 32 01 F4");
}		
	
	
	
testcase TCS_PK_FCA_AnchorUDSServer_ReadDataByIdentifier_DIDFE26_R4AppSignature_ProgrammingSession_0x61SecurityLevel_54519()
{
	testCaseComment("Precondition");
	TestStep("1","Send TesterPresent 3E 00 every 4000ms");
	SendDiag_Request_Verify_Response(DiagAnchor3,"3E 00","7E 00");
	TestStep("2","Send request 10 01 to enter default diagnostic session");
	SendDiag_Request_Verify_Response(DiagAnchor3,"10 01","50 01 00 32 01 F4");
  TestStep("3","Send request 10 03 to enter Extended Diagnostic Session");
	SendDiag_Request_Verify_Response(DiagAnchor3,"10 03","50 03 00 32 01 F4");
  TestStep("4,5","Send Security Seed Request 61 and Key 62 in DiagAnchor");  
  Security_Seed_Key_Access(Anch3,Physical,Bosch);
  testCaseComment("Actions");
  TestStep("6","Send request 10 02 to enter Programming Diagnostic Session");
	SendDiag_Request_Verify_Response(DiagAnchor3,"10 02","50 02 00 32 01 F4");
	TestStep("7,8","Send Security Seed Request 61 and Key 62 in DiagAnchor");  
  Security_Seed_Key_Access(Anch3,Physical,Bosch);
  TestStep("9","Send 22 FE 26");
	SendDiag_Request_Verify_Response_Length(DiagAnchor3,"22 FE 26",68);
  TestCaseComment("Postcondition");
	TestStep("10","Send request 10 01 to enter default diagnostic session");
	SendDiag_Request_Verify_Response(DiagAnchor3,"10 01","50 01 00 32 01 F4");
}	



testcase TCS_PK_FCA_AnchorUDSServer_ReadDataByIdentifier_DIDFE27_R4DspSignature_ProgrammingSession_0x61SecurityLevel_54520()
{
	testCaseComment("Precondition");
	TestStep("1","Send TesterPresent 3E 00 every 4000ms");
	SendDiag_Request_Verify_Response(DiagAnchor3,"3E 00","7E 00");
	TestStep("2","Send request 10 01 to enter default diagnostic session");
	SendDiag_Request_Verify_Response(DiagAnchor3,"10 01","50 01 00 32 01 F4");
  TestStep("3","Send request 10 03 to enter Extended Diagnostic Session");
	SendDiag_Request_Verify_Response(DiagAnchor3,"10 03","50 03 00 32 01 F4");
  TestStep("4,5","Send Security Seed Request 61 and Key 62 in DiagAnchor");  
  Security_Seed_Key_Access(Anch3,Physical,Bosch);
  testCaseComment("Actions");
   TestStep("6","Send request 10 02 to enter Programming Diagnostic Session");
	SendDiag_Request_Verify_Response(DiagAnchor3,"10 02","50 02 00 32 01 F4");
	 TestStep("7,8","Send Security Seed Request 61 and Key 62 in DiagAnchor");  
  Security_Seed_Key_Access(Anch3,Physical,Bosch);
  TestStep("9","Send 22 FE 27");
	SendDiag_Request_Verify_Response_Length(DiagAnchor3,"22 FE 27",68);
 TestCaseComment("Postcondition");
	TestStep("10","Send request 10 01 to enter default diagnostic session");
	SendDiag_Request_Verify_Response(DiagAnchor3,"10 01","50 01 00 32 01 F4");
}	




testcase TCS_PK_FCA_AnchorUDSServer_ReadDataByIdentifier_DIDFE30_AnchorUDSSessionIdentification_DefaultSession_54521()
{
	testCaseComment("Precondition");
	TestStep("1","Send TesterPresent 3E 00 every 4000ms");
	SendDiag_Request_Verify_Response(DiagAnchor3,"3E 00","7E 00");
  testCaseComment("Actions");
  TestStep("2","Send request 10 01 to enter Default Diagnostic Session");
	SendDiag_Request_Verify_Response(DiagAnchor3,"10 01","50 01 00 32 01 F4");
  TestStep("3","Send 22 FE 30 to request ReadDataByIdentifier Service");
	SendDiag_Request_Verify_Response(DiagAnchor3,"22 FE 30","62 FE 30 01 41");
  TestCaseComment("Postcondition");
	TestStep("4","Send request 10 01 to enter default diagnostic session");
	SendDiag_Request_Verify_Response(DiagAnchor3,"10 01","50 01 00 32 01 F4");
}



testcase TCS_PK_FCA_AnchorUDSServer_ReadDataByIdentifier_DIDFE30_AnchorUDSSessionIdentification_ExtendedSession_0x61SecurityLevel_54517()
{
	testCaseComment("Precondition");
	TestStep("1","Send TesterPresent 3E 00 every 4000ms");
	SendDiag_Request_Verify_Response(DiagAnchor3,"3E 00","7E 00");
	TestStep("2","Send request 10 01 to enter default diagnostic session");
	SendDiag_Request_Verify_Response(DiagAnchor3,"10 01","50 01 00 32 01 F4");
  testCaseComment("Actions");
  TestStep("3","Send request 10 03 to enter Extended Diagnostic Session");
	SendDiag_Request_Verify_Response(DiagAnchor3,"10 03","50 03 00 32 01 F4");
  TestStep("4,5","Send Security Seed Request 61 and Key 62 in DiagAnchor");  
  Security_Seed_Key_Access(Anch3,Physical,Bosch);
  TestStep("6","Send 22 FE 30 to request ReadDataByIdentifier Service");
	SendDiag_Request_Verify_Response(DiagAnchor3,"22 FE 30","62 FE 30 03 41");
  TestCaseComment("Postcondition");
	TestStep("7","Send request 10 01 to enter default diagnostic session");
	SendDiag_Request_Verify_Response(DiagAnchor3,"10 01","50 01 00 32 01 F4");
}



testcase TCS_PK_FCA_AnchorUDSServer_ReadDataByIdentifier_DIDFE30_AnchorUDSSessionIdentification_ExtendedSession_0x65SecurityLevel_54524()
{
	testCaseComment("Precondition");
	TestStep("1","Send TesterPresent 3E 00 every 4000ms");
	SendDiag_Request_Verify_Response(DiagAnchor3,"3E 00","7E 00");
	TestStep("2","Send request 10 01 to enter default diagnostic session");
	SendDiag_Request_Verify_Response(DiagAnchor3,"10 01","50 01 00 32 01 F4");
  testCaseComment("Actions");
  TestStep("3","Send request 10 03 to enter Extended Diagnostic Session");
	SendDiag_Request_Verify_Response(DiagAnchor3,"10 03","50 03 00 32 01 F4");
  TestStep("4,5","Send Security Seed Request 65 and Key 66 in DiagAnchor");  
  Security_Seed_Key_Access(Anch3,Physical,Incar_1);
  TestStep("6","Send 22 FE 30 to request ReadDataByIdentifier Service");
	SendDiag_Request_Verify_Response(DiagAnchor3,"22 FE 30","62 FE 30 03 41");
  TestCaseComment("Postcondition");
	TestStep("7","Send request 10 01 to enter default diagnostic session");
	SendDiag_Request_Verify_Response(DiagAnchor3,"10 01","50 01 00 32 01 F4");
}


testcase TCS_PK_FCA_AnchorUDSServer_ReadDataByIdentifier_DIDFE30_AnchorUDSSessionIdentification_ExtendedSession_NoSecurityLevel_54525()
{
	testCaseComment("Precondition");
	TestStep("1","Send TesterPresent 3E 00 every 4000ms");
	SendDiag_Request_Verify_Response(DiagAnchor3,"3E 00","7E 00");
	 TestStep("2","Send request 10 01 to enter Default Diagnostic Session");
	SendDiag_Request_Verify_Response(DiagAnchor3,"10 01","50 01 00 32 01 F4");
  testCaseComment("Actions");
  TestStep("3","Send request 10 03 to enter Extended Diagnostic Session");
	SendDiag_Request_Verify_Response(DiagAnchor3,"10 03","50 03 00 32 01 F4");
  TestStep("4","Send 22 FE 30 to request ReadDataByIdentifier Service");
	SendDiag_Request_Verify_Response(DiagAnchor3,"22 FE 30","62 FE 30 03 41");
  TestCaseComment("Postcondition");
	TestStep("5","Send request 10 01 to enter default diagnostic session");
	SendDiag_Request_Verify_Response(DiagAnchor3,"10 01","50 01 00 32 01 F4");
}



testcase TCS_PK_FCA_AnchorUDSServer_ReadDataByID_DIDFE30_AnchorUDSSessionID_Programming_0x61SecurityLevel_54527()
{
	testCaseComment("Precondition");
	TestStep("1","Send TesterPresent 3E 00 every 4000ms");
	SendDiag_Request_Verify_Response(DiagAnchor3,"3E 00","7E 00");
	TestStep("2","Send request 10 01 to enter default diagnostic session");
	SendDiag_Request_Verify_Response(DiagAnchor3,"10 01","50 01 00 32 01 F4");
  TestStep("3","Send request 10 03 to enter Extended Diagnostic Session");
	SendDiag_Request_Verify_Response(DiagAnchor3,"10 03","50 03 00 32 01 F4");
  TestStep("4,5","Send Security Seed Request 61 and Key 62 in DiagAnchor");  
  Security_Seed_Key_Access(Anch3,Physical,Bosch);
  testCaseComment("Actions");
   TestStep("6","Send request 10 02 to enter Programming Diagnostic Session");
	SendDiag_Request_Verify_Response(DiagAnchor3,"10 02","50 02 00 32 01 F4");
	 TestStep("7,8","Send Security Seed Request 61 and Key 62 in DiagAnchor");  
  Security_Seed_Key_Access(Anch3,Physical,Bosch);
  TestStep("9","Send 22 FE 30 to request ReadDataByIdentifier Service");
	SendDiag_Request_Verify_Response(DiagAnchor3,"22 FE 30","62 FE 30 02 42");
 TestCaseComment("Postcondition");
	TestStep("10","Send request 10 01 to enter default diagnostic session");
	SendDiag_Request_Verify_Response(DiagAnchor3,"10 01","50 01 00 32 01 F4");
}



testcase TCS_PK_FCA_AnchorUDSServer_ReadDataByID_DIDFE30_AnchorUDSSessionID_Programming_0x65SecurityLevel_54523()
{
	testCaseComment("Precondition");
	TestStep("1","Send TesterPresent 3E 00 every 4000ms");
	SendDiag_Request_Verify_Response(DiagAnchor3,"3E 00","7E 00");
	TestStep("2","Send request 10 01 to enter default diagnostic session");
	SendDiag_Request_Verify_Response(DiagAnchor3,"10 01","50 01 00 32 01 F4");
  TestStep("3","Send request 10 03 to enter Extended Diagnostic Session");
	SendDiag_Request_Verify_Response(DiagAnchor3,"10 03","50 03 00 32 01 F4");
  TestStep("4,5","Send Security Seed Request 61 and Key 62 in DiagAnchor");  
  Security_Seed_Key_Access(Anch3,Physical,Bosch);
  testCaseComment("Actions");
   TestStep("6","Send request 10 02 to enter Programming Diagnostic Session");
	SendDiag_Request_Verify_Response(DiagAnchor3,"10 02","50 02 00 32 01 F4");
	 TestStep("7,8","Send Security Seed Request 65 and Key 66 in DiagAnchor");  
  Security_Seed_Key_Access(Anch3,Physical,Incar_1);
  TestStep("9","Send 22 FE 30 to request ReadDataByIdentifier Service");
	SendDiag_Request_Verify_Response(DiagAnchor3,"22 FE 30","62 FE 30 02 42");
 TestCaseComment("Postcondition");
	TestStep("10","Send request 10 01 to enter default diagnostic session");
	SendDiag_Request_Verify_Response(DiagAnchor3,"10 01","50 01 00 32 01 F4");
}


testcase TCS_PK_FCA_AnchorUDSServer_ReadDataByIdentifier_DIDFE30_AnchorUDSSessionIdentification_ProgrammingSession_NoSecurityLevel_54530()
{
	testCaseComment("Precondition");
	TestStep("1","Send TesterPresent 3E 00 every 4000ms");
	SendDiag_Request_Verify_Response(DiagAnchor3,"3E 00","7E 00");
	TestStep("2","Send request 10 01 to enter default diagnostic session");
	SendDiag_Request_Verify_Response(DiagAnchor3,"10 01","50 01 00 32 01 F4");
  TestStep("3","Send request 10 03 to enter Extended Diagnostic Session");
	SendDiag_Request_Verify_Response(DiagAnchor3,"10 03","50 03 00 32 01 F4");
  TestStep("4,5","Send Security Seed Request 61 and Key 62 in DiagAnchor");  
  Security_Seed_Key_Access(Anch3,Physical,Bosch);
  testCaseComment("Actions");
   TestStep("6","Send request 10 02 to enter Programming Diagnostic Session");
	SendDiag_Request_Verify_Response(DiagAnchor3,"10 02","50 02 00 32 01 F4");
  TestStep("7","Send 22 FE 30 to request ReadDataByIdentifier Service");
	SendDiag_Request_Verify_Response(DiagAnchor3,"22 FE 30","62 FE 30 02 42");
 TestCaseComment("Postcondition");
	TestStep("8","Send request 10 01 to enter default diagnostic session");
	SendDiag_Request_Verify_Response(DiagAnchor3,"10 01","50 01 00 32 01 F4");
}



testcase TCS_PK_FCA_AnchorUDSServer_ReadDataByIdentifier_DIDFE33_BLEChipTemp_ExtendedSession_0x61SecurityLevel_54531()
{
	testCaseComment("Precondition");
	TestStep("1","Send TesterPresent 3E 00 every 4000ms");
	SendDiag_Request_Verify_Response(DiagAnchor3,"3E 00","7E 00");
	TestStep("2","Send request 10 01 to enter default diagnostic session");
	SendDiag_Request_Verify_Response(DiagAnchor3,"10 01","50 01 00 32 01 F4");
  testCaseComment("Actions");
  TestStep("3","Send request 10 03 to enter Extended Diagnostic Session");
	SendDiag_Request_Verify_Response(DiagAnchor3,"10 03","50 03 00 32 01 F4");
  TestStep("4,5","Send Security Seed Request 61 and Key 62 in DiagAnchor");  
  Security_Seed_Key_Access(Anch3,Physical,Bosch);
  TestStep("6","Send 22 FE 33 to request ReadDataByIdentifier Service");
	SendDiag_Request_Verify_Response_Length(DiagAnchor3,"22 FE 33",5);
  TestCaseComment("Postcondition");
	TestStep("7","Send request 10 01 to enter default diagnostic session");
	SendDiag_Request_Verify_Response(DiagAnchor3,"10 01","50 01 00 32 01 F4");
}



testcase TCS_PK_FCA_AnchorUDSServer_ReadDataByIdentifier_DIDFE34_BLEResetCount_ExtendedSession_0x61SecurityLevel_54528()
{
	testCaseComment("Precondition");
	TestStep("1","Send TesterPresent 3E 00 every 4000ms");
	SendDiag_Request_Verify_Response(DiagAnchor3,"3E 00","7E 00");
	TestStep("2","Send request 10 01 to enter default diagnostic session");
	SendDiag_Request_Verify_Response(DiagAnchor3,"10 01","50 01 00 32 01 F4");
  testCaseComment("Actions");
  TestStep("3","Send request 10 03 to enter Extended Diagnostic Session");
	SendDiag_Request_Verify_Response(DiagAnchor3,"10 03","50 03 00 32 01 F4");
  TestStep("4,5","Send Security Seed Request 61 and Key 62 in DiagAnchor");  
  Security_Seed_Key_Access(Anch3,Physical,Bosch);
  TestStep("6","Send 22 FE 34 to request ReadDataByIdentifier Service");
	SendDiag_Request_Verify_Response_Length(DiagAnchor3,"22 FE 34",8);
  TestCaseComment("Postcondition");
	TestStep("7","Send request 10 01 to enter default diagnostic session");
	SendDiag_Request_Verify_Response(DiagAnchor3,"10 01","50 01 00 32 01 F4");
}



testcase TCS_PK_FCA_AnchorUDSServer_ReadDataByIdentifier_DIDFE35_BLEResetCause_ExtendedSession_0x61SecurityLevel_54534()
{
	testCaseComment("Precondition");
	TestStep("1","Send TesterPresent 3E 00 every 4000ms");
	SendDiag_Request_Verify_Response(DiagAnchor3,"3E 00","7E 00");
	TestStep("2","Send request 10 01 to enter default diagnostic session");
	SendDiag_Request_Verify_Response(DiagAnchor3,"10 01","50 01 00 32 01 F4");
  testCaseComment("Actions");
  TestStep("3","Send request 10 03 to enter Extended Diagnostic Session");
	SendDiag_Request_Verify_Response(DiagAnchor3,"10 03","50 03 00 32 01 F4");
  TestStep("4,5","Send Security Seed Request 61 and Key 62 in DiagAnchor");  
  Security_Seed_Key_Access(Anch3,Physical,Bosch);
  TestStep("6","Send 22 FE 35 to request ReadDataByIdentifier Service");
	SendDiag_Request_Verify_Response_Length(DiagAnchor3,"22 FE 35",4);
  TestCaseComment("Postcondition");
	TestStep("7","Send request 10 01 to enter default diagnostic session");
	SendDiag_Request_Verify_Response(DiagAnchor3,"10 01","50 01 00 32 01 F4");
}	



testcase TCS_PK_FCA_AnchorUDSServer_ReadDataByIdentifier_DIDFE40_FirstFourBytesOfPublicKeys_ExtendedSession_0x61SecurityLevel_54532()
{
	testCaseComment("Precondition");
	TestStep("1","Send TesterPresent 3E 00 every 4000ms");
	SendDiag_Request_Verify_Response(DiagAnchor3,"3E 00","7E 00");
	TestStep("2","Send request 10 01 to enter default diagnostic session");
	SendDiag_Request_Verify_Response(DiagAnchor3,"10 01","50 01 00 32 01 F4");
  testCaseComment("Actions");
  TestStep("3","Send request 10 03 to enter Extended Diagnostic Session");
	SendDiag_Request_Verify_Response(DiagAnchor3,"10 03","50 03 00 32 01 F4");
  TestStep("4,5","Send Security Seed Request 61 and Key 62 in DiagAnchor");  
  Security_Seed_Key_Access(Anch3,Physical,Bosch);
  TestStep("6","Send 22 FE 40 to request ReadDataByIdentifier Service");
	SendDiag_Request_Verify_Response_Length(DiagAnchor3,"22 FE 40",99);
  TestCaseComment("Postcondition");
	TestStep("7","Send request 10 01 to enter default diagnostic session");
	SendDiag_Request_Verify_Response(DiagAnchor3,"10 01","50 01 00 32 01 F4");
}


testcase TCS_PK_FCA_AnchorUDSServer_ReadDataByIdentifier_DIDFE43_BLEResolvablePrivateAddress_ExtendedSession_0x61SecurityLevel_54541()
{
	testCaseComment("Precondition");
	TestStep("1","Send TesterPresent 3E 00 every 4000ms");
	SendDiag_Request_Verify_Response(DiagAnchor3,"3E 00","7E 00");
	TestStep("2","Send request 10 01 to enter default diagnostic session");
	SendDiag_Request_Verify_Response(DiagAnchor3,"10 01","50 01 00 32 01 F4");
  testCaseComment("Actions");
  TestStep("3","Send request 10 03 to enter Extended Diagnostic Session");
	SendDiag_Request_Verify_Response(DiagAnchor3,"10 03","50 03 00 32 01 F4");
  TestStep("4,5","Send Security Seed Request 61 and Key 62 in DiagAnchor");  
  Security_Seed_Key_Access(Anch3,Physical,Bosch);
  TestStep("6","Send 22 FE 43 to request ReadDataByIdentifier Service");
	SendDiag_Request_Verify_Response_Length(DiagAnchor3,"22 FE 43",9);
  TestCaseComment("Postcondition");
	TestStep("7","Send request 10 01 to enter default diagnostic session");
	SendDiag_Request_Verify_Response(DiagAnchor3,"10 01","50 01 00 32 01 F4");
}

testcase TCS_PK_FCA_AnchorUDSServer_ReadDataByIdentifier_DIDFEA1_AnchorIDTestMode_ExtendedSession_0x61SecurityLevel_54547()
{
	testCaseComment("Precondition");
	TestStep("1","Send TesterPresent 3E 00 every 4000ms");
	SendDiag_Request_Verify_Response(DiagAnchor3,"3E 00","7E 00");
	TestStep("2","Send request 10 01 to enter default diagnostic session");
	SendDiag_Request_Verify_Response(DiagAnchor3,"10 01","50 01 00 32 01 F4");
  testCaseComment("Actions");
  TestStep("3","Send request 10 03 to enter Extended Diagnostic Session");
	SendDiag_Request_Verify_Response(DiagAnchor3,"10 03","50 03 00 32 01 F4");
  TestStep("4,5","Send Security Seed Request 61 and Key 62 in DiagAnchor");  
  Security_Seed_Key_Access(Anch3,Physical,Bosch);
  TestStep("6","Send 22 FE A1 to request ReadDataByIdentifier Service");
	SendDiag_Request_Verify_Response(DiagAnchor3,"22 FE A1","62 FE A1 00");
  TestCaseComment("Postcondition");
	TestStep("7","Send request 10 01 to enter default diagnostic session");
	SendDiag_Request_Verify_Response(DiagAnchor3,"10 01","50 01 00 32 01 F4");
}



testcase TCS_PK_FCA_AnchorUDSServer_ReadDataByIdentifier_DIDFEA4_RFTestMode_ExtendedSession_0x61SecurityLevel_54550()
{
	testCaseComment("Precondition");
	TestStep("1","Send TesterPresent 3E 00 every 4000ms");
	SendDiag_Request_Verify_Response(DiagAnchor3,"3E 00","7E 00");
	TestStep("2","Send request 10 01 to enter default diagnostic session");
	SendDiag_Request_Verify_Response(DiagAnchor3,"10 01","50 01 00 32 01 F4");
  testCaseComment("Actions");
  TestStep("3","Send request 10 03 to enter Extended Diagnostic Session");
	SendDiag_Request_Verify_Response(DiagAnchor3,"10 03","50 03 00 32 01 F4");
  TestStep("4,5","Send Security Seed Request 61 and Key 62 in DiagAnchor");  
  Security_Seed_Key_Access(Anch3,Physical,Bosch);
  TestStep("6","Send 22 FE A4 to request ReadDataByIdentifier Service");
	SendDiag_Request_Verify_Response(DiagAnchor3,"22 FE A4","62 FE A4 00");
  TestCaseComment("Postcondition");
	TestStep("7","Send request 10 01 to enter default diagnostic session");
	SendDiag_Request_Verify_Response(DiagAnchor3,"10 01","50 01 00 32 01 F4");
}



testcase TCS_PK_FCA_AnchorUDSServer_ReadDataByIdentifier_DIDFED8_AnchorTeachType_ExtendedSession_0x65SecurityLevel_54551()
{
	testCaseComment("Precondition");
	TestStep("1","Send TesterPresent 3E 00 every 4000ms");
	SendDiag_Request_Verify_Response(DiagAnchor3,"3E 00","7E 00");
	TestStep("2","Send request 10 01 to enter default diagnostic session");
	SendDiag_Request_Verify_Response(DiagAnchor3,"10 01","50 01 00 32 01 F4");
  testCaseComment("Actions");
  TestStep("3","Send request 10 03 to enter Extended Diagnostic Session");
	SendDiag_Request_Verify_Response(DiagAnchor3,"10 03","50 03 00 32 01 F4");
  TestStep("4,5","Send Security Seed Request 65 and Key 66 in DiagAnchor");  
  Security_Seed_Key_Access(Anch3,Physical,Incar_1);
  TestStep("6","Send 22 FE D8 to request ReadDataByIdentifier Service");
	SendDiag_Request_Verify_Response_Length(DiagAnchor3,"22 FE D8",4);
  TestCaseComment("Postcondition");
	TestStep("7","Send request 10 01 to enter default diagnostic session");
	SendDiag_Request_Verify_Response(DiagAnchor3,"10 01","50 01 00 32 01 F4");
}



testcase TCS_PK_FCA_AnchorUDSServer_ReadDataByIdentifier_DIDFED8_AnchorTeachType_ExtendedSession_61SecurityLevel_54553()
{
	testCaseComment("Precondition");
	TestStep("1","Send TesterPresent 3E 00 every 4000ms");
	SendDiag_Request_Verify_Response(DiagAnchor3,"3E 00","7E 00");
	TestStep("2","Send request 10 01 to enter default diagnostic session");
	SendDiag_Request_Verify_Response(DiagAnchor3,"10 01","50 01 00 32 01 F4");
  testCaseComment("Actions");
  TestStep("3","Send request 10 03 to enter Extended Diagnostic Session");
	SendDiag_Request_Verify_Response(DiagAnchor3,"10 03","50 03 00 32 01 F4");
  TestStep("4,5","Send Security Seed Request 61 and Key 62 in DiagAnchor");  
  Security_Seed_Key_Access(Anch3,Physical,Bosch);
  TestStep("6","Send 22 FE D8 to request ReadDataByIdentifier Service");
	SendDiag_Request_Verify_Response_Length(DiagAnchor3,"22 FE D8",4);
  TestCaseComment("Postcondition");
	TestStep("7","Send request 10 01 to enter default diagnostic session");
	SendDiag_Request_Verify_Response(DiagAnchor3,"10 01","50 01 00 32 01 F4");
}



testcase TCS_PK_FCA_AnchorUDSServer_ReadDataByIdentifier_DIDFED8_AnchorTeachType_ExtendedSession_NoSecurityLevel_54554()
{
	testCaseComment("Precondition");
	TestStep("1","Send TesterPresent 3E 00 every 4000ms");
	SendDiag_Request_Verify_Response(DiagAnchor3,"3E 00","7E 00");
	TestStep("2","Send request 10 01 to enter default diagnostic session");
	SendDiag_Request_Verify_Response(DiagAnchor3,"10 01","50 01 00 32 01 F4");
  testCaseComment("Actions");
  TestStep("3","Send request 10 03 to enter Extended Diagnostic Session");
	SendDiag_Request_Verify_Response(DiagAnchor3,"10 03","50 03 00 32 01 F4");
  TestStep("4","Send 22 FE D8 to request ReadDataByIdentifier Service");
	SendDiag_Request_Verify_Response_Length(DiagAnchor3,"22 FE D8",4);
  TestCaseComment("Postcondition");
	TestStep("5","Send request 10 01 to enter default diagnostic session");
	SendDiag_Request_Verify_Response(DiagAnchor3,"10 01","50 01 00 32 01 F4");
}



testcase TCS_PK_FCA_AnchorUDSServer_ReadDataByIdentifier_DIDFED9_PositionIdx_ExtendedSession_0x61SecurityLevel_54552()
{
	testCaseComment("Precondition");
	TestStep("1","Send TesterPresent 3E 00 every 4000ms");
	SendDiag_Request_Verify_Response(DiagAnchor3,"3E 00","7E 00");
	TestStep("2","Send request 10 01 to enter default diagnostic session");
	SendDiag_Request_Verify_Response(DiagAnchor3,"10 01","50 01 00 32 01 F4");
  testCaseComment("Actions");
  TestStep("3","Send request 10 03 to enter Extended Diagnostic Session");
	SendDiag_Request_Verify_Response(DiagAnchor3,"10 03","50 03 00 32 01 F4");
  TestStep("4,5","Send Security Seed Request 61 and Key 62 in DiagAnchor");  
  Security_Seed_Key_Access(Anch3,Physical,Bosch);
  TestStep("6","Send 22 FE D9 to request ReadDataByIdentifier Service");
	SendDiag_Request_Verify_Response(DiagAnchor3,"22 FE D9","62 FE D9 00");
  TestCaseComment("Postcondition");
	TestStep("7","Send request 10 01 to enter default diagnostic session");
	SendDiag_Request_Verify_Response(DiagAnchor3,"10 01","50 01 00 32 01 F4");
}


testcase TCS_PK_FCA_AnchorUDSServer_ReadDataByIdentifier_DIDFED9_PositionIdx_ExtendedSession_0x65SecurityLevel_54556()
{
	testCaseComment("Precondition");
	TestStep("1","Send TesterPresent 3E 00 every 4000ms");
	SendDiag_Request_Verify_Response(DiagAnchor3,"3E 00","7E 00");
	TestStep("2","Send request 10 01 to enter default diagnostic session");
	SendDiag_Request_Verify_Response(DiagAnchor3,"10 01","50 01 00 32 01 F4");
  testCaseComment("Actions");
  TestStep("3","Send request 10 03 to enter Extended Diagnostic Session");
	SendDiag_Request_Verify_Response(DiagAnchor3,"10 03","50 03 00 32 01 F4");
  TestStep("4,5","Send Security Seed Request 65 and Key 66 in DiagAnchor");  
  Security_Seed_Key_Access(Anch3,Physical,Incar_1);
  TestStep("6","Send 22 FE D9 to request ReadDataByIdentifier Service");
	SendDiag_Request_Verify_Response(DiagAnchor3,"22 FE D9","62 FE D9 00");
  TestCaseComment("Postcondition");
	TestStep("7","Send request 10 01 to enter default diagnostic session");
	SendDiag_Request_Verify_Response(DiagAnchor3,"10 01","50 01 00 32 01 F4");
}



testcase TCS_PK_FCA_AnchorUDSServer_ReadDataByIdentifier_DIDFED9_PositionIdx_ExtendedSession_NoSecurityLevel_54557()
{
	testCaseComment("Precondition");
	TestStep("1","Send TesterPresent 3E 00 every 4000ms");
	SendDiag_Request_Verify_Response(DiagAnchor3,"3E 00","7E 00");
	TestStep("2","Send request 10 01 to enter default diagnostic session");
	SendDiag_Request_Verify_Response(DiagAnchor3,"10 01","50 01 00 32 01 F4");
  testCaseComment("Actions");
  TestStep("3","Send request 10 03 to enter Extended Diagnostic Session");
	SendDiag_Request_Verify_Response(DiagAnchor3,"10 03","50 03 00 32 01 F4");
  TestStep("4","Send 22 FE D9 to request ReadDataByIdentifier Service");
	SendDiag_Request_Verify_Response(DiagAnchor3,"22 FE D9","62 FE D9 00");
  TestCaseComment("Postcondition");
	TestStep("5","Send request 10 01 to enter default diagnostic session");
	SendDiag_Request_Verify_Response(DiagAnchor3,"10 01","50 01 00 32 01 F4");
}



testcase TCS_PK_FCA_AnchorUDSServer_ReadDataByIdentifier_DIDFEE0_ECUCompatibilityNumber_ExtendedSession_0x61SecurityLevel_54555()
{
	testCaseComment("Precondition");
	TestStep("1","Send TesterPresent 3E 00 every 4000ms");
	SendDiag_Request_Verify_Response(DiagAnchor3,"3E 00","7E 00");
	TestStep("2","Send request 10 01 to enter default diagnostic session");
	SendDiag_Request_Verify_Response(DiagAnchor3,"10 01","50 01 00 32 01 F4");
  testCaseComment("Actions");
  TestStep("3","Send request 10 03 to enter Extended Diagnostic Session");
	SendDiag_Request_Verify_Response(DiagAnchor3,"10 03","50 03 00 32 01 F4");
  TestStep("4,5","Send Security Seed Request 61 and Key 62 in DiagAnchor");  
  Security_Seed_Key_Access(Anch3,Physical,Bosch);
  TestStep("6","Send 22 FE E0 to request ReadDataByIdentifier Service");
	SendDiag_Request_Verify_Response(DiagAnchor3,"22 FE E0","62 FE E0 05 01 01 05 01 01");
  TestCaseComment("Postcondition");
	TestStep("7","Send request 10 01 to enter default diagnostic session");
	SendDiag_Request_Verify_Response(DiagAnchor3,"10 01","50 01 00 32 01 F4");
}


testcase TCS_PK_FCA_AnchorUDSServer_ReadDataByIdentifier_DIDFEE0_ECUCompatibilityNumber_ExtendedSession_0x65SecurityLevel_54564()
{
	testCaseComment("Precondition");
	TestStep("1","Send TesterPresent 3E 00 every 4000ms");
	SendDiag_Request_Verify_Response(DiagAnchor3,"3E 00","7E 00");
	TestStep("2","Send request 10 01 to enter default diagnostic session");
	SendDiag_Request_Verify_Response(DiagAnchor3,"10 01","50 01 00 32 01 F4");
  testCaseComment("Actions");
  TestStep("3","Send request 10 03 to enter Extended Diagnostic Session");
	SendDiag_Request_Verify_Response(DiagAnchor3,"10 03","50 03 00 32 01 F4");
  TestStep("4,5","Send Security Seed Request 65 and Key 66 in DiagAnchor");  
  Security_Seed_Key_Access(Anch3,Physical,Incar_1);
  TestStep("6","Send 22 FE E0 to request ReadDataByIdentifier Service");
	SendDiag_Request_Verify_Response(DiagAnchor3,"22 FE E0","62 FE E0 05 01 01 05 01 01");
  TestCaseComment("Postcondition");
	TestStep("7","Send request 10 01 to enter default diagnostic session");
	SendDiag_Request_Verify_Response(DiagAnchor3,"10 01","50 01 00 32 01 F4");
}



testcase TCS_PK_FCA_AnchorUDSServer_ReadDataByIdentifier_DIDFEE0_ECUCompatibilityNumber_ExtendedSession_NoSecurityLevel_54565()
{
	testCaseComment("Precondition");
	TestStep("1","Send TesterPresent 3E 00 every 4000ms");
	SendDiag_Request_Verify_Response(DiagAnchor3,"3E 00","7E 00");
	TestStep("2","Send request 10 01 to enter default diagnostic session");
	SendDiag_Request_Verify_Response(DiagAnchor3,"10 01","50 01 00 32 01 F4");
  testCaseComment("Actions");
  TestStep("3","Send request 10 03 to enter Extended Diagnostic Session");
	SendDiag_Request_Verify_Response(DiagAnchor3,"10 03","50 03 00 32 01 F4");
  TestStep("4","Send 22 FE E0 to request ReadDataByIdentifier Service");
	SendDiag_Request_Verify_Response(DiagAnchor3,"22 FE E0","62 FE E0 05 01 01 05 01 01");
  TestCaseComment("Postcondition");
	TestStep("5","Send request 10 01 to enter default diagnostic session");
	SendDiag_Request_Verify_Response(DiagAnchor3,"10 01","50 01 00 32 01 F4");
}



testcase TCS_PK_FCA_AnchorUDSServer_ReadDataByIdentifier_DIDFEE1_ECUChipVersions_ExtendedSession_0x65SecurityLevel_54562()
{
	testCaseComment("Precondition");
	TestStep("1","Send TesterPresent 3E 00 every 4000ms");
	SendDiag_Request_Verify_Response(DiagAnchor3,"3E 00","7E 00");
	TestStep("2","Send request 10 01 to enter default diagnostic session");
	SendDiag_Request_Verify_Response(DiagAnchor3,"10 01","50 01 00 32 01 F4");
  testCaseComment("Actions");
  TestStep("3","Send request 10 03 to enter Extended Diagnostic Session");
	SendDiag_Request_Verify_Response(DiagAnchor3,"10 03","50 03 00 32 01 F4");
  TestStep("4,5","Send Security Seed Request 65 and Key 66 in DiagAnchor");  
  Security_Seed_Key_Access(Anch3,Physical,Incar_1);
  TestStep("6","Send 22 FE E1 to request ReadDataByIdentifier Service");
	SendDiag_Request_Verify_Response(DiagAnchor3,"22 FE E1","62 FE E1");
  TestCaseComment("Postcondition");
	TestStep("7","Send request 10 01 to enter default diagnostic session");
	SendDiag_Request_Verify_Response(DiagAnchor3,"10 01","50 01 00 32 01 F4");
}


testcase TCS_PK_FCA_SYS_AnchorUDSServer_ReadDataByIdentifier_DIDFE26_R4AppSignature_Fbl_ExtendedSession_0x61SecurityLevel_63712()
{
	testCaseComment("Precondition");
	TestStep("1","Send TesterPresent 3E 00 every 4000ms");
	SendDiag_Request_Verify_Response(DiagAnchor3,"3E 00","7E 00");
	TestStep("2","Send request 10 01 to enter default diagnostic session");
	SendDiag_Request_Verify_Response(DiagAnchor3,"10 01","50 01 00 32 01 F4");
  testCaseComment("Actions");
  TestStep("3","Send request 10 03 to enter Extended Diagnostic Session");
	SendDiag_Request_Verify_Response(DiagAnchor3,"10 03","50 03 00 32 01 F4");
  TestStep("4,5","Send Security Seed Request 61 and Key 62 in DiagAnchor");  
  Security_Seed_Key_Access(Anch3,Physical,Bosch);
  TestStep("6","Send 22 FE 26 to request ReadDataByIdentifier Service");
	SendDiag_Request_Verify_Response_Length(DiagAnchor3,"22 FE 26",68);
  TestCaseComment("Postcondition");
	TestStep("7","Send request 10 01 to enter default diagnostic session");
	SendDiag_Request_Verify_Response(DiagAnchor3,"10 01","50 01 00 32 01 F4");
}


testcase TCS_PK_FCA_SYS_AnchorUDSServer_ReadDataByIdentifier_DIDFE27_R4DspSignature_Fbl_ExtendedSession_0x61SecurityLevel_63713()
{
	testCaseComment("Precondition");
	TestStep("1","Send TesterPresent 3E 00 every 4000ms");
	SendDiag_Request_Verify_Response(DiagAnchor3,"3E 00","7E 00");
	TestStep("2","Send request 10 01 to enter default diagnostic session");
	SendDiag_Request_Verify_Response(DiagAnchor3,"10 01","50 01 00 32 01 F4");
  testCaseComment("Actions");
  TestStep("3","Send request 10 03 to enter Extended Diagnostic Session");
	SendDiag_Request_Verify_Response(DiagAnchor3,"10 03","50 03 00 32 01 F4");
  TestStep("4,5","Send Security Seed Request 61 and Key 62 in DiagAnchor");  
  Security_Seed_Key_Access(Anch3,Physical,Bosch);
  TestStep("6","Send 22 FE 27 to request ReadDataByIdentifier Service");
	SendDiag_Request_Verify_Response_Length(DiagAnchor3,"22 FE 27",68);
  TestCaseComment("Postcondition");
	TestStep("7","Send request 10 01 to enter default diagnostic session");
	SendDiag_Request_Verify_Response(DiagAnchor3,"10 01","50 01 00 32 01 F4");
}


testcase TCS_PK_FCA_SYS_AnchorUDSServer_ReadDataByIdentifier_DIDFEE1_ECUChipVersions_ExtendedSession_0x61SecurityLevel_63710()
{
	testCaseComment("Precondition");
	TestStep("1","Send TesterPresent 3E 00 every 4000ms");
	SendDiag_Request_Verify_Response(DiagAnchor3,"3E 00","7E 00");
	TestStep("2","Send request 10 01 to enter default diagnostic session");
	SendDiag_Request_Verify_Response(DiagAnchor3,"10 01","50 01 00 32 01 F4");
  testCaseComment("Actions");
  TestStep("3","Send request 10 03 to enter Extended Diagnostic Session");
	SendDiag_Request_Verify_Response(DiagAnchor3,"10 03","50 03 00 32 01 F4");
  TestStep("4,5","Send Security Seed Request 61 and Key 62 in DiagAnchor");  
  Security_Seed_Key_Access(Anch3,Physical,Bosch);
  TestStep("6","Send 22 FE E1 to request ReadDataByIdentifier Service");
	SendDiag_Request_Verify_Response(DiagAnchor3,"22 FE 27","62 FE E1");
  TestCaseComment("Postcondition");
	TestStep("7","Send request 10 01 to enter default diagnostic session");
	SendDiag_Request_Verify_Response(DiagAnchor3,"10 01","50 01 00 32 01 F4");
}


testcase TCS_PK_FCA_SYS_AnchorUDSServer_ReadDataByIdentifier_DIDFE09_PrimaryChipLifeCycle_App_ExtendedSession_0x61SecurityLevel_63734()
{
	testCaseComment("Precondition");
	TestStep("1","Send TesterPresent 3E 00 every 4000ms");
	SendDiag_Request_Verify_Response(DiagAnchor3,"3E 00","7E 00");
	TestStep("2","Send request 10 01 to enter default diagnostic session");
	SendDiag_Request_Verify_Response(DiagAnchor3,"10 01","50 01 00 32 01 F4");
  testCaseComment("Actions");
  TestStep("3","Send request 10 03 to enter Extended Diagnostic Session");
	SendDiag_Request_Verify_Response(DiagAnchor3,"10 03","50 03 00 32 01 F4");
  TestStep("4,5","Send Security Seed Request 61 and Key 62 in DiagAnchor");  
  Security_Seed_Key_Access(Anch3,Physical,Bosch);
  TestStep("6","Send 22 FE 09 to request ReadDataByIdentifier Service");
	SendDiag_Request_Verify_Response(DiagAnchor3,"22 FE 09","62 FE 09 02");
  TestCaseComment("Postcondition");
	TestStep("7","Send request 10 01 to enter default diagnostic session");
	SendDiag_Request_Verify_Response(DiagAnchor3,"10 01","50 01 00 32 01 F4");
}


testcase TCS_PK_FCA_SYS_AnchorUDSServer_ReadDataByIdentifier_DIDFE19_UWBChipLifeCycle_App_ExtendedSession_0x61SecurityLevel_63735()
{
	testCaseComment("Precondition");
	TestStep("1","Send TesterPresent 3E 00 every 4000ms");
	SendDiag_Request_Verify_Response(DiagAnchor3,"3E 00","7E 00");
	TestStep("2","Send request 10 01 to enter default diagnostic session");
	SendDiag_Request_Verify_Response(DiagAnchor3,"10 01","50 01 00 32 01 F4");
  testCaseComment("Actions");
  TestStep("3","Send request 10 03 to enter Extended Diagnostic Session");
	SendDiag_Request_Verify_Response(DiagAnchor3,"10 03","50 03 00 32 01 F4");
  TestStep("4,5","Send Security Seed Request 61 and Key 62 in DiagAnchor");  
  Security_Seed_Key_Access(Anch3,Physical,Bosch);
  TestStep("6","Send 22 FE 19 to request ReadDataByIdentifier Service");
	SendDiag_Request_Verify_Response(DiagAnchor3,"22 FE 09","62 FE 19 02");
  TestCaseComment("Postcondition");
	TestStep("7","Send request 10 01 to enter default diagnostic session");
	SendDiag_Request_Verify_Response(DiagAnchor3,"10 01","50 01 00 32 01 F4");
}


testcase TCS_PK_FCA_AnchorUDSServer_ReadDataByIdentifier_DIDFE05_TimeSinceResetUWB_App_ExtendedSession_0x61SecurityLevel_63736()
{
	testCaseComment("Precondition");
	TestStep("1","Send TesterPresent 3E 00 every 4000ms");
	SendDiag_Request_Verify_Response(DiagAnchor3,"3E 00","7E 00");
	TestStep("2","Send request 10 01 to enter default diagnostic session");
	SendDiag_Request_Verify_Response(DiagAnchor3,"10 01","50 01 00 32 01 F4");
  testCaseComment("Actions");
  TestStep("3","Send request 11 01 to enter hard reset");
	SendDiag_Request_Verify_Response(DiagAnchor3,"11 01","51 01");
  TestStep("4","Send request 10 01 to enter default diagnostic session");
	SendDiag_Request_Verify_Response(DiagAnchor3,"10 01","50 01 00 32 01 F4");
  TestStep("5","Send request 10 03 to enter Extended Diagnostic Session");
	SendDiag_Request_Verify_Response(DiagAnchor3,"10 03","50 03 00 32 01 F4");
  TestStep("6,7","Send Security Seed Request 61 and Key 62 in DiagAnchor");  
  Security_Seed_Key_Access(Anch3,Physical,Bosch);
  TestStep("8","Send 22 FE 05 to request ReadDataByIdentifier Service");
	SendDiag_Request_Verify_Response_Length(DiagAnchor3,"22 FE 05",7);
  TestCaseComment("Postcondition");
	TestStep("9","Send request 10 01 to enter default diagnostic session");
	SendDiag_Request_Verify_Response(DiagAnchor3,"10 01","50 01 00 32 01 F4");
}


testcase TCS_PK_FCA_SYS_AnchorUDSServer_ReadDataByIdentifier_DIDFE61_BoschECUSerialNumber_64259()
{
	testCaseComment("Precondition");
	TestStep("1","Send TesterPresent 3E 00 every 4000ms");
	SendDiag_Request_Verify_Response(DiagAnchor3,"3E 00","7E 00");
	TestStep("2","Send request 10 01 to enter default diagnostic session");
	SendDiag_Request_Verify_Response(DiagAnchor3,"10 01","50 01 00 32 01 F4");
  testCaseComment("Actions");
  TestStep("3","Send 22 FE 61 to request ReadDataByIdentifier Service");
	SendDiag_Request_Verify_Response_Length(DiagAnchor3,"22 FE 61",35);
  TestStep("4","Send request 10 03 to enter Extended Diagnostic Session");
	SendDiag_Request_Verify_Response(DiagAnchor3,"10 03","50 03 00 32 01 F4");
  TestStep("5","Send 22 FE 61 to request ReadDataByIdentifier Service");
	SendDiag_Request_Verify_Response_Length(DiagAnchor3,"22 FE 61",35);
  TestStep("6,7","Send Security Seed Request 61 and Key 62 in DiagAnchor");  
  Security_Seed_Key_Access(Anch3,Physical,Bosch);
  TestStep("8","Send request 10 02 to enter Programming Diagnostic Session");
	SendDiag_Request_Verify_Response(DiagAnchor3,"10 02","50 02 00 32 01 F4");
  TestStep("9","Send 22 FE 61 to request ReadDataByIdentifier Service");
	SendDiag_Request_Verify_Response_Length(DiagAnchor3,"22 FE 61",35);
  TestCaseComment("Postcondition");
	TestStep("10","Send request 10 01 to enter default diagnostic session");
	SendDiag_Request_Verify_Response(DiagAnchor3,"10 01","50 01 00 32 01 F4");
}


/////////////////////////////Anchor_WriteDataByIdentifer_Pos///////////////////////////////////


 testcase TCS_PK_FCA_AnchorUDSServer_WriteDataByIdentifier_DIDFE03_BLEAddress_ExtendedSession_0x61SecurityLevel_35979()
{
	testCaseComment("Precondition");
	TestStep("1","Send TesterPresent 3E 00 every 4000ms");
	SendDiag_Request_Verify_Response(DiagAnchor3,"3E 00","7E 00");
  TestStep("2","Send request 10 01 to enter default diagnostic session");
	SendDiag_Request_Verify_Response(DiagAnchor3,"10 01","50 01 00 32 01 F4");
  testCaseComment("Actions");
  TestStep("3","Send request 10 03 to enter Extended Diagnostic Session");
	SendDiag_Request_Verify_Response(DiagAnchor3,"10 03","50 03 00 32 01 F4");
  TestStep("4,5","Send security unlock request 61 and 62");   
  Security_Seed_Key_Access(Anch3,Physical,Bosch);
  TestStep("6","Send request 2E FE 03 C0 00 00 00 00 01 to Write BLE Address");
  SendDiag_Request_Verify_Response(DiagAnchor3,"2E FE 03 C0 00 00 00 00 01","6E FE 03");
  TestStep("7","Send request 22 FE 03 to Read BLE Address");
  SendDiag_Request_Verify_Response(DiagAnchor3,"22 FE 03","62 FE 03 C0 00 00 00 00 01");
  TestStep("8","Send request 2E FE 03 DD DD DD DD DD DD to Write BLE Address");
  SendDiag_Request_Verify_Response(DiagAnchor3,"2E FE 03 DD DD DD DD DD DD","6E FE 03");
  TestStep("9","Send request 22 FE 03 to Read BLE Address");
  SendDiag_Request_Verify_Response(DiagAnchor3,"22 FE 03","62 FE 03 DD DD DD DD DD DD");
  TestStep("10","Send request 2E FE 03 FF FF FF FF FF FE to Write BLE Address");
  SendDiag_Request_Verify_Response(DiagAnchor3,"2E FE 03 FF FF FF FF FF FE","6E FE 03");
  TestStep("11","Send request 22 FE 03 to Read BLE Address");
  SendDiag_Request_Verify_Response(DiagAnchor3,"22 FE 03","62 FE 03 FF FF FF FF FF FE");
  TestCaseComment("Postcondition");
  TestStep("12","Send request 10 01 to enter default diagnostic session");
	SendDiag_Request_Verify_Response(DiagAnchor3,"10 01","50 01 00 32 01 F4");
  TestStep("13","Stop TesterPresent 3E 00");
	SendDiag_Request_Verify_Response(DiagAnchor3,"3E 00","7E 00");
}



testcase TCS_PK_FCA_AnchorUDSServer_WriteDataByIdentifier_DIDFE04_BoschEOLLock_ExtendedSession_0x61SecurityLevel_35991()
{
	testCaseComment("Precondition");
	TestStep("1","Send TesterPresent 3E 00 every 4000ms");
  SendDiag_Request_Verify_Response(DiagAnchor3,"3E 00","7E 00");
  TestStep("2","Send request 10 01 to enter default diagnostic session");
	SendDiag_Request_Verify_Response(DiagAnchor3,"10 01","50 01 00 32 01 F4");
  testCaseComment("Actions");
  TestStep("3","Send request 10 03 to enter Extended Diagnostic Session");
	SendDiag_Request_Verify_Response(DiagAnchor3,"10 03","50 03 00 32 01 F4");
  TestStep("4,5","Send security unlock request 61 and 62");   
  Security_Seed_Key_Access(Anch3,Physical,Bosch);
  TestStep("6","Send request 2E FE 04 00 to Write BoschEOLLock");
  SendDiag_Request_Verify_Response(DiagAnchor3,"2E FE 04 00","6E FE 04");
  TestStep("7","Send request 22 FE 04 to Read BoschEOLLock");
  SendDiag_Request_Verify_Response(DiagAnchor3,"22 FE 04","62 FE 04 00");
  TestStep("8","Send request 2E FE 04 01 to Write BoschEOLLock");
  SendDiag_Request_Verify_Response(DiagAnchor3,"2E FE 04 01","6E FE 04");
  TestStep("9","Send request 22 FE 04 to Read BoschEOLLock");
  SendDiag_Request_Verify_Response(DiagAnchor3,"22 FE 04","62 FE 04 01");
  TestCaseComment("Postcondition");
  TestStep("10","Send request 10 01 to enter default diagnostic session");
	SendDiag_Request_Verify_Response(DiagAnchor3,"10 01","50 01 00 32 01 F4");
  TestStep("11","Stop TesterPresent 3E 00");
	SendDiag_Request_Verify_Response(DiagAnchor3,"3E 00","7E 00");

}


testcase TCS_PK_FCA_AnchorUDSServer_WriteDataByIdentifier_DIDFE0B_R4ExtUwbDiag_ExtendedSession_0x61SecurityLevel_35997()
{
	testCaseComment("Precondition");
	TestStep("1","Send TesterPresent 3E 00 every 4000ms");
	      SendDiag_Request_Verify_Response(DiagAnchor3,"3E 00","7E 00");
       	TestStep("2","Send request 10 01 to enter default diagnostic session");
	      SendDiag_Request_Verify_Response(DiagAnchor3,"10 01","50 01 00 32 01 F4");
  testCaseComment("Actions");
  TestStep("3","Send request 10 03 to enter Extended Diagnostic Session");
	SendDiag_Request_Verify_Response(DiagAnchor3,"10 03","50 03 00 32 01 F4");
  TestStep("4,5","Send security unlock request 61 and 62");   
       	Security_Seed_Key_Access(Anch3,Physical,Bosch);
  TestStep("6","Send request 2E FE 0B 01 01 01 01 01 01 01 01 04 00 04 00 to Write R4ExtUwb");
        SendDiag_Request_Verify_Response(DiagAnchor3,"2E FE 0B 01 01 01 01 01 01 01 01 04 00 04 00","6E FE 0B");
  TestStep("7","Send request 22 FE 0B to Read R4ExtUwb");
        SendDiag_Request_Verify_Response(DiagAnchor3,"22 FE 0B","62 FE 0B 01 01 01 01 01 01 01 01 04 00 04 00");
  TestStep("8","Send request 2E FE 0B 00 00 00 00 00 00 00 00 00 00 00 00 to Write R4ExtUwb");
        SendDiag_Request_Verify_Response(DiagAnchor3,"2E FE 0B 00 00 00 00 00 00 00 00 00 00 00 00","6E FE 0B");
  TestStep("9","Send request 22 FE 0B to Read R4ExtUwb");
        SendDiag_Request_Verify_Response(DiagAnchor3,"22 FE 0B","62 FE 0B 00 00 00 00 00 00 00 00 00 00 00 00");
  TestStep("10","Send request 2E FE 0B 00 00 00 00 00 00 00 00 00 56 00 14 to Write R4ExtUwb");
        SendDiag_Request_Verify_Response(DiagAnchor3,"2E FE 0B 00 00 00 00 00 00 00 00 00 56 00 14","6E FE 0B");
  TestStep("11","Send request 22 FE 0B to Read R4ExtUwb");
        SendDiag_Request_Verify_Response(DiagAnchor3,"22 FE 0B","62 FE 0B 00 00 00 00 00 00 00 00 00 56 00 14");
  TestCaseComment("Postcondition");
  TestStep("12","Send request 10 01 to enter default diagnostic session");
	SendDiag_Request_Verify_Response(DiagAnchor3,"10 01","50 01 00 32 01 F4");
  TestStep("13","Stop TesterPresent 3E 00");
	      SendDiag_Request_Verify_Response(DiagAnchor3,"3E 00","7E 00");

}


testcase TCS_PK_FCA_AnchorUDSServer_WriteDataByIdentifier_DIDFEA1_AnchorIDTestMode_ExtendedSession_0x61SecurityLevel_36028()
{
	testCaseComment("Precondition");
	TestStep("1","Send TesterPresent 3E 00 every 4000ms");
	      SendDiag_Request_Verify_Response(DiagAnchor3,"3E 00","7E 00");
       	TestStep("2","Send request 10 01 to enter default diagnostic session");
	      SendDiag_Request_Verify_Response(DiagAnchor3,"10 01","50 01 00 32 01 F4");
  testCaseComment("Actions");
  TestStep("3","Send request 10 03 to enter Extended Diagnostic Session");
	SendDiag_Request_Verify_Response(DiagAnchor3,"10 03","50 03 00 32 01 F4");
  TestStep("4,5","Send security unlock request 61 and 62");   
       	Security_Seed_Key_Access(Anch3,Physical,Bosch);
  TestStep("6","Send request 2E FE A1 01 to Write AnchorIDTestMode");
        SendDiag_Request_Verify_Response(DiagAnchor3,"2E FE A1 01","6E FE A1");
  TestStep("7","Send request 22 FE A1 to Read AnchorIDTestMode");
        SendDiag_Request_Verify_Response(DiagAnchor3,"22 FE A1","62 FE A1 01");
  TestStep("8","Send request 2E FE A1 00 to Write AnchorIDTestMode");
        SendDiag_Request_Verify_Response(DiagAnchor3,"2E FE A1 00","6E FE A1");
  TestStep("9","Send request 22 FE A1 to Read AnchorIDTestMode");
        SendDiag_Request_Verify_Response(DiagAnchor3,"22 FE A1","62 FE A1 00");
  TestCaseComment("Postcondition");
  TestStep("10","Send request 10 01 to enter default diagnostic session");
	SendDiag_Request_Verify_Response(DiagAnchor3,"10 01","50 01 00 32 01 F4");
  TestStep("11","Stop TesterPresent 3E 00");
	      SendDiag_Request_Verify_Response(DiagAnchor3,"3E 00","7E 00");
}


testcase TCS_PK_FCA_AnchorUDSServer_WriteDataByIdentifier_DIDFEA4_RFTestMode_ExtendedSession_0x61SecurityLevel_36011()
{
	testCaseComment("Precondition");
	TestStep("1","Send TesterPresent 3E 00 every 4000ms");
	      SendDiag_Request_Verify_Response(DiagAnchor3,"3E 00","7E 00");
       	TestStep("2","Send request 10 01 to enter default diagnostic session");
	      SendDiag_Request_Verify_Response(DiagAnchor3,"10 01","50 01 00 32 01 F4");
  testCaseComment("Actions");
  TestStep("3","Send request 10 03 to enter Extended Diagnostic Session");
	SendDiag_Request_Verify_Response(DiagAnchor3,"10 03","50 03 00 32 01 F4");
  TestStep("4,5","Send security unlock request 61 and 62");   
       	Security_Seed_Key_Access(Anch3,Physical,Bosch);
  TestStep("6","Send request 2E FE A4 01 to Write RFTestMode");
        SendDiag_Request_Verify_Response(DiagAnchor3,"2E FE A4 01","6E FE A4");
  TestStep("7","Send request 22 FE A4 to Read RFTestMode");
        SendDiag_Request_Verify_Response(DiagAnchor3,"22 FE A4","62 FE A4 01");
  TestStep("8","Send request 2E FE A4 00 to Write RFTestMode");
        SendDiag_Request_Verify_Response(DiagAnchor3,"2E FE A4 00","6E FE A4");
  TestStep("9","Send request 22 FE A4 to Read RFTestMode");
        SendDiag_Request_Verify_Response(DiagAnchor3,"22 FE A4","62 FE A4 00");
  TestCaseComment("Postcondition");
  TestStep("10","Send request 10 01 to enter default diagnostic session");
	SendDiag_Request_Verify_Response(DiagAnchor3,"10 01","50 01 00 32 01 F4");
  TestStep("11","Stop TesterPresent 3E 00");
	      SendDiag_Request_Verify_Response(DiagAnchor3,"3E 00","7E 00");
}


testcase TCS_PK_FCA_AnchorUDSServer_WriteDataByIdentifier_DIDFEB0_UWBPropagationDelayCalibration_ExtendedSession_0x61SecurityLevel_36039()
{
	testCaseComment("Precondition");
	TestStep("1","Send TesterPresent 3E 00 every 4000ms");
	      SendDiag_Request_Verify_Response(DiagAnchor3,"3E 00","7E 00");
       	TestStep("2","Send request 10 01 to enter default diagnostic session");
	      SendDiag_Request_Verify_Response(DiagAnchor3,"10 01","50 01 00 32 01 F4");
  testCaseComment("Actions");
  TestStep("3","Send request 10 03 to enter Extended Diagnostic Session");
	SendDiag_Request_Verify_Response(DiagAnchor3,"10 03","50 03 00 32 01 F4");
  TestStep("4,5","Send security unlock request 61 and 62");   
       	Security_Seed_Key_Access(Anch3,Physical,Bosch);
  TestStep("6","Send request 2E FE B0 FF FF FF FF FF FF FF FF FF FF FF FF FF FF FF FF FF FF FF FF FF FF FF FF FF FF FF FF FF FF FF FF FF FF FF FF 01 to Write UWBPropagationDelayCalibration");
        SendDiag_Request_Verify_Response(DiagAnchor3,"2E FE B0 FF FF FF FF FF FF FF FF FF FF FF FF FF FF FF FF FF FF FF FF FF FF FF FF FF FF FF FF FF FF FF FF FF FF FF FF 01","6E FE B0");
  TestStep("7","Send request 22 FE B0 to Read UWBPropagationDelayCalibration");
        SendDiag_Request_Verify_Response(DiagAnchor3,"22 FE B0","62 FE B0 FF FF FF FF FF FF FF FF FF FF FF FF FF FF FF FF FF FF FF FF FF FF FF FF FF FF FF FF FF FF FF FF FF FF FF FF 01");
  TestStep("8","Send request 2E FE B0 AA AA AA AA AA AA AA AA AA AA AA AA AA AA AA AA AA AA AA AA AA AA AA AA AA AA AA AA AA AA AA AA AA AA AA AA 00 to Write UWBPropagationDelayCalibration");
        SendDiag_Request_Verify_Response(DiagAnchor3,"2E FE B0 AA AA AA AA AA AA AA AA AA AA AA AA AA AA AA AA AA AA AA AA AA AA AA AA AA AA AA AA AA AA AA AA AA AA AA AA 00","6E FE B0");
  TestStep("9","Send request 22 FE B0 to Read UWBPropagationDelayCalibration");
        SendDiag_Request_Verify_Response(DiagAnchor3,"22 FE B0","62 FE B0 AA AA AA AA AA AA AA AA AA AA AA AA AA AA AA AA AA AA AA AA AA AA AA AA AA AA AA AA AA AA AA AA AA AA AA AA 00");
  TestStep("10","Send request 2E FE B0 00 00 00 00 00 00 00 00 00 00 00 00 00 00 00 00 00 00 00 00 00 00 00 00 00 00 00 00 00 00 00 00 00 00 00 00 01 to Write UWBPropagationDelayCalibration");
        SendDiag_Request_Verify_Response(DiagAnchor3,"2E FE B0 00 00 00 00 00 00 00 00 00 00 00 00 00 00 00 00 00 00 00 00 00 00 00 00 00 00 00 00 00 00 00 00 00 00 00 00 01","6E FE B0");
  TestStep("11","Send request 22 FE B0 to Read UWBPropagationDelayCalibration");
        SendDiag_Request_Verify_Response(DiagAnchor3,"22 FE B0","62 FE B0 00 00 00 00 00 00 00 00 00 00 00 00 00 00 00 00 00 00 00 00 00 00 00 00 00 00 00 00 00 00 00 00 00 00 00 00 01");
  TestCaseComment("Postcondition");
  TestStep("12","Send request 10 01 to enter default diagnostic session");
	SendDiag_Request_Verify_Response(DiagAnchor3,"10 01","50 01 00 32 01 F4");
  TestStep("13","Stop TesterPresent 3E 00");
	      SendDiag_Request_Verify_Response(DiagAnchor3,"3E 00","7E 00");
}


testcase TCS_PK_FCA_AnchorUDSServer_WriteDataByIdentifier_DIDFEB1_UWBRadioTXPower_ExtendedSession_0x61SecurityLevel_36046()
{
	testCaseComment("Precondition");
	TestStep("1","Send TesterPresent 3E 00 every 4000ms");
	      SendDiag_Request_Verify_Response(DiagAnchor3,"3E 00","7E 00");
       	TestStep("2","Send request 10 01 to enter default diagnostic session");
	      SendDiag_Request_Verify_Response(DiagAnchor3,"10 01","50 01 00 32 01 F4");
  testCaseComment("Actions");
  TestStep("3","Send request 10 03 to enter Extended Diagnostic Session");
	SendDiag_Request_Verify_Response(DiagAnchor3,"10 03","50 03 00 32 01 F4");
  TestStep("4,5","Send security unlock request 61 and 62");   
       	Security_Seed_Key_Access(Anch3,Physical,Bosch);
  TestStep("6","Send request 2E FE B1 40 38 0C 40 38 0C to Write UWBRadioTXPower");
        SendDiag_Request_Verify_Response(DiagAnchor3,"2E FE B1 40 38 0C 40 38 0C 00","6E FE B1");
  TestStep("7","Send request 22 FE B1 to Read UWBRadioTXPower");
        SendDiag_Request_Verify_Response(DiagAnchor3,"22 FE B1","62 FE B1 40 38 0C 40 38 0C 00");
  TestStep("8","Send request 2E FE B1 20 D0 F4 20 D0 F4 to Write UWBRadioTXPower");
        SendDiag_Request_Verify_Response(DiagAnchor3,"2E FE B1 20 D0 F4 20 D0 F4 00","6E FE B1");
  TestStep("9","Send request 22 FE B1 to Read UWBRadioTXPower");
        SendDiag_Request_Verify_Response(DiagAnchor3,"22 FE B1","62 FE B1 20 D0 F4 20 D0 F4 00");
  TestStep("10","Send request 2E FE B1 00 00 00 00 00 00 to Write UWBRadioTXPower");
        SendDiag_Request_Verify_Response(DiagAnchor3,"2E FE B1 00 00 00 00 00 00 00","6E FE B1");
  TestStep("11","Send request 22 FE B1 to Read UWBRadioTXPower");
        SendDiag_Request_Verify_Response(DiagAnchor3,"22 FE B1","62 FE B1 00 00 00 00 00 00 00");
  TestCaseComment("Postcondition");
  TestStep("12","Send request 10 01 to enter default diagnostic session");
	SendDiag_Request_Verify_Response(DiagAnchor3,"10 01","50 01 00 32 01 F4");
  TestStep("13","Stop TesterPresent 3E 00");
	      SendDiag_Request_Verify_Response(DiagAnchor3,"3E 00","7E 00");
}


testcase TCS_PK_FCA_AnchorUDSServer_WriteDataByID_DIDFEB2_UWBCentreFrequencyCalibrationBaseOffset_Extended_0x61SecurityLevel_36052()
{
	testCaseComment("Precondition");
	TestStep("1","Send TesterPresent 3E 00 every 4000ms");
	      SendDiag_Request_Verify_Response(DiagAnchor3,"3E 00","7E 00");
       	TestStep("2","Send request 10 01 to enter default diagnostic session");
	      SendDiag_Request_Verify_Response(DiagAnchor3,"10 01","50 01 00 32 01 F4");
  testCaseComment("Actions");
  TestStep("3","Send request 10 03 to enter Extended Diagnostic Session");
	SendDiag_Request_Verify_Response(DiagAnchor3,"10 03","50 03 00 32 01 F4");
  TestStep("4,5","Send security unlock request 61 and 62");   
       	Security_Seed_Key_Access(Anch3,Physical,Bosch);
  TestStep("6","Send request 2E FE B2 FF FF FF FF to Write UWBCentreFrequencyCalibrationBaseOffset");
        SendDiag_Request_Verify_Response(DiagAnchor3,"2E FE B2 FF FF FF FF","6E FE B2");
  TestStep("7","Send request 22 FE B2 to Read UWBCentreFrequencyCalibrationBaseOffset");
        SendDiag_Request_Verify_Response(DiagAnchor3,"22 FE B2","62 FE B2 FF FF FF FF");
  TestStep("8","Send request 2E FE B2 80 00 80 00 to Write UWBCentreFrequencyCalibrationBaseOffset");
        SendDiag_Request_Verify_Response(DiagAnchor3,"2E FE B2 80 00 80 00","6E FE B2");
  TestStep("9","Send request 22 FE B2 to Read UWBCentreFrequencyCalibrationBaseOffset");
        SendDiag_Request_Verify_Response(DiagAnchor3,"22 FE B2","62 FE B2 80 00 80 00");
  TestStep("10","Send request 2E FE B2 00 00 00 00 to Write UWBCentreFrequencyCalibrationBaseOffset");
        SendDiag_Request_Verify_Response(DiagAnchor3,"2E FE B2 00 00 00 00","6E FE B2");
  TestStep("11","Send request 22 FE B2 to Read UWBCentreFrequencyCalibrationBaseOffset");
        SendDiag_Request_Verify_Response(DiagAnchor3,"22 FE B2","62 FE B2 00 00 00 00");
  TestCaseComment("Postcondition");
  TestStep("12","Send request 10 01 to enter default diagnostic session");
	SendDiag_Request_Verify_Response(DiagAnchor3,"10 01","50 01 00 32 01 F4");
  TestStep("13","Stop TesterPresent 3E 00");
	      SendDiag_Request_Verify_Response(DiagAnchor3,"3E 00","7E 00");
}


testcase TCS_PK_FCA_AnchorUDSServer_WriteDataByIdentifier_DIDFED9_PositionIdx_ExtendedSession_0x61Level_36069()
{
	testCaseComment("Precondition");
	TestStep("1","Send TesterPresent 3E 00 every 4000ms");
	      SendDiag_Request_Verify_Response(DiagAnchor3,"3E 00","7E 00");
       	TestStep("2","Send request 10 01 to enter default diagnostic session");
	      SendDiag_Request_Verify_Response(DiagAnchor3,"10 01","50 01 00 32 01 F4");
  testCaseComment("Actions");
  TestStep("3","Send request 10 03 to enter Extended Diagnostic Session");
	SendDiag_Request_Verify_Response(DiagAnchor3,"10 03","50 03 00 32 01 F4");
  TestStep("4,5","Send security unlock request 61 and 62");   
       	Security_Seed_Key_Access(Anch3,Physical,Bosch);
  TestStep("6","Send request 2E FE D9 01 to Write PositionIdx");
        SendDiag_Request_Verify_Response(DiagAnchor3,"2E FE D9 01","6E FE D9");
  TestStep("7","Send request 22 FE D9 to Read PositionIdx");
        SendDiag_Request_Verify_Response(DiagAnchor3,"22 FE D9","62 FE D9 01");
  TestStep("8","Send request 2E FE D9 00 to Write PositionIdx");
        SendDiag_Request_Verify_Response(DiagAnchor3,"2E FE D9 00","6E FE D9");
  TestStep("9","Send request 22 FE D9 to Read PositionIdx");
        SendDiag_Request_Verify_Response(DiagAnchor3,"22 FE D9","62 FE D9 00");
  TestCaseComment("Postcondition");
  TestStep("12","Send request 10 01 to enter default diagnostic session");
	SendDiag_Request_Verify_Response(DiagAnchor3,"10 01","50 01 00 32 01 F4");
  TestStep("13","Stop TesterPresent 3E 00");
	      SendDiag_Request_Verify_Response(DiagAnchor3,"3E 00","7E 00");
}


/////////////////////////////////Anchor_RoutineControl_Pos/////////////////////////////////


testcase TCS_PK_FCA_AnchorUDSServer_RoutineControl_RIDFA01_BLERxSensitivityTest_ExtendedSession_0x61SecurityLevel_47082()
{
  ///////TestCase needs to be executed only on Combi-Anchor
  testCaseDescription("Description:Verify that positive response messages are returned when valid request messages for each supported SFID are sent for RID 0xFA01");
  testCaseComment("Precondition");
  TestStep("1","Send request 3E 00 to send tester present periodically every 4sec");
  SendTesterPresent();
  TestStep("2","Send request 10 01 to enter Diagnostic Default Session ");
  SendDiag_Request_Verify_Response(DiagAnchor3,"10 01","50 01 00 32 01 F4");
  
  testCaseComment("Test Case Design");
  TestStep("1","Send request 10 03 to enter the diagonistic extended sesssion ");
  SendDiag_Request_Verify_Response(DiagAnchor3,"10 03","50 03 00 32 01 F4");
  TestStep("2,3","Send security unlock request 61 and 62");
  Security_Seed_Key_Access(Anch3,Physical,Bosch);
  TestStep("4","Send 2E FE A4 01 to enable WriteDataIdentifier");
  SendDiag_Request_Verify_Response(DiagAnchor3,"2E FE A4 01","6E FE A4");
  TestStep("5","Send 31 01 FA 01 80 EA CA 80 00 01 01 2C 00 01 to enable routine control request");
  SendDiag_Request_Verify_Response(DiagAnchor3,"31 01 FA 01 80 EA CA 80 00 01 01 2C 00 01","71 01 FA 01 22 22");
  TestStep("6","Send request 31 02 FA 01 to enable Routine control request ");
  SendDiag_Request_Verify_Response(DiagAnchor3,"31 02 FA 01","71 02 FA 01");
  TestStep("7","Send 31 01 FA 01 80 EA CA 80 00 01 01 2C 00 01 to enable routine control request");
  SendDiag_Request_Verify_Response(DiagAnchor3,"31 01 FA 01 80 EA CA 80 00 01 01 2C 00 01","71 01 FA 01 22 22");
  TestStep("8","Send request 31 03 FA 01 to enable Routine control request ");
  SendDiag_Request_Verify_Response(DiagAnchor3,"31 03 FA 01","71 03 FA 01 22 22");
  
  testCaseComment("Post Condition");
  TestStep("1","Send 2E FE A4 00 to disable WriteDataIdentifier");
  SendDiag_Request_Verify_Response(DiagAnchor3,"2E FE A4 00","6E FE A4");
  TestStep("2","Send request 10 01 to enter Diagnostic Default Session");
  SendDiag_Request_Verify_Response(DiagAnchor3,"10 01","50 01 00 32 01 F4");
  TestStep("3","Stop tester present 3E 00");
  StopTesterPresent();
  
 }
 
 
 testcase TCS_PK_FCA_AnchorUDSServer_RoutineControl_RIDFA02_BLETxPowerTest_ExtendedSession_0x61SecurityLevel_47088()
{
    ///////TestCase needs to be executed only on Combi-Anchor
  testCaseDescription("Description:Verify that positive response messages are returned when valid request messages for each supported SFID are sent for RID 0xFA02");
  testCaseComment("Precondition");
  TestStep("1","Send request 3E 00 to send tester present periodically every 4sec");
  SendTesterPresent();
  TestStep("2","Send request 10 01 to enter Diagnostic Default Session ");
  SendDiag_Request_Verify_Response(DiagAnchor3,"10 01","50 01 00 32 01 F4");
  
  testCaseComment("Test Case Design");
  TestStep("1","Send request 10 03 to enter the diagonistic extended sesssion ");
  SendDiag_Request_Verify_Response(DiagAnchor3,"10 03","50 03 00 32 01 F4");
  TestStep("2,3","Send security unlock request 61 and 62");
  Security_Seed_Key_Access(Anch3,Physical,Bosch);
  TestStep("4","Send 2E FE A4 01 to enable WriteDataIdentifier");
  SendDiag_Request_Verify_Response(DiagAnchor3,"2E FE A4 01","6E FE A4");
  TestStep("5","Send 31 01 FA 02 01 00 64 00 01 to enable routine control request");
  SendDiag_Request_Verify_Response(DiagAnchor3,"31 01 FA 02 01 00 64 00 01","71 01 FA 02");
  testWaitForTimeout(1000);
  TestStep("7","Send 31 02 FA 02 to enable Routine control request");
  SendDiag_Request_Verify_Response(DiagAnchor3,"31 02 FA 02","71 02 FA 02");
  TestStep("8","Send 31 01 FA 02 01 00 64 00 01 to enable Routine control request");
  SendDiag_Request_Verify_Response(DiagAnchor3,"31 01 FA 02 01 00 64 00 01","71 01 FA 02");
  
  testCaseComment("Post Condition");
  TestStep("1","Send 2E FE A4 00 to disable WriteDataIdentifier");
  SendDiag_Request_Verify_Response(DiagAnchor3,"2E FE A4 00","6E FE A4");
  TestStep("2","Send request 10 01 to enter Diagnostic Default Session");
  SendDiag_Request_Verify_Response(DiagAnchor3,"10 01","50 01 00 32 01 F4");
  TestStep("3","Stop tester present 3E 00");
  StopTesterPresent();
  
 }


 testcase TCS_PK_FCA_AnchorUDSServer_RoutineControl_RIDFA03_AnchorImcRoundTripTest_ExtendedSession_0x61SecurityLevel_47106()
{

  testCaseDescription("Description:Verify that positive response messages are returned when valid request messages for each supported SFID are sent for RID 0xFA03");
  testCaseComment("Precondition");
  TestStep("1","Send request 3E 00 to send tester present periodically every 4sec");
  SendTesterPresent();
  TestStep("2","Send request 10 01 to enter Diagnostic Default Session ");
  SendDiag_Request_Verify_Response(DiagAnchor3,"10 01","50 01 00 32 01 F4");
  
  testCaseComment("Test Case Design");
  TestStep("1","Send request 10 03 to enter the diagonistic extended sesssion ");
  SendDiag_Request_Verify_Response(DiagAnchor3,"10 03","50 03 00 32 01 F4");
  TestStep("2,3","Send security unlock request 61 and 62");
  Security_Seed_Key_Access(Anch3,Physical,Bosch);
  TestStep("4","Send 2E FE A4 01 to enable WriteDataIdentifier");
  SendDiag_Request_Verify_Response(DiagAnchor3,"2E FE A4 01","6E FE A4");
  TestStep("5","Send 31 01 FA 03 00 10 10 to enable routine control request");
  SendDiag_Request_Verify_Response(DiagAnchor3,"31 01 FA 03 00 10 10","71 01 FA 03");
  testWaitForTimeout(400);
  TestStep("7","Send 31 03 FA 03 to enable Routine control request");
  SendDiag_Request_Verify_Response(DiagAnchor3,"31 03 FA 03","71 03 FA 03 00 10 00 10 00");
  
  testCaseComment("Post Condition");
  TestStep("1","Send 2E FE A4 00 to disable WriteDataIdentifier");
  SendDiag_Request_Verify_Response(DiagAnchor3,"2E FE A4 00","6E FE A4");
  TestStep("2","Send request 10 01 to enter Diagnostic Default Session");
  SendDiag_Request_Verify_Response(DiagAnchor3,"10 01","50 01 00 32 01 F4");
  TestStep("3","Stop tester present 3E 00");
  StopTesterPresent();
  
 }
 
 
 testcase TCS_PK_FCA_AnchorUDSServer_RoutineControl_RIDFA04_BLERSSMeasurement_ExtendedSession_0x61SecurityLevel_47111()
{
////////////TestCase needs to be executed only on Combi-Anchor
  testCaseDescription("Description:Verify that positive response messages are returned when valid request messages for each supported SFID are sent for RID 0xFA04");
  testCaseComment("Precondition");
  TestStep("1","Send request 3E 00 to send tester present periodically every 4sec");
  SendTesterPresent();
  TestStep("2","Send request 10 01 to enter Diagnostic Default Session ");
  SendDiag_Request_Verify_Response(DiagAnchor3,"10 01","50 01 00 32 01 F4");
  
  testCaseComment("Test Case Design");
  TestStep("1","Send request 10 03 to enter the diagonistic extended sesssion ");
  SendDiag_Request_Verify_Response(DiagAnchor3,"10 03","50 03 00 32 01 F4");
  TestStep("2,3","Send security unlock request 61 and 62");
  Security_Seed_Key_Access(Anch3,Physical,Bosch);
  TestStep("4","Send 2E FE A4 01 to enable WriteDataIdentifier");
  SendDiag_Request_Verify_Response(DiagAnchor3,"2E FE A4 01","6E FE A4");
  TestStep("5","Send 31 01 FA 04 01 0B B8 00 02 to enable routine control request");
  SendDiag_Request_Verify_Response(DiagAnchor3,"31 01 FA 04 01 0B B8 00 02","71 01 FA 04");
  testWaitForTimeout(100);
  TestStep("7","Send 31 02 FA 04 to enable Routine control request");
  SendDiag_Request_Verify_Response(DiagAnchor3,"31 02 FA 04","71 02 FA 04");
  
  
  testCaseComment("Post Condition");
  TestStep("1","Send 2E FE A4 00 to disable WriteDataIdentifier");
  SendDiag_Request_Verify_Response(DiagAnchor3,"2E FE A4 00","6E FE A4");
  TestStep("2","Send request 10 01 to enter Diagnostic Default Session");
  SendDiag_Request_Verify_Response(DiagAnchor3,"10 01","50 01 00 32 01 F4");
  TestStep("3","Stop tester present 3E 00");
  StopTesterPresent();
  
 }
 
 testcase TCS_PK_FCA_AnchorUDSServer_RoutineControl_RIDFA05_FastSleep_ExtendedSession_0x61SecurityLevel_47123()
{

  testCaseDescription("Description:Verify that positive response messages are returned when valid request messages for each supported SFID are sent for RID 0xFA01");
  testCaseComment("Precondition");
  TestStep("1","Send request 3E 00 to send tester present periodically every 4sec");
  SendTesterPresent();
  TestStep("2","Send request 10 01 to enter Diagnostic Default Session ");
  SendDiag_Request_Verify_Response(DiagAnchor3,"10 01","50 01 00 32 01 F4");
  
  testCaseComment("Test Case Design");
  TestStep("1","Send request 10 03 to enter the diagonistic extended sesssion ");
  SendDiag_Request_Verify_Response(DiagAnchor3,"10 03","50 03 00 32 01 F4");
  TestStep("2,3","Send security unlock request 61 and 62");
  Security_Seed_Key_Access(Anch3,Physical,Bosch);
  TestStep("4","Send 31 01 FA 05 00 to enable routine control request");
  SendDiag_Request_Verify_Response(DiagAnchor3,"31 01 FA 05 00","71 01 FA 05");
  TestStep("5","Send request 10 03 to enter the diagonistic extended sesssion ");
  SendDiag_Request_Verify_Response(DiagAnchor3,"10 03","50 03 00 32 01 F4");
  TestStep("6,7","Send security unlock request 61 and 62");
  Security_Seed_Key_Access(Anch3,Physical,Bosch);
  TestStep("8","Send 31 01 FA 05 01 to enable Routine control request");
  SendDiag_Request_Verify_Response(DiagAnchor3,"31 01 FA 05 01","71 01 FA 05");
  
  
  testCaseComment("Post Condition");
  TestStep("1","Send request 10 01 to enter Diagnostic Default Session");
  SendDiag_Request_Verify_Response(DiagAnchor3,"10 01","50 01 00 32 01 F4");
  TestStep("2","Stop tester present 3E 00");
  StopTesterPresent();
  
 }
 
 testcase TCS_PK_FCA_AnchorUDSServer_RoutineControl_RIDFA08_uwbFramesTx_ExtendedSession_0x61SecurityLevel_47100()
{

  testCaseDescription("Description:Verify that positive response messages are returned when valid request messages for each supported SFID are sent for RID 0xFA08");
  testCaseComment("Precondition");
  TestStep("1","Send request 3E 00 to send tester present periodically every 4sec");
  SendTesterPresent();
  TestStep("2","Send request 10 01 to enter Diagnostic Default Session ");
  SendDiag_Request_Verify_Response(DiagAnchor3,"10 01","50 01 00 32 01 F4");
  
  testCaseComment("Test Case Design");
  TestStep("1","Send request 10 03 to enter the diagonistic extended sesssion ");
  SendDiag_Request_Verify_Response(DiagAnchor3,"10 03","50 03 00 32 01 F4");
  TestStep("2,3","Send security unlock request 61 and 62");
  Security_Seed_Key_Access(Anch3,Physical,Bosch);
  TestStep("4","Send 2E FE A4 01 to enable WriteDataIdentifier");
  SendDiag_Request_Verify_Response(DiagAnchor3,"2E FE A4 01","6E FE A4");
  TestStep("5","Send 31 01 FA 08 05 00 00 00 00 00 64 0C 12 12 to enable routine control request");
  SendDiag_Request_Verify_Response(DiagAnchor3,"31 01 FA 08 05 00 00 00 00 00 64 0C 12 12","71 01 FA 08 01");
  TestStep("6","Send request 31 02 FA 08 to enable Routine control request ");
  SendDiag_Request_Verify_Response(DiagAnchor3,"31 02 FA 08","71 02 FA 08");
  TestStep("7","Send request 31 01 FA 08 09 00 00 00 00 00 64 0C 12 12 to enable Routine control request");
  SendDiag_Request_Verify_Response(DiagAnchor3,"31 01 FA 08 09 00 00 00 00 00 64 0C 12 12","71 01 FA 08 01");
  TestStep("8","Send request 31 02 FA 08 to enable Routine control request");
  SendDiag_Request_Verify_Response(DiagAnchor3,"31 02 FA 08","71 02 FA 08");
  TestStep("9","Send request 31 01 FA 08 05 00 00 00 00 00 64 0C 12 12 to enable Routine control request");
  SendDiag_Request_Verify_Response(DiagAnchor3,"31 01 FA 08 05 00 00 00 00 00 64 0C 12 12","71 01 FA 08 01");
  testWaitForTimeout(100);
  TestStep("11","Send request 31 03 FA 08 to enable Routine control request");
  SendDiag_Request_Verify_Response(DiagAnchor3,"31 03 FA 08","71 03 FA 08 01");
  TestStep("12","Send request 31 01 FA 08 05 00 00 00 00 00 64 0C 12 12 to enable Routine control request");
  SendDiag_Request_Verify_Response(DiagAnchor3,"31 01 FA 08 05 00 00 00 00 00 64 0C 12 12","71 01 FA 08 01");
  testWaitForTimeout(1000);
  TestStep("14","Send request 31 03 FA 08 to enable Routine control request ");
  SendDiag_Request_Verify_Response(DiagAnchor3,"31 03 FA 08","71 03 FA 08 01");
  
  
  testCaseComment("Post Condition");
  TestStep("1","Send 2E FE A4 00 to enable WriteDataIdentifier");
  SendDiag_Request_Verify_Response(DiagAnchor3,"2E FE A4 00","6E FE A4");
  TestStep("2","Send request 10 01 to enter Diagnostic Default Session");
  SendDiag_Request_Verify_Response(DiagAnchor3,"10 01","50 01 00 32 01 F4");
  TestStep("3","Stop tester present 3E 00");
  StopTesterPresent();
  
 }
 
 testcase TCS_PK_FCA_AnchorUDSServer_RoutineControl_RIDFA09_uwbFramesRx_ExtendedSession_0x61SecurityLevel_47154()
{

  testCaseDescription("Description:Verify that positive response messages are returned when valid request messages for each supported SFID are sent for RID 0xFA09");
  testCaseComment("Precondition");
  TestStep("1","Send request 3E 00 to send tester present periodically every 4sec");
  SendTesterPresent();
  TestStep("2","Send request 10 01 to enter Diagnostic Default Session ");
  SendDiag_Request_Verify_Response(DiagAnchor3,"10 01","50 01 00 32 01 F4");
  
  testCaseComment("Test Case Design");
  TestStep("1","Send request 10 03 to enter the diagonistic extended sesssion ");
  SendDiag_Request_Verify_Response(DiagAnchor3,"10 03","50 03 00 32 01 F4");
  TestStep("2,3","Send security unlock request 61 and 62");
  Security_Seed_Key_Access(Anch3,Physical,Bosch);
  TestStep("4","Send 2E FE A4 01 to enable WriteDataIdentifier");
  SendDiag_Request_Verify_Response(DiagAnchor3,"2E FE A4 01","6E FE A4");
  TestStep("5","Send 31 01 FA 09 0B B8 05 00 64 0C 73 73 to enable routine control request");
  SendDiag_Request_Verify_Response(DiagAnchor3,"31 01 FA 09 0B B8 05 00 64 0C 73 73","71 01 FA 09 00 00 00 00 00 00 00 00");
  TestStep("6","Send request 31 02 FA 09 to enable Routine control request ");
  SendDiag_Request_Verify_Response(DiagAnchor3,"31 02 FA 09","71 02 FA 09");
  TestStep("7","Send request 31 01 FA 09 0B B8 09 00 64 0C 73 73 to enable Routine control request");
  SendDiag_Request_Verify_Response(DiagAnchor3,"31 01 FA 09 0B B8 09 00 64 0C 73 73","71 01 FA 09 00 00 00 00 00 00 00 00");
  TestStep("8","Send request 31 02 FA 09 to enable Routine control request");
  SendDiag_Request_Verify_Response(DiagAnchor3,"31 02 FA 09","71 02 FA 09");
  TestStep("9","Send request 31 01 FA 09 0B B8 05 00 64 0C 73 73 to enable Routine control request");
  SendDiag_Request_Verify_Response(DiagAnchor3,"31 01 FA 09 0B B8 05 00 64 0C 73 73","71 01 FA 09 00 00 00 00 00 00 00 00");
  testWaitForTimeout(300);
  TestStep("11","Send request 31 03 FA 09 to enable Routine control request");
  SendDiag_Request_Verify_Response(DiagAnchor3,"31 03 FA 09","71 03 FA 08 09 00 00 00 00 00 00 00 00");
  TestStep("12","Send request 31 01 FA 09 0B B8 09 00 64 0C 73 73 to enable Routine control request");
  SendDiag_Request_Verify_Response(DiagAnchor3,"31 01 FA 09 0B B8 09 00 64 0C 73 73","71 01 FA 09 00 00 00 00 00 00 00 00");
  testWaitForTimeout(3000);
  TestStep("14","Send request 31 03 FA 09 to enable Routine control request ");
  SendDiag_Request_Verify_Response(DiagAnchor3,"31 03 FA 09","71 03 FA 08 09 00 00 00 00 00 00 00 00");
  
  
  testCaseComment("Post Condition");
  TestStep("1","Send 2E FE A4 00 to enable WriteDataIdentifier");
  SendDiag_Request_Verify_Response(DiagAnchor3,"2E FE A4 00","6E FE A4");
  TestStep("2","Send request 10 01 to enter Diagnostic Default Session");
  SendDiag_Request_Verify_Response(DiagAnchor3,"10 01","50 01 00 32 01 F4");
  TestStep("3","Stop tester present 3E 00");
  StopTesterPresent();
  
 }
 
 
 testcase TCS_PK_FCA_AnchorUDSServer_RoutineControl_RIDFA0A_UWBTxLoopback_ExtendedSession_0x61SecurityLevel_47160()
{

  testCaseDescription("Description:Verify that positive response messages are returned when valid request messages for each supported SFID are sent for RID 0xFA0A");
  testCaseComment("Precondition");
  TestStep("1","Send request 3E 00 to send tester present periodically every 4sec");
  SendTesterPresent();
  TestStep("2","Send request 10 01 to enter Diagnostic Default Session ");
  SendDiag_Request_Verify_Response(DiagAnchor3,"10 01","50 01 00 32 01 F4");
  
  testCaseComment("Test Case Design");
  TestStep("1","Send request 10 03 to enter the diagonistic extended sesssion ");
  SendDiag_Request_Verify_Response(DiagAnchor3,"10 03","50 03 00 32 01 F4");
  TestStep("2,3","Send security unlock request 61 and 62");
  Security_Seed_Key_Access(Anch3,Physical,Bosch);
  TestStep("4","Send 2E FE A4 01 to enable WriteDataIdentifier");
  SendDiag_Request_Verify_Response(DiagAnchor3,"2E FE A4 01","6E FE A4");
  TestStep("5","Send 31 01 FA 0A 00 00 00 05 to enable routine control request");
  SendDiag_Request_Verify_Response(DiagAnchor3,"31 01 FA 0A 00 00 00 05","71 01 FA 0A 00 00 64 00 00 00 00 00 00");
  
  testCaseComment("Post Condition");
  TestStep("1","Send 2E FE A4 00 to enable WriteDataIdentifier");
  SendDiag_Request_Verify_Response(DiagAnchor3,"2E FE A4 00","6E FE A4");
  TestStep("2","Send request 10 01 to enter Diagnostic Default Session");
  SendDiag_Request_Verify_Response(DiagAnchor3,"10 01","50 01 00 32 01 F4");
  TestStep("3","Stop tester present 3E 00");
  StopTesterPresent();
  
 }
 
 testcase TCS_PK_FCA_AnchorUDSServer_RoutineControl_RIDFA0B_CarrierWaveMode_ExtendedSession_0x61SecurityLevel_47142()
{

  testCaseDescription("Description:Verify that positive response messages are returned when valid request messages for each supported SFID are sent for RID 0xFA0B");
  testCaseComment("Precondition");
  TestStep("1","Send request 3E 00 to send tester present periodically every 4sec");
  SendTesterPresent();
  TestStep("2","Send request 10 01 to enter Diagnostic Default Session ");
  SendDiag_Request_Verify_Response(DiagAnchor3,"10 01","50 01 00 32 01 F4");
  
  testCaseComment("Test Case Design");
  TestStep("1","Send request 10 03 to enter the diagonistic extended sesssion ");
  SendDiag_Request_Verify_Response(DiagAnchor3,"10 03","50 03 00 32 01 F4");
  TestStep("2,3","Send security unlock request 61 and 62");
  Security_Seed_Key_Access(Anch3,Physical,Bosch);
  TestStep("4","Send 2E FE A4 01 to enable WriteDataIdentifier");
  SendDiag_Request_Verify_Response(DiagAnchor3,"2E FE A4 01","6E FE A4");
  TestStep("5","Send 31 01 FA 0B 05 00 01 to enable routine control request");
  SendDiag_Request_Verify_Response(DiagAnchor3,"31 01 FA 0B 05 00 01","71 01 FA 0B");
  
  testCaseComment("Post Condition");
  TestStep("1","Send 2E FE A4 00 to enable WriteDataIdentifier");
  SendDiag_Request_Verify_Response(DiagAnchor3,"2E FE A4 00","6E FE A4");
  TestStep("2","Send request 10 01 to enter Diagnostic Default Session");
  SendDiag_Request_Verify_Response(DiagAnchor3,"10 01","50 01 00 32 01 F4");
  TestStep("3","Stop tester present 3E 00");
  StopTesterPresent();
  
 }
 
  testcase TCS_PK_FCA_AnchorUDSServer_RoutineControl_RIDFA10_uwbCyclic_ExtendedSession_0x61SecurityLevel_47172()
{

  testCaseDescription("Description:Verify that positive response messages are returned when valid request messages for each supported SFID are sent for RID 0xFA10");
  testCaseComment("Precondition");
  TestStep("1","Send request 3E 00 to send tester present periodically every 4sec");
  SendTesterPresent();
  TestStep("2","Send request 10 01 to enter Diagnostic Default Session ");
  SendDiag_Request_Verify_Response(DiagAnchor3,"10 01","50 01 00 32 01 F4");
  
  testCaseComment("Test Case Design");
  TestStep("1","Send request 10 03 to enter the diagonistic extended sesssion ");
  SendDiag_Request_Verify_Response(DiagAnchor3,"10 03","50 03 00 32 01 F4");
  TestStep("2,3","Send security unlock request 61 and 62");
  Security_Seed_Key_Access(Anch3,Physical,Bosch);
  TestStep("4","Send 2E FE A4 01 to enable WriteDataIdentifier");
  SendDiag_Request_Verify_Response(DiagAnchor3,"2E FE A4 01","6E FE A4");
  TestStep("5","Send 31 01 FA 10 05 00 FF 00 00 01 06 to enable routine control request");
  SendDiag_Request_Verify_Response(DiagAnchor3,"31 01 FA 10 05 00 FF 00 00 01 06","71 01 FA 10 00 00 00 00 00 00 00 00 00 00 00");
  TestStep("6","Send 31 02 FA 10 to enable routine control request");
  SendDiag_Request_Verify_Response(DiagAnchor3,"31 02 FA 10","71 02 FA 10");
  TestStep("7","Send 31 03 FA 10 to enable routine control request");
  SendDiag_Request_Verify_Response(DiagAnchor3,"31 03 FA 10","71 03 FA 10 00 00 00 00 00 00 00 00 00 00 00");
  
  testCaseComment("Post Condition");
  TestStep("1","Send 2E FE A4 00 to enable WriteDataIdentifier");
  SendDiag_Request_Verify_Response(DiagAnchor3,"2E FE A4 00","6E FE A4");
  TestStep("2","Send request 10 01 to enter Diagnostic Default Session");
  SendDiag_Request_Verify_Response(DiagAnchor3,"10 01","50 01 00 32 01 F4");
  TestStep("3","Stop tester present 3E 00");
  StopTesterPresent();
  
 }
 
 testcase TCS_PK_FCA_AnchorUDSServer_RoutineControl_RIDFA11_Node2NodeRanging_ExtendedSession_0x61SecurityLevel_47184()
{

  testCaseDescription("Description:Verify that positive response messages are returned when valid request messages for each supported SFID are sent for RID 0xFA11");
  testCaseComment("Precondition");
  TestStep("1","Send request 3E 00 to send tester present periodically every 4sec");
  SendTesterPresent();
  TestStep("2","Send request 10 01 to enter Diagnostic Default Session ");
  SendDiag_Request_Verify_Response(DiagAnchor3,"10 01","50 01 00 32 01 F4");
  
  testCaseComment("Test Case Design");
  TestStep("1","Send request 10 03 to enter the diagonistic extended sesssion ");
  SendDiag_Request_Verify_Response(DiagAnchor3,"10 03","50 03 00 32 01 F4");
  TestStep("2,3","Send security unlock request 61 and 62");
  Security_Seed_Key_Access(Anch3,Physical,Bosch);
  TestStep("4","Send 2E FE A4 01 to enable WriteDataIdentifier");
  SendDiag_Request_Verify_Response(DiagAnchor3,"2E FE A4 01","6E FE A4");
  TestStep("5","Send 31 01 FA 11 00 00 00 00 05 09 01 03 to enable routine control request");
  SendDiag_Request_Verify_Response(DiagAnchor3,"31 01 FA 11 00 00 00 00 05 09 01 03","71 01 FA 11");
  TestStep("6","Send 31 02 FA 11 to enable routine control request");
  SendDiag_Request_Verify_Response(DiagAnchor3,"31 02 FA 11","71 02 FA 11");
  
  testCaseComment("Post Condition");
  TestStep("1","Send 2E FE A4 00 to enable WriteDataIdentifier");
  SendDiag_Request_Verify_Response(DiagAnchor3,"2E FE A4 00","6E FE A4");
  TestStep("2","Send request 10 01 to enter Diagnostic Default Session");
  SendDiag_Request_Verify_Response(DiagAnchor3,"10 01","50 01 00 32 01 F4");
  TestStep("3","Stop tester present 3E 00");
  StopTesterPresent();
  
 }
 
 testcase TCS_PK_FCA_AnchorUDSServer_RoutineControl_RIDFA13_UWBTxTest_ExtendedSession_0x61SecurityLevel_47166()
{

  testCaseDescription("Description:Verify that positive response messages are returned when valid request messages for each supported SFID are sent for RID 0xFA13");
  testCaseComment("Precondition");
  TestStep("1","Send request 3E 00 to send tester present periodically every 4sec");
  SendTesterPresent();
  TestStep("2","Send request 10 01 to enter Diagnostic Default Session ");
  SendDiag_Request_Verify_Response(DiagAnchor3,"10 01","50 01 00 32 01 F4");
  
  testCaseComment("Test Case Design");
  TestStep("1","Send request 10 03 to enter the diagonistic extended sesssion ");
  SendDiag_Request_Verify_Response(DiagAnchor3,"10 03","50 03 00 32 01 F4");
  TestStep("2,3","Send security unlock request 61 and 62");
  Security_Seed_Key_Access(Anch3,Physical,Bosch);
  TestStep("4","Send 2E FE A4 01 to enable WriteDataIdentifier");
  SendDiag_Request_Verify_Response(DiagAnchor3,"2E FE A4 01","6E FE A4");
  TestStep("5","Send 31 01 FA 13 00 00 00 09 03 79 01 to enable routine control request");
  SendDiag_Request_Verify_Response(DiagAnchor3,"31 01 FA 13 00 00 00 09 03 79 01","71 01 FA 13");
  TestStep("6","Send 31 02 FA 13 to enable routine control request");
  SendDiag_Request_Verify_Response(DiagAnchor3,"31 02 FA 13","71 02 FA 13");
  
  testCaseComment("Post Condition");
  TestStep("1","Send 2E FE A4 00 to enable WriteDataIdentifier");
  SendDiag_Request_Verify_Response(DiagAnchor3,"2E FE A4 00","6E FE A4");
  TestStep("2","Send request 10 01 to enter Diagnostic Default Session");
  SendDiag_Request_Verify_Response(DiagAnchor3,"10 01","50 01 00 32 01 F4");
  TestStep("3","Stop tester present 3E 00");
  StopTesterPresent();
  
 }
 
 testcase TCS_PK_FCA_AnchorUDSServer_RoutineControl_RIDFB32_GenerateSecureCANInitialisationKeyPair_ExtendedSession_0x61SecurityLevel_47224()
{

  testCaseDescription("Description:Verify that positive response messages are returned when valid request messages for each supported SFID are sent for RID 0xFB32");
  testCaseComment("Precondition");
  TestStep("1","Send request 3E 00 to send tester present periodically every 4sec");
  SendTesterPresent();
  TestStep("2","Send request 10 01 to enter Diagnostic Default Session ");
  SendDiag_Request_Verify_Response(DiagAnchor3,"10 01","50 01 00 32 01 F4");
  
  testCaseComment("Test Case Design");
  TestStep("1","Send request 10 03 to enter the diagonistic extended sesssion ");
  SendDiag_Request_Verify_Response(DiagAnchor3,"10 03","50 03 00 32 01 F4");
  TestStep("2,3","Send security unlock request 61 and 62");
  Security_Seed_Key_Access(Anch3,Physical,Bosch);
  TestStep("4","Send 31 01 FB 32 to enable Routine control request");
  SendDiag_Request_Verify_Response(DiagAnchor3,"31 01 FB 32","71 01 FB 32 00 00 00 00 00 00 00 00 00 00 00 00 00 00 00 00 00 00 00 00 00 00 00 00 00 00 00 00 00 00 00 00 00 00 00 00 00 00 00 00 00 00 00 00 00 00 00 00 00 00 00 00 00 00 00 00 00 00 00 00 00 00 00 00 00 00 00 00 00 00 00 00 00 00 00 00 00 00 00 00 00 00 00 00 00 00 00 00 00 00 00 00 00 00 00 00 00 00 00 00 00 00 00 00 00 00 00 00 00 00 00 00 00 00 00 00 00 00 00 00 00 00 00 00 00 00 00 00 00 00 00");
  TestStep("5,6","Send security unlock request 65 and 66");
  Security_Seed_Key_Access(Anch3,Physical,Incar_1);
  TestStep("7","Send 31 01 FB 32 to enable routine control request");
  SendDiag_Request_Verify_Response(DiagAnchor3,"31 01 FB 32","71 01 FB 32 00 00 00 00 00 00 00 00 00 00 00 00 00 00 00 00 00 00 00 00 00 00 00 00 00 00 00 00 00 00 00 00 00 00 00 00 00 00 00 00 00 00 00 00 00 00 00 00 00 00 00 00 00 00 00 00 00 00 00 00 00 00 00 00 00 00 00 00 00 00 00 00 00 00 00 00 00 00 00 00 00 00 00 00 00 00 00 00 00 00 00 00 00 00 00 00 00 00 00 00 00 00 00 00 00 00 00 00 00 00 00 00 00 00 00 00 00 00 00 00 00 00 00 00 00 00 00 00 00 00 00");
  
  testCaseComment("Post Condition");
  TestStep("1","Send request 10 01 to enter Diagnostic Default Session");
  SendDiag_Request_Verify_Response(DiagAnchor3,"10 01","50 01 00 32 01 F4");
  TestStep("2","Stop tester present 3E 00");
  StopTesterPresent();
  
 }
 
  testcase TCS_PK_FCA_AnchorUDSServer_RoutineControl_RIDFB35_WriteR4CEKCust_ExtendedSession_0x61SecurityLevel_47196()
{

  testCaseDescription("Description:Verify that positive response messages are returned when valid request messages for each supported SFID are sent for RID 0xFB35");
  testCaseComment("Precondition");
  TestStep("1","Send request 3E 00 to send tester present periodically every 4sec");
  SendTesterPresent();
  TestStep("2","Send request 10 01 to enter Diagnostic Default Session ");
  SendDiag_Request_Verify_Response(DiagAnchor3,"10 01","50 01 00 32 01 F4");
  
  testCaseComment("Test Case Design");
  TestStep("1","Send request 10 03 to enter the diagonistic extended sesssion ");
  SendDiag_Request_Verify_Response(DiagAnchor3,"10 03","50 03 00 32 01 F4");
  TestStep("2,3","Send security unlock request 61 and 62");
  Security_Seed_Key_Access(Anch3,Physical,Bosch);
  TestStep("4","Send 31 01 FB 35 XX to enable Routine control request");
  SendDiag_Request_Verify_Response(DiagAnchor3,"31 01 FB 35 9F 8A 18 83 05 E6 FF C0 ED 22 22 3B 5E 27 EC 49","71 01 FB 35 C3 13 EF 52 44 B7 37 DA E5 AC D7 A0 C5 B5 3C B1");
  
  testCaseComment("Post Condition");
  TestStep("1","Send request 10 01 to enter Diagnostic Default Session");
  SendDiag_Request_Verify_Response(DiagAnchor3,"10 01","50 01 00 32 01 F4");
  TestStep("2","Stop tester present 3E 00");
  StopTesterPresent();
  
 }
 
 testcase TCS_PK_FCA_AnchorUDSServer_RoutineControl_RIDFB38_WriteUwbReflashPubKey_ExtendedSession_0x61SecurityLevel_47249()
{

  testCaseDescription("Description:Verify that positive response messages are returned when valid request messages for each supported SFID are sent for RID 0xFB38");
  testCaseComment("Precondition");
  TestStep("1","Send request 3E 00 to send tester present periodically every 4sec");
  SendTesterPresent();
  TestStep("2","Send request 10 01 to enter Diagnostic Default Session ");
  SendDiag_Request_Verify_Response(DiagAnchor3,"10 01","50 01 00 32 01 F4");
  
  testCaseComment("Test Case Design");
  TestStep("1","Send request 10 03 to enter the diagonistic extended sesssion ");
  SendDiag_Request_Verify_Response(DiagAnchor3,"10 03","50 03 00 32 01 F4");
  TestStep("2,3","Send security unlock request 61 and 62");
  Security_Seed_Key_Access(Anch3,Physical,Bosch);
  TestStep("4","Send 31 01 FB 38 XX to enable Routine control request");
  SendDiag_Request_Verify_Response(DiagAnchor3,"31 01 FB 38 00 00 00 00 00 00 00 00 00 00 00 00 00 00 00 00 00 00 00 00 00 00 00 00 00 00 00 00 00 00 00 00 00 00 00 00 00 00 00 00 00 00 00 00 00 00 00 00 00 00 00 00 00 00 00 00 00 00 00 00 00 00 00 00 00","71 01 FB 38 00 00 00 00 00 00 00 00 00 00 00 00 00 00 00 00 00 00 00 00 00 00 00 00 00 00 00 00 00 00 00 00");
  
  testCaseComment("Post Condition");
  TestStep("1","Send request 10 01 to enter Diagnostic Default Session");
  SendDiag_Request_Verify_Response(DiagAnchor3,"10 01","50 01 00 32 01 F4");
  TestStep("2","Stop tester present 3E 00");
  StopTesterPresent();
  
 }
 
 
 testcase TCS_PK_FCA_AnchorUDSServer_RoutineControl_RIDFB40_MasterAnchorPairing1_ExtendedSession_0x65SecurityLevel_47255()
{

  testCaseDescription("Description:Verify that positive response messages are returned when valid request messages for each supported SFID are sent for RID 0xFB40");
  testCaseComment("Precondition");
  TestStep("1","Send request 3E 00 to send tester present periodically every 4sec");
  SendTesterPresent();
  TestStep("2","Send request 10 01 to enter Diagnostic Default Session ");
  SendDiag_Request_Verify_Response(DiagAnchor3,"10 01","50 01 00 32 01 F4");
  
  testCaseComment("Test Case Design");
  TestStep("1","Send request 10 03 to enter the diagonistic extended sesssion ");
  SendDiag_Request_Verify_Response(DiagAnchor3,"10 03","50 03 00 32 01 F4");
  TestStep("2,3","Send security unlock request 65 and 66");
  Security_Seed_Key_Access(Anch3,Physical,Incar_1);
  TestStep("4","Send 31 01 FB 32 to enable Routine control request");
  SendDiag_Request_Verify_Response(DiagAnchor3,"31 01 FB 32","71 01 FB 32 00 00 00 00 00 00 00 00 00 00 00 00 00 00 00 00 00 00 00 00 00 00 00 00 00 00 00 00 00 00 00 00 00 00 00 00 00 00 00 00 00 00 00 00 00 00 00 00 00 00 00 00 00 00 00 00 00 00 00 00 00 00 00 00 00 00 00 00 00 00 00 00 00 00 00 00 00 00 00 00 00 00 00 00 00 00 00 00 00 00 00 00 00 00 00 00 00 00 00 00 00 00 00 00 00 00 00 00 00 00 00 00 00 00 00 00 00 00 00 00 00 00 00 00 00 00 00 00 00 00 00");
  TestStep("5","Send 31 01 FB 40 XX to enable Routine control request");
  SendDiag_Request_Verify_Response(DiagAnchor3,"31 01 FB 40 00 00 00 00 00 00 00 00 00 00 00 00 00 00 00 00 00 00 00 00 00 00 00 00 00 00 00 00 00 00 00 00 00 00 00 00 00 00 00 00 00 00 00 00 00 00 00 00 00 00 00 00 00 00 00 00 00 00 00 00 00 00 00 00","71 01 FB 40 00 00 00 00 00 00 00 00 00 00 00 00 00 00 00 00 00 00 00 00 00 00 00 00 00 00 00 00 00 00 00 00 00 00 00 00 00 00 00 00 00 00 00 00 00 00 00 00 00 00 00 00 00 00 00 00 00 00 00 00 00 00 00 00");
  
  testCaseComment("Post Condition");
  TestStep("1","Send 2E FE A4 00 to enable WriteDataIdentifier");
  SendDiag_Request_Verify_Response(DiagAnchor3,"2E FE A4 00","6E FE A4");
  TestStep("2","Send request 10 01 to enter Diagnostic Default Session");
  SendDiag_Request_Verify_Response(DiagAnchor3,"10 01","50 01 00 32 01 F4");
  TestStep("3","Stop tester present 3E 00");
  StopTesterPresent();
  
 }
 
 testcase TCS_PK_FCA_AnchorUDSServer_RoutineControl_RIDFB41_MasterAnchorPairing2_ExtendedSession_0x65SecurityLevel_47267()
{

  testCaseDescription("Description:Verify that positive response messages are returned when valid request messages for each supported SFID are sent for RID 0xFB41");
  testCaseComment("Precondition");
  TestStep("1","Send request 3E 00 to send tester present periodically every 4sec");
  SendTesterPresent();
  TestStep("2","Send request 10 01 to enter Diagnostic Default Session ");
  SendDiag_Request_Verify_Response(DiagAnchor3,"10 01","50 01 00 32 01 F4");
  
  testCaseComment("Test Case Design");
  TestStep("1","Send request 10 03 to enter the diagonistic extended sesssion ");
  SendDiag_Request_Verify_Response(DiagAnchor3,"10 03","50 03 00 32 01 F4");
  TestStep("2,3","Send security unlock request 65 and 66");
  Security_Seed_Key_Access(Anch3,Physical,Incar_1);
  TestStep("4","Send 31 01 FB 32 to enable Routine control request");
  SendDiag_Request_Verify_Response(DiagAnchor3,"31 01 FB 32","71 01 FB 32 00 VV TT");
  TestStep("5","Send 31 01 FB 40 XX to enable Routine control request");
 SendDiag_Request_Verify_Response(DiagAnchor3,"31 01 FB 40 00 00 00 00 00 00 00 00 00 00 00 00 00 00 00 00 00 00 00 00 00 00 00 00 00 00 00 00 00 00 00 00 00 00 00 00 00 00 00 00 00 00 00 00 00 00 00 00 00 00 00 00 00 00 00 00 00 00 00 00 00 00 00 00","71 01 FB 40 00 00 00 00 00 00 00 00 00 00 00 00 00 00 00 00 00 00 00 00 00 00 00 00 00 00 00 00 00 00 00 00 00 00 00 00 00 00 00 00 00 00 00 00 00 00 00 00 00 00 00 00 00 00 00 00 00 00 00 00 00 00 00 00");
  TestStep("6","Send 31 01 FB 41 WW VV UU to enable Routine control request");
  SendDiag_Request_Verify_Response(DiagAnchor3,"31 01 FB 41 00 00 00 00 00 00 00 00 00 00 00 00 00 00 00 00 00 00 00 00 00 00 00 00 00 00 00 00 00 00 00 00 00 00 00 00 00 00 00 00 00 00 00 00 00 00 00 00","71 01 FB 41");
  
  testCaseComment("Post Condition");
  TestStep("1","Send 2E FE A4 00 to enable WriteDataIdentifier");
  SendDiag_Request_Verify_Response(DiagAnchor3,"2E FE A4 00","6E FE A4");
  TestStep("2","Send request 10 01 to enter Diagnostic Default Session");
  SendDiag_Request_Verify_Response(DiagAnchor3,"10 01","50 01 00 32 01 F4");
  TestStep("3","Stop tester present 3E 00");
  StopTesterPresent();
  
 }
 
 testcase TCS_PK_FCA_AnchorUDS_RoutineControl_RIDFB42_SerialNumberBroadcast_Extended_NoSecurity0x61SecurityAnd0x65Security_47273()
{

  testCaseDescription("Description:Verify that positive response messages are returned when valid request messages for each supported SFID are sent for RID 0xFB42");
  testCaseComment("Precondition");
  TestStep("1","Send request 3E 00 to send tester present periodically every 4sec");
  SendTesterPresent();
  TestStep("2","Send request 10 01 to enter Diagnostic Default Session ");
  SendDiag_Request_Verify_Response(DiagAnchor3,"10 01","50 01 00 32 01 F4");
  
  testCaseComment("Test Case Design");
  TestStep("1","Send request 10 03 to enter the diagonistic extended sesssion ");
  SendDiag_Request_Verify_Response(DiagAnchor3,"10 03","50 03 00 32 01 F4");
  TestStep("2","Send 31 01 FB 42 01 F4 to enable Routine control request");
  SendDiag_Request_Verify_Response(DiagAnchor3,"31 01 FB 42 01 F4","71 01 FB 42");
  TestStep("3,4","Send security unlock request 61 and 62");
  Security_Seed_Key_Access(Anch3,Physical,Bosch);
  TestStep("5","Send 31 01 FB 42 01 F4 to enable Routine control request");
  SendDiag_Request_Verify_Response(DiagAnchor3,"31 01 FB 42 01 F4","71 01 FB 42");
  TestStep("6,7","Send security unlock request 65 and 66");
  Security_Seed_Key_Access(Anch3,Physical,Incar_1);
  TestStep("8","Send 31 01 FB 42 01 F4 to enable Routine control request");
  SendDiag_Request_Verify_Response(DiagAnchor3,"31 01 FB 42 01 F4","71 01 FB 42");
  
  testCaseComment("Post Condition");
  TestStep("1","Send request 10 01 to enter Diagnostic Default Session");
  SendDiag_Request_Verify_Response(DiagAnchor3,"10 01","50 01 00 32 01 F4");
  TestStep("2","Stop tester present 3E 00");
  StopTesterPresent();
  
 }
 
  testcase TCS_PK_FCA_AnchorUDS_RoutineControl_RIDFB43_SerialNumberCANIDStore_Extended_NoSecurity0x61SecurityAnd0x65Security_47279()
{

  testCaseDescription("Description:Verify that positive response messages are returned when valid request messages for each supported SFID are sent for RID 0xFB43");
  testCaseComment("Precondition");
  TestStep("1","Send request 3E 00 to send tester present periodically every 4sec");
  SendTesterPresent();
  TestStep("2","Send request 10 01 to enter Diagnostic Default Session ");
  SendDiag_Request_Verify_Response(DiagAnchor3,"10 01","50 01 00 32 01 F4");
  
  testCaseComment("Test Case Design");
  TestStep("1","Send request 10 03 to enter the diagonistic extended sesssion ");
  SendDiag_Request_Verify_Response(DiagAnchor3,"10 03","50 03 00 32 01 F4");
  TestStep("2","Send 31 01 FB 43 00 00 00 00 00 00 00 00 00 00 00 00 00 00 00 00 00 00 00 00 00 00 00 00 00 00 00 00 00 00 00 00 01 to enable Routine control request");
  SendDiag_Request_Verify_Response(DiagAnchor3,"31 01 FB 43 00 00 00 00 00 00 00 00 00 00 00 00 00 00 00 00 00 00 00 00 00 00 00 00 00 00 00 00 00 00 00 00 01","71 01 FB 43");
  TestStep("3,4","Send security unlock request 61 and 62");
  Security_Seed_Key_Access(Anch3,Physical,Bosch);
  TestStep("5","Send 31 01 FB 43 00 00 00 00 00 00 00 00 00 00 00 00 00 00 00 00 00 00 00 00 00 00 00 00 00 00 00 00 00 00 00 00 01 to enable Routine control request");
  SendDiag_Request_Verify_Response(DiagAnchor3,"31 01 FB 43 00 00 00 00 00 00 00 00 00 00 00 00 00 00 00 00 00 00 00 00 00 00 00 00 00 00 00 00 00 00 00 00 01","71 01 FB 42");
  TestStep("6,7","Send security unlock request 65 and 66");
  Security_Seed_Key_Access(Anch3,Physical,Incar_1);
  TestStep("8","Send 31 01 FB 43 00 00 00 00 00 00 00 00 00 00 00 00 00 00 00 00 00 00 00 00 00 00 00 00 00 00 00 00 00 00 00 00 01 to enable Routine control request");
  SendDiag_Request_Verify_Response(DiagAnchor3,"31 01 FB 43 00 00 00 00 00 00 00 00 00 00 00 00 00 00 00 00 00 00 00 00 00 00 00 00 00 00 00 00 00 00 00 00 01","71 01 FB 43");
  
  testCaseComment("Post Condition");
  TestStep("1","Send request 10 01 to enter Diagnostic Default Session");
  SendDiag_Request_Verify_Response(DiagAnchor3,"10 01","50 01 00 32 01 F4");
  TestStep("2","Stop tester present 3E 00");
  StopTesterPresent();
  
 }
 
 
  testcase TCS_PK_FCA_AnchorUDSServer_RoutineControl_RIDFC03_CompareSWSignatures_ProgrammingSession_0x61SecurityLevel_47297()
{

  testCaseDescription("Description:Verify that positive response messages are returned when valid request messages for each supported SFID are sent for RID 0xFC03");
  testCaseComment("Precondition");
  TestStep("1","Send request 3E 00 to send tester present periodically every 4sec");
  SendTesterPresent();
  TestStep("2","Send request 10 01 to enter Diagnostic Default Session ");
  SendDiag_Request_Verify_Response(DiagAnchor3,"10 01","50 01 00 32 01 F4");
  TestStep("3","Send request 10 03 to enter the diagonistic extended sesssion ");
  SendDiag_Request_Verify_Response(DiagAnchor3,"10 03","50 03 00 32 01 F4");
  
  testCaseComment("Test Case Design");
  TestStep("1,2","Send security unlock request 61 and 62");
  Security_Seed_Key_Access(Anch3,Physical,Bosch);
  TestStep("3","Send request 10 02 to enter the diagonistic Programing sesssion ");
  SendDiag_Request_Verify_Response(DiagAnchor3,"10 02","50 02 00 32 01 F4");
  TestStep("4","Send 31 01 FC 03 B0 00 00 01 VV  to enable Routine control request");
  SendDiag_Request_Verify_Response(DiagAnchor3,"31 01 FC 03 B0 00 00 01 00 00 00 00 00 00 00 00 00 00 00 00 00 00 00 00 00 00 00 00 00 00 00 00 00 00 00 00 00 00 00 00 00 00 00 00 00 00 00 00 00 00 00 00 00 00 00 00 00 00 00 00 00 00 00 00 00 00 00 00 00 00 00 00","71 01 FC 03 01");
  TestStep("5","Send 31 01 FC 03 B0 00 00 01 VV to enable Routine control request");
  SendDiag_Request_Verify_Response(DiagAnchor3,"31 01 FC 03 B0 00 00 01 00 00 00 00 00 00 00 00 00 00 00 00 00 00 00 00 00 00 00 00 00 00 00 00 00 00 00 00 00 00 00 00 00 00 00 00 00 00 00 00 00 00 00 00 00 00 00 00 00 00 00 00 00 00 00 00 00 00 00 00 00 00 00 00","71 01 FC 03 00");
  
  testCaseComment("Post Condition");
  TestStep("1","Send request 10 01 to enter Diagnostic Default Session");
  SendDiag_Request_Verify_Response(DiagAnchor3,"10 01","50 01 00 32 01 F4");
  TestStep("2","Stop tester present 3E 00");
  StopTesterPresent();
  
 }
 
 testcase TCS_PK_FCA_AnchorUDSServer_RoutineControl_RIDFC03_CompareSWSignatures_ProgrammingSession_0x65SecurityLevel_47303()
{

  testCaseDescription("Description:Verify that positive response messages are returned when valid request messages for each supported SFID are sent for RID 0xFC03");
  testCaseComment("Precondition");
  TestStep("1","Send request 3E 00 to send tester present periodically every 4sec");
  SendTesterPresent();
  TestStep("2","Send request 10 01 to enter Diagnostic Default Session ");
  SendDiag_Request_Verify_Response(DiagAnchor3,"10 01","50 01 00 32 01 F4");
  TestStep("3","Send request 10 03 to enter the diagonistic extended sesssion ");
  SendDiag_Request_Verify_Response(DiagAnchor3,"10 03","50 03 00 32 01 F4");
  
  testCaseComment("Test Case Design");
  TestStep("1,2","Send security unlock request 65 and 66");
  Security_Seed_Key_Access(Anch3,Physical,Incar_1);
  TestStep("3","Send request 10 02 to enter the diagonistic Programing sesssion ");
  SendDiag_Request_Verify_Response(DiagAnchor3,"10 02","50 02 00 32 01 F4");
  TestStep("4","Send 31 01 FC 03 B0 00 00 01 VV to enable Routine control request");
  SendDiag_Request_Verify_Response(DiagAnchor3,"31 01 FC 03 B0 00 00 01 00 00 00 00 00 00 00 00 00 00 00 00 00 00 00 00 00 00 00 00 00 00 00 00 00 00 00 00 00 00 00 00 00 00 00 00 00 00 00 00 00 00 00 00 00 00 00 00 00 00 00 00 00 00 00 00 00 00 00 00 00 00 00 00","71 01 FC 03 01");
  TestStep("5","Send 31 01 FC 03 B0 00 00 01 VV to enable Routine control request");
  SendDiag_Request_Verify_Response(DiagAnchor3,"31 01 FC 03 B0 00 00 01 00 00 00 00 00 00 00 00 00 00 00 00 00 00 00 00 00 00 00 00 00 00 00 00 00 00 00 00 00 00 00 00 00 00 00 00 00 00 00 00 00 00 00 00 00 00 00 00 00 00 00 00 00 00 00 00 00 00 00 00 00 00 00 00","71 01 FC 03 00");
  
  testCaseComment("Post Condition");
  TestStep("1","Send request 10 01 to enter Diagnostic Default Session");
  SendDiag_Request_Verify_Response(DiagAnchor3,"10 01","50 01 00 32 01 F4");
  TestStep("2","Stop tester present 3E 00");
  StopTesterPresent();
  
 }
 
 testcase TCS_PK_FCA_AnchorUDSServer_RoutineControl_RIDFC04_VerifySignature_ProgrammingSession_0x61SecurityLevel_47309()
{

  testCaseDescription("Description:Verify that positive response messages are returned when valid request messages for each supported SFID are sent for RID 0xFC04");
  testCaseComment("Precondition");
  TestStep("1","Send request 3E 00 to send tester present periodically every 4sec");
  SendTesterPresent();
  TestStep("2","Send request 10 01 to enter Diagnostic Default Session ");
  SendDiag_Request_Verify_Response(DiagAnchor3,"10 01","50 01 00 32 01 F4");
  TestStep("3","Send request 10 03 to enter the diagonistic extended sesssion ");
  SendDiag_Request_Verify_Response(DiagAnchor3,"10 03","50 03 00 32 01 F4");
  
  testCaseComment("Test Case Design");
  TestStep("1,2","Send security unlock request 61 and 62");
  Security_Seed_Key_Access(Anch3,Physical,Bosch);
  TestStep("3","Send request 10 02 to enter the diagonistic Programing sesssion ");
  SendDiag_Request_Verify_Response(DiagAnchor3,"10 02","50 02 00 32 01 F4");
  TestStep("4","Send 31 01 FC 04 B0 00 00 00 to enable Routine control request");
  SendDiag_Request_Verify_Response(DiagAnchor3,"31 01 FC 04 B0 00 00 00","71 01 FC 04 01");
  
  testCaseComment("Post Condition");
  TestStep("1","Send request 10 01 to enter Diagnostic Default Session");
  SendDiag_Request_Verify_Response(DiagAnchor3,"10 01","50 01 00 32 01 F4");
  TestStep("2","Stop tester present 3E 00");
  StopTesterPresent();
  
 }
 
 testcase TCS_PK_FCA_AnchorUDSServer_RoutineControl_RIDFC04_VerifySignature_ProgrammingSession_0x65SecurityLevel_47315()
{

  testCaseDescription("Description:Verify that positive response messages are returned when valid request messages for each supported SFID are sent for RID 0xFC04");
  testCaseComment("Precondition");
  TestStep("1","Send request 3E 00 to send tester present periodically every 4sec");
  SendTesterPresent();
  TestStep("2","Send request 10 01 to enter Diagnostic Default Session ");
  SendDiag_Request_Verify_Response(DiagAnchor3,"10 01","50 01 00 32 01 F4");
  TestStep("3","Send request 10 03 to enter the diagonistic extended sesssion ");
  SendDiag_Request_Verify_Response(DiagAnchor3,"10 03","50 03 00 32 01 F4");
  
  testCaseComment("Test Case Design");
  TestStep("1,2","Send security unlock request 65 and 66");
  Security_Seed_Key_Access(Anch3,Physical,Incar_1);
  TestStep("3","Send request 10 02 to enter the diagonistic Programing sesssion ");
  SendDiag_Request_Verify_Response(DiagAnchor3,"10 02","50 02 00 32 01 F4");
  TestStep("4","Send 31 01 FC 04 B0 00 00 00 to enable Routine control request");
  SendDiag_Request_Verify_Response(DiagAnchor3,"31 01 FC 04 B0 00 00 00","71 01 FC 04 01");
  
  testCaseComment("Post Condition");
  TestStep("1","Send request 10 01 to enter Diagnostic Default Session");
  SendDiag_Request_Verify_Response(DiagAnchor3,"10 01","50 01 00 32 01 F4");
  TestStep("2","Stop tester present 3E 00");
  StopTesterPresent();
  
 }


testcase TCS_PK_FCA_AnchorUDSServer_RoutineControl_RIDFA22_ExtendedSession_0x61SecurityLevel_55124()
{
  PreCondition_Anchor("TCS_PK_FCA_AnchorUDSServer_RoutineControl_RIDFA22_ExtendedSession_0x61SecurityLevel_55124");
  testCaseComment("Actions");
  TestStep("1","Send request 10 03 to enter Extended Diagnostic Session");
	SendDiag_Request_Verify_Response(DiagAnchor3,"10 03","50 03 00 32 01 F4");
   TestStep("2,3","Send Security Seed Request 61 and Key 62 in DiagAnchor");   
       	Security_Seed_Key_Access(Anch3,Physical,Bosch);
  TestStep("4","Send request 31 01 FA 22 to request routine control services");
        SendDiag_Request_Verify_Response(DiagAnchor3,"31 01 FA 22","71 01 FA 22");
  PostCondition_Anchor( );
  }

testcase TCS_PK_FCA_AnchorUDSServer_RoutineControl_RIDFA23_ExtendedSession_0x61SecurityLevel_19770()
{
  PreCondition_Anchor("TCS_PK_FCA_AnchorUDSServer_RoutineControl_RIDFA23_ExtendedSession_0x61SecurityLevel_19770");
  testCaseComment("Actions");
  TestStep("1","Send request 10 03 to enter Extended Diagnostic Session");
	SendDiag_Request_Verify_Response(DiagAnchor3,"10 03","50 03 00 32 01 F4");
     TestStep("2,3","Send Security Seed Request 61 and Key 62 in DiagAnchor");   
       	Security_Seed_Key_Access(Anch3,Physical,Bosch);
  TestStep("4","Send request 31 01 FA 23 to request routine control services");
        SendDiag_Request_Verify_Response(DiagAnchor3,"31 01 FA 23","71 01 FA 23");
  PostCondition_Anchor( );
  }

testcase TCS_PK_FCA_AnchorUDSServer_RoutineControl_RIDFA24_ExtendedSession_0x61SecurityLevel_17703()
{
  PreCondition_Anchor("TCS_PK_FCA_AnchorUDSServer_RoutineControl_RIDFA24_ExtendedSession_0x61SecurityLevel_17703");
  testCaseComment("Actions");
  TestStep("1","Send request 10 03 to enter Extended Diagnostic Session");
	SendDiag_Request_Verify_Response(DiagAnchor3,"10 03","50 03 00 32 01 F4");
       TestStep("2,3","Send Security Seed Request 61 and Key 62 in DiagAnchor");   
       	Security_Seed_Key_Access(Anch3,Physical,Bosch);
  TestStep("4","Send request 31 01 FA 24 00 00 00 00 00 00 00 00 00 00 00 00 00 00 00 00 to request routine control services");
        SendDiag_Request_Verify_Response(DiagAnchor3,"31 01 FA 24 00 00 00 00 00 00 00 00 00 00 00 00 00 00 00 00","71 01 FA 24 00 01");
  PostCondition_Anchor( );
  }


  
testcase TCS_PK_FCA_AnchorUDSServer_RoutineControl_RIDFA21_ExtendedSession_0x61SecurityLevel_53672()
{
  PreCondition_Anchor("TCS_PK_FCA_AnchorUDSServer_RoutineControl_RIDFA21_ExtendedSession_NoSecurityLevel_53672");
  testCaseComment("Actions");
  TestStep("1","Send request 10 03 to enter Extended Diagnostic Session");
	SendDiag_Request_Verify_Response(DiagAnchor3,"10 03","50 03 00 32 01 F4");
       TestStep("2,3","Send Security Seed Request 61 and Key 62 in DiagAnchor");   
       	Security_Seed_Key_Access(Anch3,Physical,Bosch);
  TestStep("4","Send request 31 01 FA 21 01 00 00 00 00 00 00 00 00 00 00 00 00 00 00 00 00 00 00 00 00 00 00 00 00 00 00 00 00 00 00 00 00 00 00 00 00 00 00 00 00 00 00 00 00 00 00 00 00 00 00 00 00 00 00 00 00 00 00 00 00 00 00 00 00 to request routine control services");
        SendDiag_Request_Verify_Response(DiagAnchor3,"31 01 FA 21 01 00 00 00 00 00 00 00 00 00 00 00 00 00 00 00 00 00 00 00 00 00 00 00 00 00 00 00 00 00 00 00 00 00 00 00 00 00 00 00 00 00 00 00 00 00 00 00 00 00 00 00 00 00 00 00 00 00 00 00 00 00 00 00 00","71 01 FA 21");
  PostCondition_Anchor( );
  }



 ///////////////////////////////AnchorUDSServer_ReadDataByIdentifier_NRC31//////////////////////////////

 testcase TCS_PK_FCA_AnchorUDSServer_ReadDataByIdentifier_NRC31_DIDFE03_BLEAddress_DefaultSession_54571()
{
	testCaseComment("Precondition");
	TestStep("1","Send TesterPresent 3E 00 every 4000ms");
	SendDiag_Request_Verify_Response(DiagAnchor3,"3E 00","7E 00");
  testCaseComment("Actions");
  TestStep("2","Send request 10 01 to enter Default Diagnostic Session");
	SendDiag_Request_Verify_Response(DiagAnchor3,"10 01","50 01");
  TestStep("3","Send request 22 FE 03 to request ReadDataByIdentifier Service ");
	SendDiag_Request_Verify_Negative_Response(DiagAnchor3,"22 FE 03","7F 22 31");
  TestCaseComment("Postcondition");
	TestStep("4","Send request 10 01 to enter default diagnostic session");
	SendDiag_Request_Verify_Response(DiagAnchor3,"10 01","50 01 00 32 01 F4");
  TestStep("5"," Stop Sending TesterPresent 3E 00 every 4000ms");
} 



testcase TCS_PK_FCA_AnchorUDSServer_ReadDataByIdentifier_NRC31_DIDFE03_BLEAddress_ProgrammingSession_NoSecurityLevel_54572()
{
	testCaseComment("Precondition");
	TestStep("1","Send TesterPresent 3E 00 every 4000ms");
	SendDiag_Request_Verify_Response(DiagAnchor3,"3E 00","7E 00");
	TestStep("2","Send request 10 01 to enter default diagnostic session");
	SendDiag_Request_Verify_Response(DiagAnchor3,"10 01","50 01 00 32 01 F4");
  TestStep("3","Send request 10 03 to enter Extended Diagnostic Session");
	SendDiag_Request_Verify_Response(DiagAnchor3,"10 03","50 03 00 32 01 F4");
  TestStep("4,5","Send Security Seed Request 61 and Key 62 in DiagAnchor");  
  Security_Seed_Key_Access(Anch3,Physical,Bosch);
  testCaseComment("Actions");
  TestStep("6","Send request 10 02 to enter Programming Diagnostic Session");
	SendDiag_Request_Verify_Response(DiagAnchor3,"10 02","50 02 00 32 01 F4");
  TestStep("7","Send request 22 FE 03 to request ReadDataByIdentifier Service");
	SendDiag_Request_Verify_Negative_Response(DiagAnchor3,"22 FE 03","7F 22 31");
	TestCaseComment("Postcondition");
	TestStep("8","Send request 10 01 to enter default diagnostic session");
	SendDiag_Request_Verify_Response(DiagAnchor3,"10 01","50 01 00 32 01 F4");
	}



testcase TCS_PK_FCA_AnchorUDSServer_ReadDataByIdentifier_NRC31_DIDFE04_BoschEOLLock_DefaultSession_54573()
{
	testCaseComment("Precondition");
	TestStep("1","Send TesterPresent 3E 00 every 4000ms");
	SendDiag_Request_Verify_Response(DiagAnchor3,"3E 00","7E 00");
  testCaseComment("Actions");
  TestStep("2","Send request 10 01 to enter Default Diagnostic Session");
	SendDiag_Request_Verify_Response(DiagAnchor3,"10 01","50 01");
  TestStep("3","Send request 22 FE 03 to request ReadDataByIdentifier Service ");
	SendDiag_Request_Verify_Negative_Response(DiagAnchor3,"22 FE 03","7F 22 31");
  TestCaseComment("Postcondition");
  TestStep("4"," Stop Sending TesterPresent 3E 00 every 4000ms");
} 
	
	
testcase TCS_PK_FCA_AnchorUDSServer_ReadDataByIdentifier_NRC31_DIDFE04_BoschEOLLock_ProgrammingSession_NoSecurityLevel_54575()
{
	testCaseComment("Precondition");
	TestStep("1","Send TesterPresent 3E 00 every 4000ms");
	SendDiag_Request_Verify_Response(DiagAnchor3,"3E 00","7E 00");
	TestStep("2","Send request 10 01 to enter default diagnostic session");
	SendDiag_Request_Verify_Response(DiagAnchor3,"10 01","50 01 00 32 01 F4");
  TestStep("3","Send request 10 03 to enter Extended Diagnostic Session");
	SendDiag_Request_Verify_Response(DiagAnchor3,"10 03","50 03 00 32 01 F4");
  TestStep("4,5","Send Security Seed Request 61 and Key 62 in DiagAnchor");  
  Security_Seed_Key_Access(Anch3,Physical,Bosch);
  testCaseComment("Actions");
  TestStep("6","Send request 10 02 to enter Programming Diagnostic Session");
	SendDiag_Request_Verify_Response(DiagAnchor3,"10 02","50 02 00 32 01 F4");
  TestStep("7","Send request 22 FE 04 to request ReadDataByIdentifier Service");
	SendDiag_Request_Verify_Negative_Response(DiagAnchor3,"22 FE 04","7F 22 31");
	TestCaseComment("Postcondition");
	TestStep("8","Send request 10 01 to enter default diagnostic session");
	SendDiag_Request_Verify_Response(DiagAnchor3,"10 01","50 01 00 32 01 F4");
	}	
	
	
testcase TCS_PK_FCA_AnchorUDSServer_ReadDataByIdentifier_NRC31_DIDFE05_TimeSinceResetUWB_DefaultSession_54578()
{
	testCaseComment("Precondition");
	TestStep("1","Send TesterPresent 3E 00 every 4000ms");
	SendDiag_Request_Verify_Response(DiagAnchor3,"3E 00","7E 00");
  testCaseComment("Actions");
  TestStep("2","Send request 10 01 to enter Default Diagnostic Session");
	SendDiag_Request_Verify_Response(DiagAnchor3,"10 01","50 01");
  TestStep("3","Send request 22 FE 05 to request ReadDataByIdentifier Service ");
	SendDiag_Request_Verify_Negative_Response(DiagAnchor3,"22 FE 05","7F 22 31");
  TestCaseComment("Postcondition");
  TestStep("4"," Stop Sending TesterPresent 3E 00 every 4000ms");
}




testcase TCS_PK_FCA_AnchorUDSServer_ReadDataByIdentifier_NRC31_DIDFE05_TimeSinceResetUWB_ProgrammingSession_NoSecurityLevel_54581()
{
	testCaseComment("Precondition");
	TestStep("1","Send TesterPresent 3E 00 every 4000ms");
	SendDiag_Request_Verify_Response(DiagAnchor3,"3E 00","7E 00");
	TestStep("2","Send request 10 01 to enter default diagnostic session");
	SendDiag_Request_Verify_Response(DiagAnchor3,"10 01","50 01 00 32 01 F4");
  TestStep("3","Send request 10 03 to enter Extended Diagnostic Session");
	SendDiag_Request_Verify_Response(DiagAnchor3,"10 03","50 03 00 32 01 F4");
  TestStep("4,5","Send Security Seed Request 61 and Key 62 in DiagAnchor");  
  Security_Seed_Key_Access(Anch3,Physical,Bosch);
  testCaseComment("Actions");
  TestStep("6","Send request 10 02 to enter Programming Diagnostic Session");
	SendDiag_Request_Verify_Response(DiagAnchor3,"10 02","50 02 00 32 01 F4");
  TestStep("7","Send request 22 FE 05 to request ReadDataByIdentifier Service");
	SendDiag_Request_Verify_Negative_Response(DiagAnchor3,"22 FE 05","7F 22 31");
	TestCaseComment("Postcondition");
	TestStep("8","Send request 10 01 to enter default diagnostic session");
	SendDiag_Request_Verify_Response(DiagAnchor3,"10 01","50 01 00 32 01 F4");
	}	 	
	



testcase TCS_PK_FCA_AnchorUDSServer_ReadDataByIdentifier_NRC31_DIDFE06_TimeSinceReset_DefaultSession_54576()
{
	testCaseComment("Precondition");
	TestStep("1","Send TesterPresent 3E 00 every 4000ms");
	SendDiag_Request_Verify_Response(DiagAnchor3,"3E 00","7E 00");
  testCaseComment("Actions");
  TestStep("2","Send request 10 01 to enter Default Diagnostic Session");
	SendDiag_Request_Verify_Response(DiagAnchor3,"10 01","50 01");
  TestStep("3","Send request 22 FE 06 to request ReadDataByIdentifier Service ");
	SendDiag_Request_Verify_Negative_Response(DiagAnchor3,"22 FE 06","7F 22 31");
  TestCaseComment("Postcondition");
	TestStep("4","Send request 10 01 to enter default diagnostic session");
	SendDiag_Request_Verify_Response(DiagAnchor3,"10 01","50 01 00 32 01 F4");
  TestStep("5"," Stop Sending TesterPresent 3E 00 every 4000ms");
} 



testcase TCS_PK_FCA_AnchorUDSServer_ReadDataByIdentifier_NRC31_DIDFE06_TimeSinceReset_ProgrammingSession_NoSecurityLevel_54585()
{
	testCaseComment("Precondition");
	TestStep("1","Send TesterPresent 3E 00 every 4000ms");
	SendDiag_Request_Verify_Response(DiagAnchor3,"3E 00","7E 00");
	TestStep("2","Send request 10 01 to enter default diagnostic session");
	SendDiag_Request_Verify_Response(DiagAnchor3,"10 01","50 01 00 32 01 F4");
  TestStep("3","Send request 10 03 to enter Extended Diagnostic Session");
	SendDiag_Request_Verify_Response(DiagAnchor3,"10 03","50 03 00 32 01 F4");
  TestStep("4,5","Send Security Seed Request 61 and Key 62 in DiagAnchor");  
  Security_Seed_Key_Access(Anch3,Physical,Bosch);
  testCaseComment("Actions");
  TestStep("6","Send request 10 02 to enter Programming Diagnostic Session");
	SendDiag_Request_Verify_Response(DiagAnchor3,"10 02","50 02 00 32 01 F4");
  TestStep("7","Send request 22 FE 06 to request ReadDataByIdentifier Service");
	SendDiag_Request_Verify_Negative_Response(DiagAnchor3,"22 FE 06","7F 22 31");
	TestCaseComment("Postcondition");
	TestStep("8","Send request 10 01 to enter default diagnostic session");
	SendDiag_Request_Verify_Response(DiagAnchor3,"10 01","50 01 00 32 01 F4");
	}	 	



testcase TCS_PK_FCA_AnchorUDSServer_ReadDataByIdentifier_NRC31_DIDFE07_CANIdx_DefaultSession_54588()
{
	testCaseComment("Precondition");
	TestStep("1","Send TesterPresent 3E 00 every 4000ms");
	SendDiag_Request_Verify_Response(DiagAnchor3,"3E 00","7E 00");
  testCaseComment("Actions");
  TestStep("2","Send request 10 01 to enter Default Diagnostic Session");
	SendDiag_Request_Verify_Response(DiagAnchor3,"10 01","50 01");
  TestStep("3","Send request 22 FE 07 to request ReadDataByIdentifier Service ");
	SendDiag_Request_Verify_Negative_Response(DiagAnchor3,"22 FE 07","7F 22 31");
  TestCaseComment("Postcondition");
  TestStep("4"," Stop Sending TesterPresent 3E 00 every 4000ms");
}




testcase TCS_PK_FCA_AnchorUDSServer_ReadDataByIdentifier_NRC31_DIDFE07_CANIdx_ProgrammingSession_NoSecurityLevel_54583()
{
	testCaseComment("Precondition");
	TestStep("1","Send TesterPresent 3E 00 every 4000ms");
	SendDiag_Request_Verify_Response(DiagAnchor3,"3E 00","7E 00");
	TestStep("2","Send request 10 01 to enter default diagnostic session");
	SendDiag_Request_Verify_Response(DiagAnchor3,"10 01","50 01 00 32 01 F4");
  TestStep("3","Send request 10 03 to enter Extended Diagnostic Session");
	SendDiag_Request_Verify_Response(DiagAnchor3,"10 03","50 03 00 32 01 F4");
  TestStep("4,5","Send Security Seed Request 61 and Key 62 in DiagAnchor");  
  Security_Seed_Key_Access(Anch3,Physical,Bosch);
  testCaseComment("Actions");
  TestStep("6","Send request 10 02 to enter Programming Diagnostic Session");
	SendDiag_Request_Verify_Response(DiagAnchor3,"10 02","50 02 00 32 01 F4");
  TestStep("7","Send request 22 FE 07 to request ReadDataByIdentifier Service");
	SendDiag_Request_Verify_Negative_Response(DiagAnchor3,"22 FE 07","7F 22 31");
	TestCaseComment("Postcondition");
	TestStep("8","Send request 10 01 to enter default diagnostic session");
	SendDiag_Request_Verify_Response(DiagAnchor3,"10 01","50 01 00 32 01 F4");
	}	 	


	
	
testcase TCS_PK_FCA_AnchorUDSServer_ReadDataByIdentifier_NRC31_DIDFE08_IDPinRead_DefaultSession_54593()
{
	testCaseComment("Precondition");
	TestStep("1","Send TesterPresent 3E 00 every 4000ms");
	      SendDiag_Request_Verify_Response(DiagAnchor3,"3E 00","7E 00");
        testCaseComment("Actions");
        TestStep("2","Send request 10 01 to enter default diagnostic session");
	      SendDiag_Request_Verify_Response(DiagAnchor3,"10 01","50 01 00 32 01 F4");
        TestStep("3","Send request 22 FE 08 to Read IDPinRead");
              SendDiag_Request_Verify_Negative_Response(DiagAnchor3,"22 FE 08","7F 22 31");
        TestCaseComment("Postcondition");
        TestStep("4","Send request 10 01 to enter default diagnostic session");
	      SendDiag_Request_Verify_Response(DiagAnchor3,"10 01","50 01 00 32 01 F4");
        TestStep("5","Stop TesterPresent 3E 00");
	      SendDiag_Request_Verify_Response(DiagAnchor3,"3E 00","7E 00");
}



testcase TCS_PK_FCA_AnchorUDSServer_ReadDataByIdentifier_NRC31_DIDFE08_IDPinRead_ProgrammingSession_NoSecurityLevel_54596()
{
	testCaseComment("Precondition");
	TestStep("1","Send TesterPresent 3E 00 every 4000ms");
	      SendDiag_Request_Verify_Response(DiagAnchor3,"3E 00","7E 00");
        TestStep("2","Send request 10 01 to enter default diagnostic session");
	      SendDiag_Request_Verify_Response(DiagAnchor3,"10 01","50 01 00 32 01 F4");
        TestStep("3","Send request 10 03 to enter Extended Diagnostic Session");
	      SendDiag_Request_Verify_Response(DiagAnchor3,"10 03","50 03 00 32 01 F4");
        TestStep("4,5","Send security unlock request 61 and 62");   
       	      Security_Seed_Key_Access(Anch3,Physical,Bosch);
        testCaseComment("Actions");
        TestStep("6","Send request 10 02 to enter Programming Diagnostic Session");
	      SendDiag_Request_Verify_Response(DiagAnchor3,"10 02","50 02 00 32 01 F4");
        TestStep("7","Send request 22 FE 08 to Read IDPinRead");
              SendDiag_Request_Verify_Negative_Response(DiagAnchor3,"22 FE 08","7F 22 31");
        TestCaseComment("Postcondition");
        TestStep("8","Send request 10 01 to enter default diagnostic session");
	      SendDiag_Request_Verify_Response(DiagAnchor3,"10 01","50 01 00 32 01 F4");
        TestStep("9","Stop TesterPresent 3E 00");
	      SendDiag_Request_Verify_Response(DiagAnchor3,"3E 00","7E 00");
}




testcase TCS_PK_FCA_AnchorUDSServer_ReadDataByIdentifier_NRC31_DIDFE0B_R4ExtUwbDiag_DefaultSession_54591()
{
	testCaseComment("Precondition");
	TestStep("1","Send TesterPresent 3E 00 every 4000ms");
	      SendDiag_Request_Verify_Response(DiagAnchor3,"3E 00","7E 00");
        testCaseComment("Actions");
        TestStep("2","Send request 10 01 to enter default diagnostic session");
	      SendDiag_Request_Verify_Response(DiagAnchor3,"10 01","50 01 00 32 01 F4");
        TestStep("3","Send request 22 FE 0B to Read R4ExtUwb");
              SendDiag_Request_Verify_Negative_Response(DiagAnchor3,"22 FE 0B","7F 22 31");
        TestCaseComment("Postcondition");
        TestStep("4","Stop TesterPresent 3E 00");
	      SendDiag_Request_Verify_Response(DiagAnchor3,"3E 00","7E 00");
}




testcase TCS_PK_FCA_AnchorUDSServer_ReadDataByIdentifier_NRC31_DIDFE0B_R4ExtUwbDiag_ProgrammingSession_0x61SecurityLevel_54599()
{
	testCaseComment("Precondition");
	TestStep("1","Send TesterPresent 3E 00 every 4000ms");
	      SendDiag_Request_Verify_Response(DiagAnchor3,"3E 00","7E 00");
        TestStep("2","Send request 10 01 to enter default diagnostic session");
	      SendDiag_Request_Verify_Response(DiagAnchor3,"10 01","50 01 00 32 01 F4");
        TestStep("3","Send request 10 03 to enter Extended Diagnostic Session");
	      SendDiag_Request_Verify_Response(DiagAnchor3,"10 03","50 03 00 32 01 F4");
        TestStep("4,5","Send security unlock request 61 and 62");   
       	      Security_Seed_Key_Access(Anch3,Physical,Bosch);
        testCaseComment("Actions");
        TestStep("6","Send request 10 02 to enter Programming Diagnostic Session");
	      SendDiag_Request_Verify_Response(DiagAnchor3,"10 02","50 02 00 32 01 F4");
        TestStep("7","Send request 22 FE 0B to Read R4ExtUwb");
              SendDiag_Request_Verify_Negative_Response(DiagAnchor3,"22 FE 0B","7F 22 31");
        TestCaseComment("Postcondition");
        TestStep("8","Send request 10 01 to enter default diagnostic session");
	      SendDiag_Request_Verify_Response(DiagAnchor3,"10 01","50 01 00 32 01 F4");
        TestStep("9","Stop TesterPresent 3E 00");
	      SendDiag_Request_Verify_Response(DiagAnchor3,"3E 00","7E 00");
}



testcase TCS_PK_FCA_AnchorUDSServer_ReadDataByIdentifier_NRC31_DIDFE0B_R4ExtUwbDiag_ProgrammingSession_NoSecurityLevel_54604()
{
	testCaseComment("Precondition");
	TestStep("1","Send TesterPresent 3E 00 every 4000ms");
	      SendDiag_Request_Verify_Response(DiagAnchor3,"3E 00","7E 00");
        testCaseComment("Actions");
        TestStep("2","Send request 10 01 to enter default diagnostic session");
	      SendDiag_Request_Verify_Response(DiagAnchor3,"10 01","50 01 00 32 01 F4");
        TestStep("3","Send request 22 FE 0E to Read SupplyVoltage");
              SendDiag_Request_Verify_Negative_Response(DiagAnchor3,"22 FE 0E","7F 22 31");
        TestCaseComment("Postcondition");
        TestStep("4","Send request 10 01 to enter default diagnostic session");
	      SendDiag_Request_Verify_Response(DiagAnchor3,"10 01","50 01 00 32 01 F4");
        TestStep("5","Stop TesterPresent 3E 00");
	      SendDiag_Request_Verify_Response(DiagAnchor3,"3E 00","7E 00");
}




testcase TCS_PK_FCA_AnchorUDSServer_ReadDataByIdentifier_NRC31_DIDFE0E_SupplyVoltage_ProgrammingSession_NoSecurityLevel_54598()
{
	testCaseComment("Precondition");
	TestStep("1","Send TesterPresent 3E 00 every 4000ms");
	      SendDiag_Request_Verify_Response(DiagAnchor3,"3E 00","7E 00");
        TestStep("2","Send request 10 01 to enter default diagnostic session");
	      SendDiag_Request_Verify_Response(DiagAnchor3,"10 01","50 01 00 32 01 F4");
        TestStep("3","Send request 10 03 to enter Extended Diagnostic Session");
	      SendDiag_Request_Verify_Response(DiagAnchor3,"10 03","50 03 00 32 01 F4");
        TestStep("4,5","Send security unlock request 61 and 62");   
       	      Security_Seed_Key_Access(Anch3,Physical,Bosch);
        testCaseComment("Actions");
        TestStep("6","Send request 10 02 to enter Programming Diagnostic Session");
	      SendDiag_Request_Verify_Response(DiagAnchor3,"10 02","50 02 00 32 01 F4");
        TestStep("7","Send request 22 FE 0E to Read SupplyVoltage");
              SendDiag_Request_Verify_Negative_Response(DiagAnchor3,"22 FE 0E","7F 22 31");
        TestCaseComment("Postcondition");
        TestStep("8","Send request 10 01 to enter default diagnostic session");
	      SendDiag_Request_Verify_Response(DiagAnchor3,"10 01","50 01 00 32 01 F4");
        TestStep("9","Stop TesterPresent 3E 00");
	      SendDiag_Request_Verify_Response(DiagAnchor3,"3E 00","7E 00");
}



testcase TCS_PK_FCA_AnchorUDSServer_ReadDataByIdentifier_NRC31_DIDFE11_SWInformation_DefaultSession_54607()
{
	testCaseComment("Precondition");
	TestStep("1","Send TesterPresent 3E 00 every 4000ms");
	      SendDiag_Request_Verify_Response(DiagAnchor3,"3E 00","7E 00");
        testCaseComment("Actions");
        TestStep("2","Send request 10 01 to enter default diagnostic session");
	      SendDiag_Request_Verify_Response(DiagAnchor3,"10 01","50 01 00 32 01 F4");
        TestStep("3","Send request 22 FE 11 to Read SWInformation");
              SendDiag_Request_Verify_Negative_Response(DiagAnchor3,"22 FE 11","7F 22 31");
        TestCaseComment("Postcondition");
        TestStep("4","Send request 10 01 to enter default diagnostic session");
	      SendDiag_Request_Verify_Response(DiagAnchor3,"10 01","50 01 00 32 01 F4");
        TestStep("5","Stop TesterPresent 3E 00");
	      SendDiag_Request_Verify_Response(DiagAnchor3,"3E 00","7E 00");
}




testcase TCS_PK_FCA_AnchorUDSServer_ReadDataByIdentifier_NRC31_DIDFE13_UWBChipVersion_DefaultSession_54608()
{
	testCaseComment("Precondition");
	TestStep("1","Send TesterPresent 3E 00 every 4000ms");
	      SendDiag_Request_Verify_Response(DiagAnchor3,"3E 00","7E 00");
        testCaseComment("Actions");
        TestStep("2","Send request 10 01 to enter default diagnostic session");
	      SendDiag_Request_Verify_Response(DiagAnchor3,"10 01","50 01 00 32 01 F4");
        TestStep("3","Send request 22 FE 13 to Read UWBChipVersion");
              SendDiag_Request_Verify_Negative_Response(DiagAnchor3,"22 FE 13","7F 22 31");
        TestCaseComment("Postcondition");
        TestStep("4","Stop TesterPresent 3E 00");
	      SendDiag_Request_Verify_Response(DiagAnchor3,"3E 00","7E 00");
}




testcase TCS_PK_FCA_AnchorUDSServer_ReadDataByIdentifier_NRC31_DIDFE13_UWBChipVersion_ProgrammingSession_54605()
{
	testCaseComment("Precondition");
	TestStep("1","Send TesterPresent 3E 00 every 4000ms");
	      SendDiag_Request_Verify_Response(DiagAnchor3,"3E 00","7E 00");
        TestStep("2","Send request 10 01 to enter default diagnostic session");
	      SendDiag_Request_Verify_Response(DiagAnchor3,"10 01","50 01 00 32 01 F4");
        TestStep("3","Send request 10 03 to enter Extended Diagnostic Session");
	      SendDiag_Request_Verify_Response(DiagAnchor3,"10 03","50 03 00 32 01 F4");
        TestStep("4,5","Send security unlock request 61 and 62");   
       	      Security_Seed_Key_Access(Anch3,Physical,Bosch);
        testCaseComment("Actions");
        TestStep("6","Send request 10 02 to enter Programming Diagnostic Session");
	      SendDiag_Request_Verify_Response(DiagAnchor3,"10 02","50 02 00 32 01 F4");
        TestStep("7","Send request 22 FE 13 to Read UWBChipVersion");
              SendDiag_Request_Verify_Negative_Response(DiagAnchor3,"22 FE 13","7F 22 31");
        TestCaseComment("Postcondition");
        TestStep("8","Stop TesterPresent 3E 00");
	      SendDiag_Request_Verify_Response(DiagAnchor3,"3E 00","7E 00");
}



testcase TCS_PK_FCA_AnchorUDSServer_ReadDataByIdentifier_NRC31_DIDFE14_SourceControlCommitID_DefaultSession_54611()
{
	testCaseComment("Precondition");
	TestStep("1","Send TesterPresent 3E 00 every 4000ms");
	      SendDiag_Request_Verify_Response(DiagAnchor3,"3E 00","7E 00");
        testCaseComment("Actions");
        TestStep("2","Send request 10 01 to enter default diagnostic session");
	      SendDiag_Request_Verify_Response(DiagAnchor3,"10 01","50 01 00 32 01 F4");
        TestStep("3","Send request 22 FE 14 to Read SourceControlCommitID");
              SendDiag_Request_Verify_Negative_Response(DiagAnchor3,"22 FE 14","7F 22 31");
        TestCaseComment("Postcondition");
        TestStep("4","Stop TesterPresent 3E 00");
	      SendDiag_Request_Verify_Response(DiagAnchor3,"3E 00","7E 00");
}



testcase TCS_PK_FCA_AnchorUDSServer_ReadDataByIdentifier_NRC31_DIDFE14_SourceControlCommitID_ProgrammingSession_54612()

{
	testCaseComment("Precondition");
	TestStep("1","Send TesterPresent 3E 00 every 4000ms");
	      SendDiag_Request_Verify_Response(DiagAnchor3,"3E 00","7E 00");
        TestStep("2","Send request 10 01 to enter default diagnostic session");
	      SendDiag_Request_Verify_Response(DiagAnchor3,"10 01","50 01 00 32 01 F4");
        TestStep("3","Send request 10 03 to enter Extended Diagnostic Session");
	      SendDiag_Request_Verify_Response(DiagAnchor3,"10 03","50 03 00 32 01 F4");
        TestStep("4,5","Send security unlock request 61 and 62");   
       	      Security_Seed_Key_Access(Anch3,Physical,Bosch);
        testCaseComment("Actions");
        TestStep("6","Send request 10 02 to enter Programming Diagnostic Session");
	      SendDiag_Request_Verify_Response(DiagAnchor3,"10 02","50 02 00 32 01 F4");
        TestStep("7","Send request 22 FE 14 to Read SourceControlCommitIDs");
              SendDiag_Request_Verify_Negative_Response(DiagAnchor3,"22 FE 14","7F 22 31");
        TestCaseComment("Postcondition");
        TestStep("8","Stop TesterPresent 3E 00");
	      SendDiag_Request_Verify_Response(DiagAnchor3,"3E 00","7E 00");
}



testcase TCS_PK_FCA_AnchorUDSServer_ReadDataByIdentifier_NRC31_DIDFE1A_BLEorMiniMCURuntimeStats_DefaultSession_54616()
{
	testCaseComment("Precondition");
	TestStep("1","Send TesterPresent 3E 00 every 4000ms");
	      SendDiag_Request_Verify_Response(DiagAnchor3,"3E 00","7E 00");
        testCaseComment("Actions");
        TestStep("2","Send request 10 01 to enter default diagnostic session");
	      SendDiag_Request_Verify_Response(DiagAnchor3,"10 01","50 01 00 32 01 F4");
	TestStep("3","Send request 22 FE 1A to Read BLEorMiniMCURuntimeStats");
      SendDiag_Request_Verify_Negative_Response(DiagAnchor3,"22 FE 1A","7F 22 31");
	TestCaseComment("Postcondition");
        TestStep("4","Send request 10 01 to enter default diagnostic session");
	      SendDiag_Request_Verify_Response(DiagAnchor3,"10 01","50 01 00 32 01 F4");
        TestStep("5","Stop TesterPresent 3E 00");
	      SendDiag_Request_Verify_Response(DiagAnchor3,"3E 00","7E 00");
}




testcase TCS_PK_FCA_AnchorUDSServer_ReadDataByID_NRC31_DIDFE1A_BLEorMiniMCURuntimeStats_Programming_BoschSecurity_54619()
{
	testCaseComment("Precondition");
	TestStep("1","Send TesterPresent 3E 00 every 4000ms");
	      SendDiag_Request_Verify_Response(DiagAnchor3,"3E 00","7E 00");
        TestStep("2","Send request 10 01 to enter default diagnostic session");
	      SendDiag_Request_Verify_Response(DiagAnchor3,"10 01","50 01 00 32 01 F4");
        TestStep("3","Send request 10 03 to enter Extended Diagnostic Session");
	      SendDiag_Request_Verify_Response(DiagAnchor3,"10 03","50 03 00 32 01 F4");
        TestStep("4,5","Send security unlock request 61 and 62");   
       	      Security_Seed_Key_Access(Anch3,Physical,Bosch);
        testCaseComment("Actions");
	TestStep("6","Send request 10 02 to enter Programming Diagnostic Session");
	      SendDiag_Request_Verify_Response(DiagAnchor3,"10 02","50 02 00 32 01 F4");
        TestStep("7","Send request 22 FE 1A to Read BLEorMiniMCURuntimeStats");
              SendDiag_Request_Verify_Negative_Response(DiagAnchor3,"22 FE 1A","7F 22 31");
        TestCaseComment("Postcondition");
        TestStep("8","Send request 10 01 to enter default diagnostic session");
	      SendDiag_Request_Verify_Response(DiagAnchor3,"10 01","50 01 00 32 01 F4");
        TestStep("9","Stop TesterPresent 3E 00");
	      SendDiag_Request_Verify_Response(DiagAnchor3,"3E 00","7E 00");
}




testcase TCS_PK_FCA_AnchorUDSServer_ReadDataByIdentifier_NRC31_DIDFE1C_UWBRuntimeStats_DefaultSession_54620()
{
	testCaseComment("Precondition");
	TestStep("1","Send TesterPresent 3E 00 every 4000ms");
	      SendDiag_Request_Verify_Response(DiagAnchor3,"3E 00","7E 00");
	testCaseComment("Actions");
        TestStep("2","Send request 10 01 to enter default diagnostic session");
	      SendDiag_Request_Verify_Response(DiagAnchor3,"10 01","50 01 00 32 01 F4");
	TestStep("3","Send request 22 FE 1C to Read UWBRuntimeStats");
              SendDiag_Request_Verify_Negative_Response(DiagAnchor3,"22 FE 1C","7F 22 31");
	TestCaseComment("Postcondition");
        TestStep("4","Send request 10 01 to enter default diagnostic session");
	      SendDiag_Request_Verify_Response(DiagAnchor3,"10 01","50 01 00 32 01 F4");
        TestStep("5","Stop TesterPresent 3E 00");
	      SendDiag_Request_Verify_Response(DiagAnchor3,"3E 00","7E 00");
}



testcase TCS_PK_FCA_AnchorUDSServer_ReadDataByIdentifier_NRC31_DIDFE1C_UWBRuntimeStats_ProgrammingSession_BoschSecurityLevel_54621()
{
	testCaseComment("Precondition");
	TestStep("1","Send TesterPresent 3E 00 every 4000ms");
	      SendDiag_Request_Verify_Response(DiagAnchor3,"3E 00","7E 00");
        TestStep("2","Send request 10 01 to enter default diagnostic session");
	      SendDiag_Request_Verify_Response(DiagAnchor3,"10 01","50 01 00 32 01 F4");
        TestStep("3","Send request 10 03 to enter Extended Diagnostic Session");
	      SendDiag_Request_Verify_Response(DiagAnchor3,"10 03","50 03 00 32 01 F4");
        TestStep("4,5","Send security unlock request 61 and 62");   
       	      Security_Seed_Key_Access(Anch3,Physical,Bosch);
        testCaseComment("Actions");
	TestStep("6","Send request 10 02 to enter Programming Diagnostic Session");
	      SendDiag_Request_Verify_Response(DiagAnchor3,"10 02","50 02 00 32 01 F4");
        TestStep("7","Send request 22 FE 1C to Read UWBRuntimeStats");
              SendDiag_Request_Verify_Negative_Response(DiagAnchor3,"22 FE 1C","7F 22 31");
        TestCaseComment("Postcondition");
        TestStep("8","Send request 10 01 to enter default diagnostic session");
	      SendDiag_Request_Verify_Response(DiagAnchor3,"10 01","50 01 00 32 01 F4");
        TestStep("9","Stop TesterPresent 3E 00");
	      SendDiag_Request_Verify_Response(DiagAnchor3,"3E 00","7E 00");
}




testcase TCS_PK_FCA_AnchorUDSServer_ReadDataByIdentifier_NRC31_DIDFE25_SwupStatus_DefaultSession_54618()
{
	testCaseComment("Precondition");
	TestStep("1","Send TesterPresent 3E 00 every 4000ms");
	      SendDiag_Request_Verify_Response(DiagAnchor3,"3E 00","7E 00");
	testCaseComment("Actions");
        TestStep("2","Send request 10 01 to enter default diagnostic session");
	      SendDiag_Request_Verify_Response(DiagAnchor3,"10 01","50 01 00 32 01 F4");
	TestStep("3","Send request 22 FE 25 to Read SwupStatus");
              SendDiag_Request_Verify_Negative_Response(DiagAnchor3,"22 FE 25","7F 22 31");
	TestCaseComment("Postcondition");
        TestStep("4","Send request 10 01 to enter default diagnostic session");
	      SendDiag_Request_Verify_Response(DiagAnchor3,"10 01","50 01 00 32 01 F4");
        TestStep("5","Stop TesterPresent 3E 00");
	      SendDiag_Request_Verify_Response(DiagAnchor3,"3E 00","7E 00");
}




testcase TCS_PK_FCA_AnchorUDSServer_ReadDataByIdentifier_NRC31_DIDFE25_TimeSinceResetUWB_ExtendedSession_BoschSecurityLevel_54623()
{
	testCaseComment("Precondition");
	TestStep("1","Send TesterPresent 3E 00 every 4000ms");
	      SendDiag_Request_Verify_Response(DiagAnchor3,"3E 00","7E 00");
	TestStep("2","Send request 10 01 to enter default diagnostic session");
	      SendDiag_Request_Verify_Response(DiagAnchor3,"10 01","50 01 00 32 01 F4");
        testCaseComment("Actions");
	TestStep("3","Send request 10 03 to enter Extended Diagnostic Session");
	      SendDiag_Request_Verify_Response(DiagAnchor3,"10 03","50 03 00 32 01 F4");
  TestStep("4,5","Send security unlock request 61 and 62");   
       	      Security_Seed_Key_Access(Anch3,Physical,Bosch);
  TestStep("6","Send request 10 02 to enter Programming Diagnostic Session");
	      SendDiag_Request_Verify_Response(DiagAnchor3,"10 02","50 02 00 32 01 F4");
  TestStep("7","Send request 10 02 to enter Programming Diagnostic Session");
	      SendDiag_Request_Verify_Response(DiagAnchor3,"10 02","50 02 00 32 01 F4");
	TestStep("8","Send request 22 FE 25 to Read TimeSinceResetUWB");
              SendDiag_Request_Verify_Negative_Response(DiagAnchor3,"22 FE 25","7F 22 31");
	TestCaseComment("Postcondition");
        TestStep("9","Send request 10 01 to enter default diagnostic session");
	      SendDiag_Request_Verify_Response(DiagAnchor3,"10 01","50 01 00 32 01 F4");
        TestStep("10","Stop TesterPresent 3E 00");
	      SendDiag_Request_Verify_Response(DiagAnchor3,"3E 00","7E 00");
}


	
testcase TCS_PK_FCA_AnchorUDSServer_ReadDataByIdentifier_NRC31_DIDFE26_R4AppSignature_DefaultSession_54624()
{
	testCaseComment("Precondition");
	TestStep("1","Send TesterPresent 3E 00 every 4000ms");
	      SendDiag_Request_Verify_Response(DiagAnchor3,"3E 00","7E 00");
	testCaseComment("Actions");
	TestStep("2","Send request 10 01 to enter default diagnostic session");
	      SendDiag_Request_Verify_Response(DiagAnchor3,"10 01","50 01 00 32 01 F4");
	TestStep("3","Send request 22 FE 26 to Read R4AppSignature");
              SendDiag_Request_Verify_Negative_Response(DiagAnchor3,"22 FE 26","7F 22 31");
	TestCaseComment("Postcondition");
        TestStep("4","Stop TesterPresent 3E 00");
	      SendDiag_Request_Verify_Response(DiagAnchor3,"3E 00","7E 00");
}



testcase TCS_PK_FCA_AnchorUDSServer_ReadDataByIdentifier_NRC31_DIDFE26_R4AppSignature_ExtendedSession_BoschSecurityLevel_54622()
{
	testCaseComment("Precondition");
	TestStep("1","Send TesterPresent 3E 00 every 4000ms");
	      SendDiag_Request_Verify_Response(DiagAnchor3,"3E 00","7E 00");
        TestStep("2","Send request 10 01 to enter default diagnostic session");
	      SendDiag_Request_Verify_Response(DiagAnchor3,"10 01","50 01 00 32 01 F4");
        testCaseComment("Actions");
	TestStep("3","Send request 10 03 to enter Extended Diagnostic Session");
	      SendDiag_Request_Verify_Response(DiagAnchor3,"10 03","50 03 00 32 01 F4");
  TestStep("4,5","Send security unlock request 61 and 62");   
       	      Security_Seed_Key_Access(Anch3,Physical,Bosch);
  TestStep("6","Send request 10 02 to enter Programming Diagnostic Session");
	      SendDiag_Request_Verify_Response(DiagAnchor3,"10 02","50 02 00 32 01 F4");
  TestStep("7","Send request 10 02 to enter Programming Diagnostic Session");
	      SendDiag_Request_Verify_Response(DiagAnchor3,"10 02","50 02 00 32 01 F4");
        TestStep("8","Send request 22 FE 26 to Read R4AppSignature");
              SendDiag_Request_Verify_Negative_Response(DiagAnchor3,"22 FE 26","7F 22 31");
        TestCaseComment("Postcondition");
        TestStep("9","Send request 10 01 to enter default diagnostic session");
	      SendDiag_Request_Verify_Response(DiagAnchor3,"10 01","50 01 00 32 01 F4");
        TestStep("10","Stop TesterPresent 3E 00");
	      SendDiag_Request_Verify_Response(DiagAnchor3,"3E 00","7E 00");
}


testcase TCS_PK_FCA_AnchorUDSServer_ReadDataByIdentifier_NRC31_DIDFE27_R4DspSignature_DefaultSession_54626()
{
	testCaseComment("Precondition");
	TestStep("1","Send TesterPresent 3E 00 every 4000ms");
	      SendDiag_Request_Verify_Response(DiagAnchor3,"3E 00","7E 00");
	testCaseComment("Actions");
	TestStep("2","Send request 10 01 to enter default diagnostic session");
	      SendDiag_Request_Verify_Response(DiagAnchor3,"10 01","50 01 00 32 01 F4");
	TestStep("3","Send request 22 FE 27 to Read R4DspSignature");
              SendDiag_Request_Verify_Negative_Response(DiagAnchor3,"22 FE 27","7F 22 31");
	TestCaseComment("Postcondition");
        TestStep("4","Stop TesterPresent 3E 00");
	      SendDiag_Request_Verify_Response(DiagAnchor3,"3E 00","7E 00");
}



testcase TCS_PK_FCA_AnchorUDSServer_ReadDataByIdentifier_NRC31_DIDFE27_R4DspSignature_ExtendedSession_BoschSecurityLevel_54628()
{
  testCaseComment("Precondition");
  TestStep("1","Send request 3E 00 to send tester present periodically every 4sec");
  SendTesterPresent();
  TestStep("2","Send request 10 01 to enter Diagnostic Default Session ");
  SendDiag_Request_Verify_Response(DiagAnchor3,"10 01","50 01 00 32 01 F4");
  testCaseComment("Actions");
  TestStep("3","Send request 10 03 to enter the diagonistic extended sesssion ");
  SendDiag_Request_Verify_Response(DiagAnchor3,"10 03","50 03 00 32 01 F4");
  TestStep("4,5","Send security unlock request 61 and 62");   
       	      Security_Seed_Key_Access(Anch3,Physical,Bosch);
  TestStep("6","Send request 10 02 to enter Programming Diagnostic Session");
	      SendDiag_Request_Verify_Response(DiagAnchor3,"10 02","50 02 00 32 01 F4");
  TestStep("7","Send request 10 02 to enter Programming Diagnostic Session");
	      SendDiag_Request_Verify_Response(DiagAnchor3,"10 02","50 02 00 32 01 F4");
  TestStep("8","Send 22 FE 27 to enable ReadDataByIdentifier");
  SendDiag_Request_Verify_Negative_Response(DiagAnchor3,"22 FE 27","7F 22 31");
  testCaseComment("Post Condition");
  TestStep("9","Send request 10 01 to enter Diagnostic Default Session");
  SendDiag_Request_Verify_Response(DiagAnchor3,"10 01","50 01 00 32 01 F4");
  TestStep("10","Stop tester present 3E 00");
  StopTesterPresent();
   }
   
   
   
 
 testcase TCS_PK_FCA_AnchorUDSServer_ReadDataByIdentifier_NRC31_DIDFE33_BLEChipTemp_DefaultSession_54630()
{
  testCaseComment("Precondition");
  TestStep("1","Send request 3E 00 to send tester present periodically every 4sec");
  SendTesterPresent();
  testCaseComment("Actions");
  TestStep("2","Send request 10 01 to enter the diagonistic default sesssion ");
  SendDiag_Request_Verify_Response(DiagAnchor3,"10 01","50 01 00 32 01 F4");
  TestStep("3","Send 22 FE 33 to enable ReadDataByIdentifier");
  SendDiag_Request_Verify_Negative_Response(DiagAnchor3,"22 FE 33","7F 22 31");
  testCaseComment("Post Condition");
  TestStep("4","Send request 10 01 to enter Diagnostic Default Session");
  SendDiag_Request_Verify_Response(DiagAnchor3,"10 01","50 01 00 32 01 F4");
  TestStep("5","Stop tester present 3E 00");
  StopTesterPresent();
  }
 
 
 
 
 testcase TCS_PK_FCA_AnchorUDSServer_ReadDataByIdentifier_NRC31_DIDFE33_BLEChipTemp_ProgrammingSession_BoschSecurityLevel_54633()
{
  testCaseComment("Precondition");
  TestStep("1","Send request 3E 00 to send tester present periodically every 4sec");
  SendTesterPresent();
  TestStep("2","Send request 10 01 to enter the diagonistic default sesssion ");
  SendDiag_Request_Verify_Response(DiagAnchor3,"10 01","50 01 00 32 01 F4");
  TestStep("3","Send request 10 03 to enter the diagonistic extended sesssion ");
  SendDiag_Request_Verify_Response(DiagAnchor3,"10 03","50 03 00 32 01 F4");
  TestStep("4,5","Send security unlock request 61 and 62");
  Security_Seed_Key_Access(Anch3,Physical,Bosch);
  testCaseComment("Actions");
  TestStep("6","Send request 10 02 to enter the diagonistic programing sesssion ");
  SendDiag_Request_Verify_Response(DiagAnchor3,"10 02","50 02 00 32 01 F4");
  TestStep("7","Send 22 FE 33 to enable ReadDataByIdentifier");
  SendDiag_Request_Verify_Negative_Response(DiagAnchor3,"22 FE 33","7F 22 31");
  testCaseComment("Post Condition");
  TestStep("8","Send request 10 01 to enter Diagnostic Default Session");
  SendDiag_Request_Verify_Response(DiagAnchor3,"10 01","50 01 00 32 01 F4");
  TestStep("9","Stop tester present 3E 00");
  StopTesterPresent();
  
 }
 
 
 
 
 testcase TCS_PK_FCA_AnchorUDSServer_ReadDataByIdentifier_NRC31_DIDFE34_BLEResetCount_DefaultSession_54634()
{
  testCaseComment("Precondition");
  TestStep("1","Send request 3E 00 to send tester present periodically every 4sec");
  SendTesterPresent();
   testCaseComment("Actions");
  TestStep("2","Send request 10 01 to enter the diagonistic default sesssion ");
  SendDiag_Request_Verify_Response(DiagAnchor3,"10 01","50 01 00 32 01 F4");
  TestStep("3","Send 22 FE 34 to enable ReadDataByIdentifier");
  SendDiag_Request_Verify_Negative_Response(DiagAnchor3,"22 FE 34","7F 22 31");
  testCaseComment("Post Condition");
  TestStep("4","Send request 10 01 to enter Diagnostic Default Session");
  SendDiag_Request_Verify_Response(DiagAnchor3,"10 01","50 01 00 32 01 F4");
  TestStep("5","Stop tester present 3E 00");
  StopTesterPresent();
  
 }
 
 
 
 testcase TCS_PK_FCA_AnchorUDSServer_ReadDataByIdentifier_NRC31_DIDFE34_BLEResetCount_ProgrammingSession_BoschSecurityLevel_54636()
{
  testCaseComment("Precondition");
  TestStep("1","Send request 3E 00 to send tester present periodically every 4sec");
  SendTesterPresent();
  TestStep("2","Send request 10 01 to enter the diagonistic default sesssion ");
  SendDiag_Request_Verify_Response(DiagAnchor3,"10 01","50 01 00 32 01 F4");
  TestStep("3","Send request 10 03 to enter the diagonistic extended sesssion ");
  SendDiag_Request_Verify_Response(DiagAnchor3,"10 03","50 03 00 32 01 F4");
  TestStep("4,5","Send security unlock request 61 and 62");
  Security_Seed_Key_Access(Anch3,Physical,Bosch);
   testCaseComment("Actions");
  TestStep("6","Send request 10 02 to enter the diagonistic programming sesssion ");
  SendDiag_Request_Verify_Response(DiagAnchor3,"10 02","50 02 00 32 01 F4");
  TestStep("7","Send 22 FE 34 to enable ReadDataByIdentifier");
  SendDiag_Request_Verify_Negative_Response(DiagAnchor3,"22 FE 34","7F 22 31");
  testCaseComment("Post Condition");
  TestStep("8","Send request 10 01 to enter Diagnostic Default Session");
  SendDiag_Request_Verify_Response(DiagAnchor3,"10 01","50 01 00 32 01 F4");
  TestStep("9","Stop tester present 3E 00");
  StopTesterPresent();
  
 }
 
 
 
 
 testcase TCS_PK_FCA_AnchorUDSServer_ReadDataByIdentifier_NRC31_DIDFE35_Last10BLEResetCause_DefaultSession_54632()
{
  testCaseComment("Precondition");
  TestStep("1","Send request 3E 00 to send tester present periodically every 4sec");
  SendTesterPresent();
  testCaseComment("Actions");
  TestStep("2","Send request 10 01 to enter the diagonistic default sesssion ");
  SendDiag_Request_Verify_Response(DiagAnchor3,"10 01","50 01 00 32 01 F4");
  TestStep("3","Send 22 FE 35 to enable ReadDataByIdentifier");
  SendDiag_Request_Verify_Negative_Response(DiagAnchor3,"22 FE 35","7F 22 31");
  testCaseComment("Post Condition");
  TestStep("4","Send request 10 01 to enter Diagnostic Default Session");
  SendDiag_Request_Verify_Response(DiagAnchor3,"10 01","50 01 00 32 01 F4");
  TestStep("5","Stop tester present 3E 00");
  StopTesterPresent();
  
 }
 
 
 
 
 testcase TCS_PK_FCA_AnchorUDSServer_ReadDataByIdentifier_NRC31_DIDFE35_Last10BLEResetCause_ProgrammingSession_BoschSecurityLevel_54638()
{
  testCaseComment("Precondition");
  TestStep("1","Send request 3E 00 to send tester present periodically every 4sec");
  SendTesterPresent();
  TestStep("2","Send request 10 01 to enter the diagonistic default sesssion ");
  SendDiag_Request_Verify_Response(DiagAnchor3,"10 01","50 01 00 32 01 F4");
  TestStep("3","Send request 10 03 to enter the diagonistic extended sesssion ");
  SendDiag_Request_Verify_Response(DiagAnchor3,"10 03","50 03 00 32 01 F4");
  TestStep("4,5","Send security unlock request 61 and 62");
  Security_Seed_Key_Access(Anch3,Physical,Bosch);
  testCaseComment("Actions");
  TestStep("6","Send request 10 02 to enter the diagonistic programming sesssion ");
  SendDiag_Request_Verify_Response(DiagAnchor3,"10 02","50 02 00 32 01 F4");
  TestStep("7","Send 22 FE 35 to enable ReadDataByIdentifier");
  SendDiag_Request_Verify_Negative_Response(DiagAnchor3,"22 FE 35","7F 22 31");
  testCaseComment("Post Condition");
  TestStep("8","Send request 10 01 to enter Diagnostic Default Session");
  SendDiag_Request_Verify_Response(DiagAnchor3,"10 01","50 01 00 32 01 F4");
  TestStep("9","Stop tester present 3E 00");
  StopTesterPresent();
  
 }
 
 
 
 testcase TCS_PK_FCA_AnchorUDSServer_ReadDataByIdentifier_NRC31_DIDFE40_FirstFourBytesOfPublicKeys_DefaultSession_54639()
{
	testCaseComment("Precondition");
	TestStep("1","Send TesterPresent 3E 00 every 4000ms");
	SendDiag_Request_Verify_Response(DiagAnchor3,"3E 00","7E 00");
  testCaseComment("Actions");
  TestStep("2","Send request 10 01 to enter Default Diagnostic Session");
	SendDiag_Request_Verify_Response(DiagAnchor3,"10 01","50 01");
  TestStep("3","Send request 22 FE 40 to request ReadDataByIdentifier Service ");
	SendDiag_Request_Verify_Negative_Response(DiagAnchor3,"22 FE 40","7F 22 31");
  TestCaseComment("Postcondition");
  TestStep("4"," Stop Sending TesterPresent 3E 00 every 4000ms");
} 
 
 
 
testcase TCS_PK_FCA_AnchorUDSServer_ReadDataByID_NRC31_DIDFE40_FirstFourBytesOfPublicKeys_Programming_BoschSecurity_54637()
{
    testCaseComment("Precondition");
    TestStep("1","Send TesterPresent 3E 00 every 4000ms");
    SendDiag_Request_Verify_Response(DiagAnchor3,"3E 00","7E 00");
    TestStep("2","Send request 10 01 to enter default diagnostic session");
    SendDiag_Request_Verify_Response(DiagAnchor3,"10 01","50 01 00 32 01 F4");
  TestStep("3","Send request 10 03 to enter Extended Diagnostic Session");
    SendDiag_Request_Verify_Response(DiagAnchor3,"10 03","50 03 00 32 01 F4");
  TestStep("4,5","Send Security Seed Request 61 and Key 62 in DiagAnchor");  
  Security_Seed_Key_Access(Anch3,Physical,Bosch);
  testCaseComment("Actions");
  TestStep("6","Send request 10 02 to enter Programming Diagnostic Session");
    SendDiag_Request_Verify_Response(DiagAnchor3,"10 02","50 02 00 32 01 F4");
  TestStep("7","Send request 22 FE 40 to request ReadDataByIdentifier Service");
    SendDiag_Request_Verify_Negative_Response(DiagAnchor3,"22 FE 40","7F 22 31");
    TestCaseComment("Postcondition");
 TestStep("8"," Stop Sending TesterPresent 3E 00 every 4000ms");
   }	 	


testcase TCS_PK_FCA_AnchorUDSServer_ReadDataByIdentifier_NRC31_DIDFE43_BLEResolvablePrivateAddress_DefaultSession_54643()
{
	testCaseComment("Precondition");
	TestStep("1","Send TesterPresent 3E 00 every 4000ms");
	SendDiag_Request_Verify_Response(DiagAnchor3,"3E 00","7E 00");
  testCaseComment("Actions");
  TestStep("2","Send request 10 01 to enter Default Diagnostic Session");
	SendDiag_Request_Verify_Response(DiagAnchor3,"10 01","50 01");
  TestStep("3","Send request 22 FE 43 to request ReadDataByIdentifier Service ");
	SendDiag_Request_Verify_Negative_Response(DiagAnchor3,"22 FE 43","7F 22 31");
  TestCaseComment("Postcondition");
  TestStep("4"," Stop Sending TesterPresent 3E 00 every 4000ms");
}



testcase TCS_PK_FCA_AnchorUDSServer_ReadDataByID_NRC31_DIDFE43_BLEResolvablePrivateAddress_Programming_BoschSecurity_54646()
{
	testCaseComment("Precondition");
	TestStep("1","Send TesterPresent 3E 00 every 4000ms");
	SendDiag_Request_Verify_Response(DiagAnchor3,"3E 00","7E 00");
	TestStep("2","Send request 10 01 to enter default diagnostic session");
	SendDiag_Request_Verify_Response(DiagAnchor3,"10 01","50 01 00 32 01 F4");
  TestStep("3","Send request 10 03 to enter Extended Diagnostic Session");
	SendDiag_Request_Verify_Response(DiagAnchor3,"10 03","50 03 00 32 01 F4");
  TestStep("4,5","Send Security Seed Request 61 and Key 62 in DiagAnchor");  
  Security_Seed_Key_Access(Anch3,Physical,Bosch);
  testCaseComment("Actions");
  TestStep("6","Send request 10 02 to enter Programming Diagnostic Session");
	SendDiag_Request_Verify_Response(DiagAnchor3,"10 02","50 02 00 32 01 F4");
  TestStep("7","Send request 22 FE 43 to request ReadDataByIdentifier Service");
	SendDiag_Request_Verify_Negative_Response(DiagAnchor3,"22 FE 43","7F 22 31");
	TestCaseComment("Postcondition");
	TestStep("8","Send request 10 01 to enter default diagnostic session");
	SendDiag_Request_Verify_Response(DiagAnchor3,"10 01","50 01 00 32 01 F4");
	}	 	
 


testcase TCS_PK_FCA_AnchorUDSServer_ReadDataByIdentifier_NRC31_DIDFEA1_AnchorIDTestMode_DefaultSession_54647()
{
  testCaseComment("Precondition");
  TestStep("1","Send request 3E 00 to send tester present periodically every 4sec");
  SendTesterPresent();
  testCaseComment("Actions");
  TestStep("2","Send request 10 01 to enter the diagonistic default sesssion ");
  SendDiag_Request_Verify_Response(DiagAnchor3,"10 01","50 01 00 32 01 F4");
  TestStep("3","Send 22 FE A1 to enable ReadDataByIdentifier");
  SendDiag_Request_Verify_Negative_Response(DiagAnchor3,"22 FE A1","7F 22 31");
  testCaseComment("Post Condition");
  TestStep("4","Send request 10 01 to enter Diagnostic Default Session");
  SendDiag_Request_Verify_Response(DiagAnchor3,"10 01","50 01 00 32 01 F4");
  TestStep("5","Stop tester present 3E 00");
  StopTesterPresent();
   }
   
   
   
   testcase TCS_PK_FCA_AnchorUDSServer_ReadDataByIdentifier_NRC31_DIDFEA1_AnchorIDTestMode_ProgrammingSession_BoschSecurityLevel_54648()
{
	testCaseComment("Precondition");
	TestStep("1","Send TesterPresent 3E 00 every 4000ms");
	SendDiag_Request_Verify_Response(DiagAnchor3,"3E 00","7E 00");
	TestStep("2","Send request 10 01 to enter default diagnostic session");
	SendDiag_Request_Verify_Response(DiagAnchor3,"10 01","50 01 00 32 01 F4");
  TestStep("3","Send request 10 03 to enter Extended Diagnostic Session");
	SendDiag_Request_Verify_Response(DiagAnchor3,"10 03","50 03 00 32 01 F4");
  TestStep("4,5","Send Security Seed Request 61 and Key 62 in DiagAnchor");  
  Security_Seed_Key_Access(Anch3,Physical,Bosch);
  testCaseComment("Actions");
  TestStep("6","Send request 10 02 to enter Programming Diagnostic Session");
	SendDiag_Request_Verify_Response(DiagAnchor3,"10 02","50 02 00 32 01 F4");
  TestStep("7","Send request 22 FE A1 to request ReadDataByIdentifier Service");
	SendDiag_Request_Verify_Negative_Response(DiagAnchor3,"22 FE A1","7F 22 31");
	TestCaseComment("Postcondition");
	TestStep("8","Send request 10 01 to enter default diagnostic session");
	SendDiag_Request_Verify_Response(DiagAnchor3,"10 01","50 01 00 32 01 F4");
	}


testcase TCS_PK_FCA_AnchorUDSServer_ReadDataByIdentifier_NRC31_DIDFEA4_RFTestMode_DefaultSession_54644()
{
  testCaseComment("Precondition");
  TestStep("1","Send request 3E 00 to send tester present periodically every 4sec");
  SendTesterPresent();
  testCaseComment("Actions");
  TestStep("2","Send request 10 01 to enter the diagonistic default sesssion ");
  SendDiag_Request_Verify_Response(DiagAnchor3,"10 01","50 01 00 32 01 F4");
  TestStep("3","Send 22 FE A4 to enable ReadDataByIdentifier");
  SendDiag_Request_Verify_Negative_Response(DiagAnchor3,"22 FE A4","7F 22 31");
  testCaseComment("Post Condition");
  TestStep("4","Send request 10 01 to enter Diagnostic Default Session");
  SendDiag_Request_Verify_Response(DiagAnchor3,"10 01","50 01 00 32 01 F4");
  TestStep("5","Stop tester present 3E 00");
  StopTesterPresent();
   }
   
   
   
  testcase TCS_PK_FCA_AnchorUDSServer_ReadDataByIdentifier_NRC31_DIDFEA4_RFTestMode_ProgrammingSession_BoschSecurityLevel_54650()
{
	testCaseComment("Precondition");
	TestStep("1","Send TesterPresent 3E 00 every 4000ms");
	SendDiag_Request_Verify_Response(DiagAnchor3,"3E 00","7E 00");
	TestStep("2","Send request 10 01 to enter default diagnostic session");
	SendDiag_Request_Verify_Response(DiagAnchor3,"10 01","50 01 00 32 01 F4");
  TestStep("3","Send request 10 03 to enter Extended Diagnostic Session");
	SendDiag_Request_Verify_Response(DiagAnchor3,"10 03","50 03 00 32 01 F4");
  TestStep("4,5","Send Security Seed Request 61 and Key 62 in DiagAnchor");  
  Security_Seed_Key_Access(Anch3,Physical,Bosch);
  testCaseComment("Actions");
  TestStep("6","Send request 10 02 to enter Programming Diagnostic Session");
	SendDiag_Request_Verify_Response(DiagAnchor3,"10 02","50 02 00 32 01 F4");
  TestStep("7","Send request 22 FE A4 to request ReadDataByIdentifier Service");
	SendDiag_Request_Verify_Negative_Response(DiagAnchor3,"22 FE A4","7F 22 31");
	TestCaseComment("Postcondition");
	TestStep("8","Send request 10 01 to enter default diagnostic session");
	SendDiag_Request_Verify_Response(DiagAnchor3,"10 01","50 01 00 32 01 F4");
	}  
   
	

testcase TCS_PK_FCA_AnchorUDSServer_ReadDataByIdentifier_NRC31_DIDFEB0_UWBPropagationDelayCalibration_DefaultSession_54653()
{
	testCaseComment("Precondition");
	TestStep("1","Send TesterPresent 3E 00 every 4000ms");
	SendDiag_Request_Verify_Response(DiagAnchor3,"3E 00","7E 00");
  testCaseComment("Actions");
  TestStep("2","Send request 10 01 to enter Default Diagnostic Session");
	SendDiag_Request_Verify_Response(DiagAnchor3,"10 01","50 01");
  TestStep("3","Send request 22 FE B0 to request ReadDataByIdentifier Service ");
	SendDiag_Request_Verify_Negative_Response(DiagAnchor3,"22 FE B0","7F 22 31");
  TestCaseComment("Postcondition");
  TestStep("4"," Stop Sending TesterPresent 3E 00 every 4000ms");
}



testcase TCS_PK_FCA_AnchorUDSServer_ReadDataByID_NRC31_DIDFEB0_UWBPropagationDelayCalibration_Programming_BoschSecurity_54649()
{
	testCaseComment("Precondition");
	TestStep("1","Send TesterPresent 3E 00 every 4000ms");
	SendDiag_Request_Verify_Response(DiagAnchor3,"3E 00","7E 00");
	TestStep("2","Send request 10 01 to enter default diagnostic session");
	SendDiag_Request_Verify_Response(DiagAnchor3,"10 01","50 01 00 32 01 F4");
  TestStep("3","Send request 10 03 to enter Extended Diagnostic Session");
	SendDiag_Request_Verify_Response(DiagAnchor3,"10 03","50 03 00 32 01 F4");
  TestStep("4,5","Send Security Seed Request 61 and Key 62 in DiagAnchor");  
  Security_Seed_Key_Access(Anch3,Physical,Bosch);
  testCaseComment("Actions");
  TestStep("6","Send request 10 02 to enter Programming Diagnostic Session");
	SendDiag_Request_Verify_Response(DiagAnchor3,"10 02","50 02 00 32 01 F4");
  TestStep("7","Send request 22 FE B0 to request ReadDataByIdentifier Service");
	SendDiag_Request_Verify_Negative_Response(DiagAnchor3,"22 FE B0","7F 22 31");
	TestCaseComment("Postcondition");
	TestStep("8","Send request 10 01 to enter default diagnostic session");
	SendDiag_Request_Verify_Response(DiagAnchor3,"10 01","50 01 00 32 01 F4");
	} 



testcase TCS_PK_FCA_AnchorUDSServer_ReadDataByIdentifier_NRC31_DIDFEB1_UWBRadioTXPower_DefaultSession_54654()
{
	testCaseComment("Precondition");
	TestStep("1","Send TesterPresent 3E 00 every 4000ms");
	SendDiag_Request_Verify_Response(DiagAnchor3,"3E 00","7E 00");
  testCaseComment("Actions");
  TestStep("2","Send request 10 01 to enter Default Diagnostic Session");
	SendDiag_Request_Verify_Response(DiagAnchor3,"10 01","50 01");
  TestStep("3","Send request 22 FE B1 to request ReadDataByIdentifier Service ");
	SendDiag_Request_Verify_Negative_Response(DiagAnchor3,"22 FE B1","7F 22 31");
  TestCaseComment("Postcondition");
  TestStep("4"," Stop Sending TesterPresent 3E 00 every 4000ms");
} 



testcase TCS_PK_FCA_AnchorUDSServer_ReadDataByIdentifier_NRC31_DIDFEB1_UWBRadioTXPower_ProgrammingSession_BoschSecurityLevel_54656()
{
	testCaseComment("Precondition");
	TestStep("1","Send TesterPresent 3E 00 every 4000ms");
	SendDiag_Request_Verify_Response(DiagAnchor3,"3E 00","7E 00");
	TestStep("2","Send request 10 01 to enter default diagnostic session");
	SendDiag_Request_Verify_Response(DiagAnchor3,"10 01","50 01 00 32 01 F4");
  TestStep("3","Send request 10 03 to enter Extended Diagnostic Session");
	SendDiag_Request_Verify_Response(DiagAnchor3,"10 03","50 03 00 32 01 F4");
  TestStep("4,5","Send Security Seed Request 61 and Key 62 in DiagAnchor");  
  Security_Seed_Key_Access(Anch3,Physical,Bosch);
  testCaseComment("Actions");
  TestStep("6","Send request 10 02 to enter Programming Diagnostic Session");
	SendDiag_Request_Verify_Response(DiagAnchor3,"10 02","50 02 00 32 01 F4");
  TestStep("7","Send request 22 FE B1 to request ReadDataByIdentifier Service");
	SendDiag_Request_Verify_Negative_Response(DiagAnchor3,"22 FE B1","7F 22 31");
	TestCaseComment("Postcondition");
	TestStep("8","Send request 10 01 to enter default diagnostic session");
	SendDiag_Request_Verify_Response(DiagAnchor3,"10 01","50 01 00 32 01 F4");
	} 



testcase TCS_PK_FCA_AnchorUDSServer_ReadDataByIdentifier_NRC31_DIDFEB2_UWBCentreFrequencyCalibrationBaseOffset_DefaultSession_54657()
{
	testCaseComment("Precondition");
	TestStep("1","Send TesterPresent 3E 00 every 4000ms");
	SendDiag_Request_Verify_Response(DiagAnchor3,"3E 00","7E 00");
  testCaseComment("Actions");
  TestStep("2","Send request 10 01 to enter Default Diagnostic Session");
	SendDiag_Request_Verify_Response(DiagAnchor3,"10 01","50 01");
  TestStep("3","Send request 22 FE B2 to request ReadDataByIdentifier Service ");
	SendDiag_Request_Verify_Negative_Response(DiagAnchor3,"22 FE B2","7F 22 31");
  TestCaseComment("Postcondition");
  TestStep("4"," Stop Sending TesterPresent 3E 00 every 4000ms");
}



testcase TCS_PK_FCA_AnchorUDSServer_ReadDataByID_NRC31_DIDFEB2_UWBCentreFrequencyCalibrationBaseOffset_Programmin_BoschSecurity_54659()
{
	testCaseComment("Precondition");
	TestStep("1","Send TesterPresent 3E 00 every 4000ms");
	SendDiag_Request_Verify_Response(DiagAnchor3,"3E 00","7E 00");
	TestStep("2","Send request 10 01 to enter default diagnostic session");
	SendDiag_Request_Verify_Response(DiagAnchor3,"10 01","50 01 00 32 01 F4");
  TestStep("3","Send request 10 03 to enter Extended Diagnostic Session");
	SendDiag_Request_Verify_Response(DiagAnchor3,"10 03","50 03 00 32 01 F4");
  TestStep("4,5","Send Security Seed Request 61 and Key 62 in DiagAnchor");  
  Security_Seed_Key_Access(Anch3,Physical,Bosch);
  testCaseComment("Actions");
  TestStep("6","Send request 10 02 to enter Programming Diagnostic Session");
	SendDiag_Request_Verify_Response(DiagAnchor3,"10 02","50 02 00 32 01 F4");
  TestStep("7","Send request 22 FE B2 to request ReadDataByIdentifier Service");
	SendDiag_Request_Verify_Negative_Response(DiagAnchor3,"22 FE B2","7F 22 31");
	TestCaseComment("Postcondition");
	TestStep("8","Send request 10 01 to enter default diagnostic session");
	SendDiag_Request_Verify_Response(DiagAnchor3,"10 01","50 01 00 32 01 F4");
	}


testcase TCS_PK_FCA_AnchorUDSServer_ReadDataByIdentifier_NRC31_DIDFED8_AnchorTeachType_DefaultSession_54660()
{
	testCaseComment("Precondition");
	TestStep("1","Send TesterPresent 3E 00 every 4000ms");
	SendDiag_Request_Verify_Response(DiagAnchor3,"3E 00","7E 00");
  testCaseComment("Actions");
  TestStep("2","Send request 10 01 to enter Default Diagnostic Session");
	SendDiag_Request_Verify_Response(DiagAnchor3,"10 01","50 01");
  TestStep("3","Send request 22 FE D8 to request ReadDataByIdentifier Service ");
	SendDiag_Request_Verify_Negative_Response(DiagAnchor3,"22 FE D8","7F 22 31");
  TestCaseComment("Postcondition");
  TestStep("4"," Stop Sending TesterPresent 3E 00 every 4000ms");
}



testcase TCS_PK_FCA_AnchorUDSServer_ReadDataByIdentifier_NRC31_DIDFED8_AnchorTeachType_ProgrammingSession_BoschSecurityLevel_54661()
{
	testCaseComment("Precondition");
	TestStep("1","Send TesterPresent 3E 00 every 4000ms");
	SendDiag_Request_Verify_Response(DiagAnchor3,"3E 00","7E 00");
	TestStep("2","Send request 10 01 to enter default diagnostic session");
	SendDiag_Request_Verify_Response(DiagAnchor3,"10 01","50 01 00 32 01 F4");
  TestStep("3","Send request 10 03 to enter Extended Diagnostic Session");
	SendDiag_Request_Verify_Response(DiagAnchor3,"10 03","50 03 00 32 01 F4");
  TestStep("4,5","Send Security Seed Request 61 and Key 62 in DiagAnchor");  
  Security_Seed_Key_Access(Anch3,Physical,Bosch);
  testCaseComment("Actions");
  TestStep("6","Send request 10 02 to enter Programming Diagnostic Session");
	SendDiag_Request_Verify_Response(DiagAnchor3,"10 02","50 02 00 32 01 F4");
  TestStep("7","Send request 22 FE D8 to request ReadDataByIdentifier Service");
	SendDiag_Request_Verify_Negative_Response(DiagAnchor3,"22 FE D8","7F 22 31");
	TestCaseComment("Postcondition");
	TestStep("8","Send request 10 01 to enter default diagnostic session");
	SendDiag_Request_Verify_Response(DiagAnchor3,"10 01","50 01 00 32 01 F4");
	}
	

testcase TCS_PK_FCA_AnchorUDSServer_ReadDataByIdentifier_NRC31_DIDFED9_PositionIdx_DefaultSession_54662()
{
	testCaseComment("Precondition");
	TestStep("1","Send TesterPresent 3E 00 every 4000ms");
	SendDiag_Request_Verify_Response(DiagAnchor3,"3E 00","7E 00");
  testCaseComment("Actions");
  TestStep("2","Send request 10 01 to enter Default Diagnostic Session");
	SendDiag_Request_Verify_Response(DiagAnchor3,"10 01","50 01");
  TestStep("3","Send request 22 FE D9 to request ReadDataByIdentifier Service ");
	SendDiag_Request_Verify_Negative_Response(DiagAnchor3,"22 FE D9","7F 22 31");
  TestCaseComment("Postcondition");
  TestStep("4"," Stop Sending TesterPresent 3E 00 every 4000ms");
}



testcase TCS_PK_FCA_AnchorUDSServer_ReadDataByIdentifier_NRC31_DIDFED9_PositionIdx_ProgrammingSession_BoschSecurityLevel_54663()
{
	testCaseComment("Precondition");
	TestStep("1","Send TesterPresent 3E 00 every 4000ms");
	SendDiag_Request_Verify_Response(DiagAnchor3,"3E 00","7E 00");
	TestStep("2","Send request 10 01 to enter default diagnostic session");
	SendDiag_Request_Verify_Response(DiagAnchor3,"10 01","50 01 00 32 01 F4");
  TestStep("3","Send request 10 03 to enter Extended Diagnostic Session");
	SendDiag_Request_Verify_Response(DiagAnchor3,"10 03","50 03 00 32 01 F4");
  TestStep("4,5","Send Security Seed Request 61 and Key 62 in DiagAnchor");  
  Security_Seed_Key_Access(Anch3,Physical,Bosch);
  testCaseComment("Actions");
  TestStep("6","Send request 10 02 to enter Programming Diagnostic Session");
	SendDiag_Request_Verify_Response(DiagAnchor3,"10 02","50 02 00 32 01 F4");
  TestStep("7","Send request 22 FE D9 to request ReadDataByIdentifier Service");
	SendDiag_Request_Verify_Negative_Response(DiagAnchor3,"22 FE D9","7F 22 31");
	TestCaseComment("Postcondition");
	TestStep("8","Send request 10 01 to enter default diagnostic session");
	SendDiag_Request_Verify_Response(DiagAnchor3,"10 01","50 01 00 32 01 F4");
	}


testcase TCS_PK_FCA_AnchorUDSServer_ReadDataByIdentifier_NRC31_DIDFEE0_ECUCompatibilityNumber_DefaultSession_54665()
{
	testCaseComment("Precondition");
	TestStep("1","Send TesterPresent 3E 00 every 4000ms");
	SendDiag_Request_Verify_Response(DiagAnchor3,"3E 00","7E 00");
  testCaseComment("Actions");
  TestStep("2","Send request 10 01 to enter Default Diagnostic Session");
	SendDiag_Request_Verify_Response(DiagAnchor3,"10 01","50 01");
  TestStep("3","Send request 22 FE E0 to request ReadDataByIdentifier Service");
	SendDiag_Request_Verify_Negative_Response(DiagAnchor3,"22 FE E0","7F 22 31");
  TestCaseComment("Postcondition");
  TestStep("4"," Stop Sending TesterPresent 3E 00 every 4000ms");
}



testcase TCS_PK_FCA_AnchorUDSServer_ReadDataByIdentifier_NRC31_DIDFEE0_ECUCompatibilityNumber_ProgrammingSession_BoschSecurityLevel_54667()
{
	testCaseComment("Precondition");
	TestStep("1","Send TesterPresent 3E 00 every 4000ms");
	SendDiag_Request_Verify_Response(DiagAnchor3,"3E 00","7E 00");
	TestStep("2","Send request 10 01 to enter default diagnostic session");
	SendDiag_Request_Verify_Response(DiagAnchor3,"10 01","50 01 00 32 01 F4");
  TestStep("3","Send request 10 03 to enter Extended Diagnostic Session");
	SendDiag_Request_Verify_Response(DiagAnchor3,"10 03","50 03 00 32 01 F4");
  TestStep("4,5","Send Security Seed Request 61 and Key 62 in DiagAnchor");  
  Security_Seed_Key_Access(Anch3,Physical,Bosch);
  testCaseComment("Actions");
  TestStep("6","Send request 10 02 to enter Programming Diagnostic Session");
	SendDiag_Request_Verify_Response(DiagAnchor3,"10 02","50 02 00 32 01 F4");
  TestStep("7","Send request 22 FE E0 to request ReadDataByIdentifier Service");
	SendDiag_Request_Verify_Negative_Response(DiagAnchor3,"22 FE E0","7F 22 31");
	TestCaseComment("Postcondition");
	TestStep("8","Send request 10 01 to enter default diagnostic session");
	SendDiag_Request_Verify_Response(DiagAnchor3,"10 01","50 01 00 32 01 F4");
	}



testcase TCS_PK_FCA_AnchorUDSServer_ReadDataByIdentifier_NRC31_DIDFEE1_ECUChipVersions_DefaultSession_54664()
{
	testCaseComment("Precondition");
	TestStep("1","Send TesterPresent 3E 00 every 4000ms");
	SendDiag_Request_Verify_Response(DiagAnchor3,"3E 00","7E 00");
  testCaseComment("Actions");
  TestStep("2","Send request 10 01 to enter Default Diagnostic Session");
	SendDiag_Request_Verify_Response(DiagAnchor3,"10 01","50 01");
  TestStep("3","Send request 22 FE E1 to request ReadDataByIdentifier Service ");
	SendDiag_Request_Verify_Negative_Response(DiagAnchor3,"22 FE E1","7F 22 31");
  TestCaseComment("Postcondition");
  TestStep("4"," Stop Sending TesterPresent 3E 00 every 4000ms");
}




testcase TCS_PK_FCA_AnchorUDSServer_ReadDataByIdentifier_NRC31_DIDFEE1_ECUChipVersions_ProgrammingSession_BoschSecurityLevel_54668()
{
    testCaseComment("Precondition");
    TestStep("1","Send TesterPresent 3E 00 every 4000ms");
    SendDiag_Request_Verify_Response(DiagAnchor3,"3E 00","7E 00");
    TestStep("2","Send request 10 01 to enter default diagnostic session");
    SendDiag_Request_Verify_Response(DiagAnchor3,"10 01","50 01 00 32 01 F4");
    TestStep("3","Send request 10 03 to enter Extended Diagnostic Session");
    SendDiag_Request_Verify_Response(DiagAnchor3,"10 03","50 03 00 32 01 F4");
    TestStep("4,5","Send Security Seed Request 61 and Key 62 in DiagAnchor");  
    Security_Seed_Key_Access(Anch3,Physical,Bosch);
    TestCaseComment("Actions");
    TestStep("6","Send request 10 02 to enter Programming Diagnostic Session");
    SendDiag_Request_Verify_Response(DiagAnchor3,"10 02","50 02 00 32 01 F4");
    TestStep("7","Send request 22 FE E1 to request ReadDataByIdentifier Service");
    SendDiag_Request_Verify_Negative_Response(DiagAnchor3,"22 FE E1","7F FE E1 31");
    TestCaseComment("Postcondition");
    TestStep("8","Send request 10 01 to enter default diagnostic session");
    SendDiag_Request_Verify_Response(DiagAnchor3,"10 01","50 01 00 32 01 F4");
}



testcase TCS_PK_FCA_AnchorUDSServer_ReadDataByIdentifier_NRC31_DIDFEFF_XCPEnable_DefaultSession_48243()
{
    testCaseComment("Precondition");
    TestStep("1","Send TesterPresent 3E 00 every 4000ms");
    SendDiag_Request_Verify_Response(DiagAnchor3,"3E 00","7E 00");
    testCaseComment("Actions");
    TestStep("2","Send request 10 01 to enter default diagnostic session");
    SendDiag_Request_Verify_Response(DiagAnchor3,"10 01","50 01 00 32 01 F4");
    TestStep("3","Send request 22 FE FF to request ReadDataByIdentifier Service");
    SendDiag_Request_Verify_Negative_Response(DiagAnchor3,"22 FE FF","7F 22 31");
    TestCaseComment("Postcondition");
    TestStep("4","Send request 3E 00 Stop sending TesterPresent ");
    SendDiag_Request_Verify_Response(DiagAnchor3,"3E 00","7E 00");
}




testcase TCS_PK_FCA_AnchorUDSServer_ReadDataByIdentifier_NRC31_DIDFEFF_XCPEnable_ExtendedSession_NoSecurityLevel_54745()
{
    testCaseComment("Precondition");
    TestStep("1","Send TesterPresent 3E 00 every 2000ms");
    SendDiag_Request_Verify_Response(DiagAnchor3,"3E 00","7E 00");
    TestStep("2","Send request 10 01 to enter default diagnostic session");
    SendDiag_Request_Verify_Response(DiagAnchor3,"10 01","50 01 00 32 01 F4");
    testCaseComment("Actions");
    TestStep("3","Send request 10 03 to enter Extended Diagnostic Session");
    SendDiag_Request_Verify_Response(DiagAnchor3,"10 03","50 03 00 32 01 F4");
    TestStep("4","Send request 22 FE FF to request ReadDataByIdentifier Service");
    SendDiag_Request_Verify_Negative_Response(DiagAnchor3,"22 FE FF","7F 22 31");
    TestCaseComment("Postcondition");
    TestStep("5","Send request 10 01 to enter default diagnostic session");
    SendDiag_Request_Verify_Response(DiagAnchor3,"10 01","50 01 00 32 01 F4");
}




testcase TCS_PK_FCA_AnchorUDSServer_ReadDataByIdentifier_NRC31_DIDFEFF_XCPEnable_ProgrammingSession_NoSecurityLevell_22515()
{
    testCaseComment("Precondition");
    TestStep("1","Send TesterPresent 3E 00 every 2000ms");
    SendDiag_Request_Verify_Response(DiagAnchor3,"3E 00","7E 00");
    TestStep("2","Send request 10 01 to enter default diagnostic session");
    SendDiag_Request_Verify_Response(DiagAnchor3,"10 01","50 01");
    TestStep("3","Send request 10 03 to enter Extended Diagnostic Session");
    SendDiag_Request_Verify_Response(DiagAnchor3,"10 03","50 03");
    TestStep("4,5","Send Security Seed Request 61 and Key 62 in DiagAnchor");  
    Security_Seed_Key_Access(Anch3,Physical,Bosch);
testCaseComment("Actions");
    TestStep("6","Send request 10 02 to enter Programming Diagnostic Session");
    SendDiag_Request_Verify_Response(DiagAnchor3,"10 02","50 02 00 32 01 F4");
TestStep("7","Send request 10 02 to enter Programming Diagnostic Session");
    SendDiag_Request_Verify_Response(DiagAnchor3,"10 02","50 02 00 32 01 F4");
    TestStep("8","Send request 22 FE FF to request ReadDataByIdentifier Service");
    SendDiag_Request_Verify_Negative_Response(DiagAnchor3,"22 FE FF","7F 22 31");
 TestCaseComment("Postcondition");
    TestStep("9","Send request 10 01 to enter default diagnostic session");
    SendDiag_Request_Verify_Response(DiagAnchor3,"10 01","50 01");
}




testcase TCS_PK_FCA_AnchorUDSServer_ReadDataByIdentifier_NRC31_UnsupportedDID_DefaultSession_54672()
{
    testCaseComment("Precondition");
    TestStep("1","Send TesterPresent 3E 00 every 4000ms");
SendDiag_Request_Verify_Response(DiagAnchor3,"3E 00","7E 00");
    testCaseComment("Actions");
    TestStep("2","Send request 10 01 to enter default diagnostic session");
    SendDiag_Request_Verify_Response(DiagAnchor3,"10 01","50 01");
    TestStep("3","Send request 22 00 00 to request an unsupported DID ReadDataByIdentifier Service");
    SendDiag_Request_Verify_Negative_Response(DiagAnchor3,"22 00 00","7F 22 31");
    TestStep("4","Send request 22 AA AA to request an unsupported DID ReadDataByIdentifier Service");
    SendDiag_Request_Verify_Negative_Response(DiagAnchor3,"22 AA AA","7F 22 31");
    TestStep("5","Send request 22 FF FF to request an unsupported DID ReadDataByIdentifier Service");
    SendDiag_Request_Verify_Negative_Response(DiagAnchor3,"22 FF FF","7F 22 31");
TestCaseComment("Postcondition");
    TestStep("5","Send request 10 01 to enter default diagnostic session");
    SendDiag_Request_Verify_Response(DiagAnchor3,"10 01","50 01 00 32 01 F4");
}


testcase TCS_PK_FCA_AnchorUDSServer_ReadDataByIdentifier_NRC31_UnsupportedDID_ExtendedSession_NoSecurityLevell_54675()
{
    testCaseComment("Precondition");
    TestStep("1","Send TesterPresent 3E 00 every 4000ms");
    SendDiag_Request_Verify_Response(DiagAnchor3,"3E 00","7E 00");
    TestStep("2","Send request 10 01 to enter default diagnostic session");
    SendDiag_Request_Verify_Response(DiagAnchor3,"10 01","50 01");
     testCaseComment("Actions");
    TestStep("3","Send request 10 03 to enter Extended Diagnostic Session");
    SendDiag_Request_Verify_Response(DiagAnchor3,"10 03","50 03");
    TestStep("3","Send request 22 00 00 to request an unsupported DID ReadDataByIdentifier Service");
    SendDiag_Request_Verify_Negative_Response(DiagAnchor3,"22 00 00","7F 22 31");
    TestStep("4","Send request 22 AA AA to request an unsupported DID ReadDataByIdentifier Service");
    SendDiag_Request_Verify_Negative_Response(DiagAnchor3,"22 AA AA","7F 22 31");
    TestStep("5","Send request 22 FF FF to request an unsupported DID ReadDataByIdentifier Service");
    SendDiag_Request_Verify_Negative_Response(DiagAnchor3,"22 FF FF","7F 22 31");
TestCaseComment("Postcondition");
    TestStep("6","Send request 10 01 to enter default diagnostic session");
    SendDiag_Request_Verify_Response(DiagAnchor3,"10 01","50 01");
}



testcase TCS_PK_FCA_AnchorUDSServer_ReadDataByIdentifier_NRC31_UnsupportedDID_ExtendedSession_NoSecurityLevel_54676()
{
    testCaseComment("Precondition");
    TestStep("1","Send TesterPresent 3E 00 every 4000ms");
    SendDiag_Request_Verify_Response(DiagAnchor3,"3E 00","7E 00");
    TestStep("2","Send request 10 01 to enter default diagnostic session");
    SendDiag_Request_Verify_Response(DiagAnchor3,"10 01","50 01");
    TestStep("3","Send request 10 03 to enter Extended Diagnostic Session");
    SendDiag_Request_Verify_Response(DiagAnchor3,"10 03","50 03");
    TestStep("4,5","Send Security Seed Request 61 and Key 62 in DiagAnchor");  
    Security_Seed_Key_Access(Anch3,Physical,Bosch);
 testCaseComment("Actions");
    TestStep("6","Send request 10 02 to enter Programming Diagnostic Session");
    SendDiag_Request_Verify_Response(DiagAnchor3,"10 02","50 02");
    TestStep("7","Send request 22 00 00 to request ReadDataByIdentifier Service");
    SendDiag_Request_Verify_Negative_Response(DiagAnchor3,"22 00 00","7F 22 31");
    TestStep("8","Send request 22 AA AA to request ReadDataByIdentifier Service");
    SendDiag_Request_Verify_Negative_Response(DiagAnchor3,"22 AA AA","7F 22 31");
    TestStep("9","Send request 22 FE FF to request ReadDataByIdentifier Service");
    SendDiag_Request_Verify_Negative_Response(DiagAnchor3,"22 FE FF","7F 22 31");
    TestCaseComment("Postcondition");
    TestStep("9","Send request 10 01 to enter default diagnostic session");
    SendDiag_Request_Verify_Response(DiagAnchor3,"10 01","50 01");
}







///////////////////////WriteDataByIdentifier_NRC33/////////////////////////



testcase TCS_PK_FCA_AnchorUDSServer_WriteDataByID_NRC33_DIDFE03_BLEAddress_Extended_NoSecurityAnd0x65Security_35145()
{
 testCaseComment("Precondition");
	TestStep("1","Send TesterPresent 3E 00 every 4000ms");
	      SendDiag_Request_Verify_Response(DiagAnchor3,"3E 00","7E 00");
       	TestStep("2","Send request 10 01 to enter default diagnostic session");
	      SendDiag_Request_Verify_Response(DiagAnchor3,"10 01","50 01 00 32 01 F4");
  testCaseComment("Actions");
  TestStep("3","Send request 10 03 to enter Extended Diagnostic Session");
	SendDiag_Request_Verify_Response(DiagAnchor3,"10 03","50 03 00 32 01 F4");
   TestStep("4","Send request 2E FE 03 C0 00 00 00 00 01 to request WriteDataByIdentifier Service");
	SendDiag_Request_Verify_Negative_Response(DiagAnchor3,"2E FE 03 0C 00 00 00 00 01","7F 2E 33");
	 TestStep("5,6","Send Security Seed Request 65 and Key 66 in DiagAnchor");  
  Security_Seed_Key_Access(Anch3,Physical,Incar_1);
  TestStep("7","Send request 2E FE 03 0C 00 00 00 00 01 to WriteDataByIdentifier");
        SendDiag_Request_Verify_Negative_Response(DiagAnchor3,"2E FE 03 0C 00 00 00 00 01","7F 2E 33");
  TestCaseComment("Postcondition");
  TestStep("8","Send request 10 01 to enter default diagnostic session");
	SendDiag_Request_Verify_Response(DiagAnchor3,"10 01","50 01 00 32 01 F4");
  TestStep("9","Stop TesterPresent 3E 00");
	      SendDiag_Request_Verify_Response(DiagAnchor3,"3E 00","7E 00");
}


testcase TCS_PK_FCA_AnchorUDSServer_WriteDataByID_NRC33_DIDFE04_BoschEOLLock_Extended_NoSecurityAnd0x65Security_35126()
{
 testCaseComment("Precondition");
	TestStep("1","Send TesterPresent 3E 00 every 4000ms");
	      SendDiag_Request_Verify_Response(DiagAnchor3,"3E 00","7E 00");
       	TestStep("2","Send request 10 01 to enter default diagnostic session");
	      SendDiag_Request_Verify_Response(DiagAnchor3,"10 01","50 01 00 32 01 F4");
  testCaseComment("Actions");
  TestStep("3","Send request 10 03 to enter Extended Diagnostic Session");
	SendDiag_Request_Verify_Response(DiagAnchor3,"10 03","50 03 00 32 01 F4");
   TestStep("4","Send request 2E FE 04 01 to request WriteDataByIdentifier Service");
	SendDiag_Request_Verify_Negative_Response(DiagAnchor3,"2E FE 04 01","7F 2E 33");
	 TestStep("5,6","Send Security Seed Request 65 and Key 66 in DiagAnchor");  
  Security_Seed_Key_Access(Anch3,Physical,Incar_1);
  TestStep("7","Send request 2E FE 04 01 to WriteDataByIdentifier");
        SendDiag_Request_Verify_Negative_Response(DiagAnchor3,"2E FE 04 01","7F 2E 33");
  TestCaseComment("Postcondition");
  TestStep("8","Send request 10 01 to enter default diagnostic session");
	SendDiag_Request_Verify_Response(DiagAnchor3,"10 01","50 01 00 32 01 F4");
  TestStep("9","Stop TesterPresent 3E 00");
	      SendDiag_Request_Verify_Response(DiagAnchor3,"3E 00","7E 00");
}


testcase TCS_PK_FCA_AnchorUDSServer_WriteDataByIdentifier_NRC33_DIDFE07_CANIdx_ExtendedSession_NoSecurityLevelAnd0x65SecurityLevel_35164()
{
 testCaseComment("Precondition");
	TestStep("1","Send TesterPresent 3E 00 every 4000ms");
	      SendDiag_Request_Verify_Response(DiagAnchor3,"3E 00","7E 00");
       	TestStep("2","Send request 10 01 to enter default diagnostic session");
	      SendDiag_Request_Verify_Response(DiagAnchor3,"10 01","50 01 00 32 01 F4");
  testCaseComment("Actions");
  TestStep("3","Send request 10 03 to enter Extended Diagnostic Session");
	SendDiag_Request_Verify_Response(DiagAnchor3,"10 03","50 03 00 32 01 F4");
   TestStep("4","Send request 2E FE 07 0F to request WriteDataByIdentifier Service");
	SendDiag_Request_Verify_Negative_Response(DiagAnchor3,"2E FE 07 0F","7F 2E 33");
	 TestStep("5,6","Send Security Seed Request 65 and Key 66 in DiagAnchor");  
  Security_Seed_Key_Access(Anch3,Physical,Incar_1);
  TestStep("7","Send request 2E FE 07 0F to WriteDataByIdentifier");
        SendDiag_Request_Verify_Negative_Response(DiagAnchor3,"2E FE 07 0F","7F 2E 33");
  TestCaseComment("Postcondition");
  TestStep("8","Send request 10 01 to enter default diagnostic session");
	SendDiag_Request_Verify_Response(DiagAnchor3,"10 01","50 01 00 32 01 F4");
  TestStep("9","Stop TesterPresent 3E 00");
	      SendDiag_Request_Verify_Response(DiagAnchor3,"3E 00","7E 00");
}


testcase TCS_PK_FCA_AnchorUDSServer_WriteDataByID_NRC33_DIDFE0B_R4ExtUwbDiag_Extended_NoSecurityAnd0x65Security_35170()
{
 testCaseComment("Precondition");
	TestStep("1","Send TesterPresent 3E 00 every 4000ms");
	      SendDiag_Request_Verify_Response(DiagAnchor3,"3E 00","7E 00");
       	TestStep("2","Send request 10 01 to enter default diagnostic session");
	      SendDiag_Request_Verify_Response(DiagAnchor3,"10 01","50 01 00 32 01 F4");
  testCaseComment("Actions");
  TestStep("3","Send request 10 03 to enter Extended Diagnostic Session");
	SendDiag_Request_Verify_Response(DiagAnchor3,"10 03","50 03 00 32 01 F4");
   TestStep("4","Send request 2E FE 0B 00 00 00 00 00 00 00 00 00 00 00 00 to request WriteDataByIdentifier Service");
	SendDiag_Request_Verify_Negative_Response(DiagAnchor3,"2E FE 0B 00 00 00 00 00 00 00 00 00 00 00 00","7F 2E 33");
	 TestStep("5,6","Send Security Seed Request 65 and Key 66 in DiagAnchor");  
  Security_Seed_Key_Access(Anch3,Physical,Incar_1);
  TestStep("7","Send request 2E FE 0B 00 00 00 00 00 00 00 00 00 00 00 00 to WriteDataByIdentifier");
        SendDiag_Request_Verify_Negative_Response(DiagAnchor3,"2E FE 0B 00 00 00 00 00 00 00 00 00 00 00 00","7F 2E 33");
  TestCaseComment("Postcondition");
  TestStep("8","Send request 10 01 to enter default diagnostic session");
	SendDiag_Request_Verify_Response(DiagAnchor3,"10 01","50 01 00 32 01 F4");
  TestStep("9","Stop TesterPresent 3E 00");
	      SendDiag_Request_Verify_Response(DiagAnchor3,"3E 00","7E 00");
}


testcase TCS_PK_FCA_AnchorUDSServer_WriteDataByID_NRC33_DIDFEA1_AnchorIDTestMode_Extended_NoSecurityAnd0x65Security_35187()
{
 testCaseComment("Precondition");
	TestStep("1","Send TesterPresent 3E 00 every 4000ms");
	      SendDiag_Request_Verify_Response(DiagAnchor3,"3E 00","7E 00");
       	TestStep("2","Send request 10 01 to enter default diagnostic session");
	      SendDiag_Request_Verify_Response(DiagAnchor3,"10 01","50 01 00 32 01 F4");
  testCaseComment("Actions");
  TestStep("3","Send request 10 03 to enter Extended Diagnostic Session");
	SendDiag_Request_Verify_Response(DiagAnchor3,"10 03","50 03 00 32 01 F4");
   TestStep("4","Send request 2E FE A1 01 to request WriteDataByIdentifier Service");
	SendDiag_Request_Verify_Negative_Response(DiagAnchor3,"2E FE A1 01","7F 2E 33");
	 TestStep("5,6","Send Security Seed Request 65 and Key 66 in DiagAnchor");  
  Security_Seed_Key_Access(Anch3,Physical,Incar_1);
  TestStep("7","Send request 2E FE A1 00 to WriteDataByIdentifier");
        SendDiag_Request_Verify_Negative_Response(DiagAnchor3,"2E FE A1 00","7F 2E 33");
  TestCaseComment("Postcondition");
  TestStep("8","Send request 10 01 to enter default diagnostic session");
	SendDiag_Request_Verify_Response(DiagAnchor3,"10 01","50 01 00 32 01 F4");
  TestStep("9","Stop TesterPresent 3E 00");
	      SendDiag_Request_Verify_Response(DiagAnchor3,"3E 00","7E 00");
}


testcase TCS_PK_FCA_AnchorUDSServer_WriteDataByID_NRC33_DIDFEA4_RFTestMode_Extended_NoSecurityAnd0x65Security_35193()
{
 testCaseComment("Precondition");
	TestStep("1","Send TesterPresent 3E 00 every 4000ms");
	      SendDiag_Request_Verify_Response(DiagAnchor3,"3E 00","7E 00");
       	TestStep("2","Send request 10 01 to enter default diagnostic session");
	      SendDiag_Request_Verify_Response(DiagAnchor3,"10 01","50 01 00 32 01 F4");
  testCaseComment("Actions");
  TestStep("3","Send request 10 03 to enter Extended Diagnostic Session");
	SendDiag_Request_Verify_Response(DiagAnchor3,"10 03","50 03 00 32 01 F4");
   TestStep("4","Send request 2E FE A4 01 to request WriteDataByIdentifier Service");
	SendDiag_Request_Verify_Negative_Response(DiagAnchor3,"2E FE A4 01","7F 2E 33");
	 TestStep("5,6","Send Security Seed Request 65 and Key 66 in DiagAnchor");  
  Security_Seed_Key_Access(Anch3,Physical,Incar_1);
  TestStep("7","Send request 2E FE A4 00 to WriteDataByIdentifier");
        SendDiag_Request_Verify_Negative_Response(DiagAnchor3,"2E FE A4 00","7F 2E 33");
  TestCaseComment("Postcondition");
  TestStep("8","Send request 10 01 to enter default diagnostic session");
	SendDiag_Request_Verify_Response(DiagAnchor3,"10 01","50 01 00 32 01 F4");
  TestStep("9","Stop TesterPresent 3E 00");
	      SendDiag_Request_Verify_Response(DiagAnchor3,"3E 00","7E 00");
}


testcase TCS_PK_FCA_AnchorUDSServer_WriteDataByID_NRC33_DIDFEB0_UWBPropagationDelayCalibration_Extended_NoSecurityAnd0x65Security_35199()
{
 testCaseComment("Precondition");
	TestStep("1","Send TesterPresent 3E 00 every 4000ms");
	      SendDiag_Request_Verify_Response(DiagAnchor3,"3E 00","7E 00");
       	TestStep("2","Send request 10 01 to enter default diagnostic session");
	      SendDiag_Request_Verify_Response(DiagAnchor3,"10 01","50 01 00 32 01 F4");
  testCaseComment("Actions");
  TestStep("3","Send request 10 03 to enter Extended Diagnostic Session");
	SendDiag_Request_Verify_Response(DiagAnchor3,"10 03","50 03 00 32 01 F4");
   TestStep("4","Send request 2E FE B0 00 00 00 00 00 00 00 00 00 00 00 00 00 00 00 00 00 00 00 00 00 00 00 00 00 00 00 00 00 00 00 00 00 00 00 00 00 to request WriteDataByIdentifier Service");
	SendDiag_Request_Verify_Negative_Response(DiagAnchor3,"2E FE B0 00 00 00 00 00 00 00 00 00 00 00 00 00 00 00 00 00 00 00 00 00 00 00 00 00 00 00 00 00 00 00 00 00 00 00 00 00","7F 2E 33");
	 TestStep("5,6","Send Security Seed Request 65 and Key 66 in DiagAnchor");  
  Security_Seed_Key_Access(Anch3,Physical,Incar_1);
  TestStep("7","Send request 2E FE B0 00 00 00 00 00 00 00 00 00 00 00 00 00 00 00 00 00 00 00 00 00 00 00 00 00 00 00 00 00 00 00 00 00 00 00 00 00 to WriteDataByIdentifier");
        SendDiag_Request_Verify_Negative_Response(DiagAnchor3,"2E FE B0 00 00 00 00 00 00 00 00 00 00 00 00 00 00 00 00 00 00 00 00 00 00 00 00 00 00 00 00 00 00 00 00 00 00 00 00 00","7F 2E 33");
  TestCaseComment("Postcondition");
  TestStep("8","Send request 10 01 to enter default diagnostic session");
	SendDiag_Request_Verify_Response(DiagAnchor3,"10 01","50 01 00 32 01 F4");
  TestStep("9","Stop TesterPresent 3E 00");
	      SendDiag_Request_Verify_Response(DiagAnchor3,"3E 00","7E 00");
}


testcase TCS_PK_FCA_AnchorUDSServer_WriteDataByID_NRC33_DIDFEB1_UWBRadioTXPower_Extended_NoSecurityAnd0x65Security_35205()
{
 testCaseComment("Precondition");
	TestStep("1","Send TesterPresent 3E 00 every 4000ms");
	      SendDiag_Request_Verify_Response(DiagAnchor3,"3E 00","7E 00");
       	TestStep("2","Send request 10 01 to enter default diagnostic session");
	      SendDiag_Request_Verify_Response(DiagAnchor3,"10 01","50 01 00 32 01 F4");
  testCaseComment("Actions");
  TestStep("3","Send request 10 03 to enter Extended Diagnostic Session");
	SendDiag_Request_Verify_Response(DiagAnchor3,"10 03","50 03 00 32 01 F4");
   TestStep("4","Send request 2E FE B1 00 00 00 00 00 00 00 to request WriteDataByIdentifier Service");
	SendDiag_Request_Verify_Negative_Response(DiagAnchor3,"2E FE B1 00 00 00 00 00 00 00","7F 2E 33");
	 TestStep("5,6","Send Security Seed Request 65 and Key 66 in DiagAnchor");  
  Security_Seed_Key_Access(Anch3,Physical,Incar_1);
  TestStep("7","Send request 2E FE B1 00 00 00 00 00 00 00 to WriteDataByIdentifier");
        SendDiag_Request_Verify_Negative_Response(DiagAnchor3,"2E FE B1 00 00 00 00 00 00 00","7F 2E 33");
  TestCaseComment("Postcondition");
  TestStep("8","Send request 10 01 to enter default diagnostic session");
	SendDiag_Request_Verify_Response(DiagAnchor3,"10 01","50 01 00 32 01 F4");
  TestStep("9","Stop TesterPresent 3E 00");
	      SendDiag_Request_Verify_Response(DiagAnchor3,"3E 00","7E 00");
}


testcase TCS_PK_FCA_AnchorUDS_WriteDataByID_NRC33_DIDFEB2_Extended_NoSecurity0x65Security_35218()
{
 testCaseComment("Precondition");
	TestStep("1","Send TesterPresent 3E 00 every 4000ms");
	      SendDiag_Request_Verify_Response(DiagAnchor3,"3E 00","7E 00");
       	TestStep("2","Send request 10 01 to enter default diagnostic session");
	      SendDiag_Request_Verify_Response(DiagAnchor3,"10 01","50 01 00 32 01 F4");
  testCaseComment("Actions");
  TestStep("3","Send request 10 03 to enter Extended Diagnostic Session");
	SendDiag_Request_Verify_Response(DiagAnchor3,"10 03","50 03 00 32 01 F4");
   TestStep("4","Send request 2E FE B2 00 00 00 00 to request WriteDataByIdentifier Service");
	SendDiag_Request_Verify_Negative_Response(DiagAnchor3,"2E FE B2 00 00 00 00","7F 2E 33");
	 TestStep("5,6","Send Security Seed Request 65 and Key 66 in DiagAnchor");  
  Security_Seed_Key_Access(Anch3,Physical,Incar_1);
  TestStep("7","Send request 2E FE B2 00 00 00 00 to WriteDataByIdentifier");
        SendDiag_Request_Verify_Negative_Response(DiagAnchor3,"2E FE B2 00 00 00 00","7F 2E 33");
  TestCaseComment("Postcondition");
  TestStep("8","Send request 10 01 to enter default diagnostic session");
	SendDiag_Request_Verify_Response(DiagAnchor3,"10 01","50 01 00 32 01 F4");
  TestStep("9","Stop TesterPresent 3E 00");
	      SendDiag_Request_Verify_Response(DiagAnchor3,"3E 00","7E 00");
}


testcase TCS_PK_FCA_AnchorUDS_WriteDataByID_NRC33_DIDFED9_PositionIdx_Extended_NoSecurity0x65Security_35230()
{
 testCaseComment("Precondition");
	TestStep("1","Send TesterPresent 3E 00 every 4000ms");
	      SendDiag_Request_Verify_Response(DiagAnchor3,"3E 00","7E 00");
       	TestStep("2","Send request 10 01 to enter default diagnostic session");
	      SendDiag_Request_Verify_Response(DiagAnchor3,"10 01","50 01 00 32 01 F4");
  testCaseComment("Actions");
  TestStep("3","Send request 10 03 to enter Extended Diagnostic Session");
	SendDiag_Request_Verify_Response(DiagAnchor3,"10 03","50 03 00 32 01 F4");
   TestStep("4","Send request 2E FE D9 00 to request WriteDataByIdentifier Service");
	SendDiag_Request_Verify_Negative_Response(DiagAnchor3,"2E FE D9 00","7F 2E 33");
	 TestStep("5,6","Send Security Seed Request 65 and Key 66 in DiagAnchor");  
  Security_Seed_Key_Access(Anch3,Physical,Incar_1);
  TestStep("7","Send request 2E FE D9 00 to WriteDataByIdentifier");
        SendDiag_Request_Verify_Negative_Response(DiagAnchor3,"2E FE D9 00","7F 2E 33");
  TestCaseComment("Postcondition");
  TestStep("8","Send request 10 01 to enter default diagnostic session");
	SendDiag_Request_Verify_Response(DiagAnchor3,"10 01","50 01 00 32 01 F4");
  TestStep("9","Stop TesterPresent 3E 00");
	      SendDiag_Request_Verify_Response(DiagAnchor3,"3E 00","7E 00");
}








 //////////////////WriteDataByIdentifier_NRC13///////////////////////////


testcase TCS_PK_FCA_AnchorUDSServer_WriteDataByIdentifier_NRC13_DIDFE03_ExtendedSession_NoSecurityLevel_36081()
{
 testCaseComment("Precondition");
	TestStep("1","Send TesterPresent 3E 00 every 4000ms");
	      SendDiag_Request_Verify_Response(DiagAnchor3,"3E 00","7E 00");
       	TestStep("2","Send request 10 01 to enter default diagnostic session");
	      SendDiag_Request_Verify_Response(DiagAnchor3,"10 01","50 01 00 32 01 F4");
  testCaseComment("Actions");
  TestStep("3","Send request 10 03 to enter Extended Diagnostic Session");
	SendDiag_Request_Verify_Response(DiagAnchor3,"10 03","50 03 00 32 01 F4");
   TestStep("4","Send request 2E FE 03 00 00 00 00 00 to request WriteDataByIdentifier Service");
	SendDiag_Request_Verify_Negative_Response(DiagAnchor3,"2E FE 03 00 00 00 00 00","7F 2E 13");
  TestStep("5","Send request 2E FE 03 00 00 00 00 00 00 00 to WriteDataByIdentifier");
        SendDiag_Request_Verify_Negative_Response(DiagAnchor3,"2E FE 03 00 00 00 00 00 00 00","7F 2E 13");
  TestCaseComment("Postcondition");
  TestStep("6","Send request 10 01 to enter default diagnostic session");
	SendDiag_Request_Verify_Response(DiagAnchor3,"10 01","50 01 00 32 01 F4");
  TestStep("7","Stop TesterPresent 3E 00");
	      SendDiag_Request_Verify_Response(DiagAnchor3,"3E 00","7E 00");
}


testcase TCS_PK_FCA_AnchorUDSServer_WriteDataByIdentifier_NRC13_DIDFE04_ExtendedSession_NoSecurityLevel_36087()
{
 testCaseComment("Precondition");
	TestStep("1","Send TesterPresent 3E 00 every 4000ms");
	      SendDiag_Request_Verify_Response(DiagAnchor3,"3E 00","7E 00");
       	TestStep("2","Send request 10 01 to enter default diagnostic session");
	      SendDiag_Request_Verify_Response(DiagAnchor3,"10 01","50 01 00 32 01 F4");
  testCaseComment("Actions");
  TestStep("3","Send request 10 03 to enter Extended Diagnostic Session");
	SendDiag_Request_Verify_Response(DiagAnchor3,"10 03","50 03 00 32 01 F4");
   TestStep("4","Send request 2E FE 04 to request WriteDataByIdentifier Service");
	SendDiag_Request_Verify_Negative_Response(DiagAnchor3,"2E FE 04","7F 2E 13");
  TestStep("5","Send request 2E FE 04 00 00 to WriteDataByIdentifier");
        SendDiag_Request_Verify_Negative_Response(DiagAnchor3,"2E FE 04 00 00","7F 2E 13");
  TestCaseComment("Postcondition");
  TestStep("6","Send request 10 01 to enter default diagnostic session");
	SendDiag_Request_Verify_Response(DiagAnchor3,"10 01","50 01 00 32 01 F4");
  TestStep("7","Stop TesterPresent 3E 00");
	      SendDiag_Request_Verify_Response(DiagAnchor3,"3E 00","7E 00");
}


testcase TCS_PK_FCA_AnchorUDSServer_WriteDataByIdentifier_NRC13_DIDFE07_ExtendedSession_NoSecurityLevel_36100()
{
 testCaseComment("Precondition");
	TestStep("1","Send TesterPresent 3E 00 every 4000ms");
	      SendDiag_Request_Verify_Response(DiagAnchor3,"3E 00","7E 00");
       	TestStep("2","Send request 10 01 to enter default diagnostic session");
	      SendDiag_Request_Verify_Response(DiagAnchor3,"10 01","50 01 00 32 01 F4");
  testCaseComment("Actions");
  TestStep("3","Send request 10 03 to enter Extended Diagnostic Session");
	SendDiag_Request_Verify_Response(DiagAnchor3,"10 03","50 03 00 32 01 F4");
   TestStep("4","Send request 2E FE 07 to request ReadDataByIdentifier Service");
	SendDiag_Request_Verify_Negative_Response(DiagAnchor3,"2E FE 07","7F 2E 13");
  TestStep("5","Send request 2E FE 07 00 00 to WriteDataByIdentifier");
        SendDiag_Request_Verify_Negative_Response(DiagAnchor3,"2E FE 07 00 00","7F 2E 13");
  TestCaseComment("Postcondition");
  TestStep("6","Send request 10 01 to enter default diagnostic session");
	SendDiag_Request_Verify_Response(DiagAnchor3,"10 01","50 01 00 32 01 F4");
  TestStep("7","Stop TesterPresent 3E 00");
	      SendDiag_Request_Verify_Response(DiagAnchor3,"3E 00","7E 00");
}


testcase TCS_PK_FCA_AnchorUDSServer_WriteDataByIdentifier_NRC13_DIDFE0B_ExtendedSession_NoSecurityLevel_36105()
{
 testCaseComment("Precondition");
	TestStep("1","Send TesterPresent 3E 00 every 4000ms");
	      SendDiag_Request_Verify_Response(DiagAnchor3,"3E 00","7E 00");
       	TestStep("2","Send request 10 01 to enter default diagnostic session");
	      SendDiag_Request_Verify_Response(DiagAnchor3,"10 01","50 01 00 32 01 F4");
  testCaseComment("Actions");
  TestStep("3","Send request 10 03 to enter Extended Diagnostic Session");
	SendDiag_Request_Verify_Response(DiagAnchor3,"10 03","50 03 00 32 01 F4");
   TestStep("4","Send request 2E FE 0B 00 00 00 00 00 00 00 00 00 00 00 to request WriteDataByIdentifier Service");
	SendDiag_Request_Verify_Negative_Response(DiagAnchor3,"2E FE 0B 00 00 00 00 00 00 00 00 00 00 00","7F 2E 13");
  TestStep("5","Send request 2E FE 0B 00 00 00 00 00 00 00 00 00 00 00 00 00 to WriteDataByIdentifier");
  SendDiag_Request_Verify_Negative_Response(DiagAnchor3,"2E FE 0B 00 00 00 00 00 00 00 00 00 00 00 00 00","7F 2E 13");
  TestCaseComment("Postcondition");
  TestStep("6","Send request 10 01 to enter default diagnostic session");
	SendDiag_Request_Verify_Response(DiagAnchor3,"10 01","50 01 00 32 01 F4");
  TestStep("7","Stop TesterPresent 3E 00");
	      SendDiag_Request_Verify_Response(DiagAnchor3,"3E 00","7E 00");
}

testcase TCS_PK_FCA_AnchorUDSServer_WriteDataByIdentifier_NRC13_DIDFEA1_ExtendedSession_NoSecurityLevel_36129()
{
 testCaseComment("Precondition");
	TestStep("1","Send TesterPresent 3E 00 every 4000ms");
	      SendDiag_Request_Verify_Response(DiagAnchor3,"3E 00","7E 00");
       	TestStep("2","Send request 10 01 to enter default diagnostic session");
	      SendDiag_Request_Verify_Response(DiagAnchor3,"10 01","50 01 00 32 01 F4");
  testCaseComment("Actions");
  TestStep("3","Send request 10 03 to enter Extended Diagnostic Session");
	SendDiag_Request_Verify_Response(DiagAnchor3,"10 03","50 03 00 32 01 F4");
   TestStep("4","Send request 2E FE A1 to request WriteDataByIdentifier Service");
	SendDiag_Request_Verify_Negative_Response(DiagAnchor3,"2E FE A1","7F 2E 13");
  TestStep("5","Send request 2E FE A1 00 00 to WriteDataByIdentifier");
        SendDiag_Request_Verify_Negative_Response(DiagAnchor3,"2E FE A1 00 00","7F 2E 13");
  TestCaseComment("Postcondition");
  TestStep("6","Send request 10 01 to enter default diagnostic session");
	SendDiag_Request_Verify_Response(DiagAnchor3,"10 01","50 01 00 32 01 F4");
  TestStep("7","Stop TesterPresent 3E 00");
	      SendDiag_Request_Verify_Response(DiagAnchor3,"3E 00","7E 00");
}


testcase TCS_PK_FCA_AnchorUDSServer_WriteDataByIdentifier_NRC13_DIDFEA4_ExtendedSession_NoSecurityLevel_36141()
{
 testCaseComment("Precondition");
	TestStep("1","Send TesterPresent 3E 00 every 4000ms");
	      SendDiag_Request_Verify_Response(DiagAnchor3,"3E 00","7E 00");
       	TestStep("2","Send request 10 01 to enter default diagnostic session");
	      SendDiag_Request_Verify_Response(DiagAnchor3,"10 01","50 01 00 32 01 F4");
  testCaseComment("Actions");
  TestStep("3","Send request 10 03 to enter Extended Diagnostic Session");
	SendDiag_Request_Verify_Response(DiagAnchor3,"10 03","50 03 00 32 01 F4");
   TestStep("4","Send request 2E FE A4 to request WriteDataByIdentifier Service");
	SendDiag_Request_Verify_Negative_Response(DiagAnchor3,"2E FE A4","7F 2E 13");
  TestStep("5","Send request 2E FE A4 00 00 to WriteDataByIdentifier");
        SendDiag_Request_Verify_Negative_Response(DiagAnchor3,"2E FE A4 00 00","7F 2E 13");
  TestCaseComment("Postcondition");
  TestStep("6","Send request 10 01 to enter default diagnostic session");
	SendDiag_Request_Verify_Response(DiagAnchor3,"10 01","50 01 00 32 01 F4");
  TestStep("7","Stop TesterPresent 3E 00");
	      SendDiag_Request_Verify_Response(DiagAnchor3,"3E 00","7E 00");
}


testcase TCS_PK_FCA_AnchorUDSServer_WriteDataByIdentifier_NRC13_DIDFEB0_ExtendedSession_NoSecurityLevel_36154()
{
 testCaseComment("Precondition");
	TestStep("1","Send TesterPresent 3E 00 every 4000ms");
	      SendDiag_Request_Verify_Response(DiagAnchor3,"3E 00","7E 00");
       	TestStep("2","Send request 10 01 to enter default diagnostic session");
	      SendDiag_Request_Verify_Response(DiagAnchor3,"10 01","50 01 00 32 01 F4");
  testCaseComment("Actions");
  TestStep("3","Send request 10 03 to enter Extended Diagnostic Session");
	SendDiag_Request_Verify_Response(DiagAnchor3,"10 03","50 03 00 32 01 F4");
   TestStep("4","Send request 2E FE B0 00 00 00 00 00 00 00 00 00 00 00 00 00 00 00 00 00 00 00 00 00 00 00 00 00 00 00 00 00 00 00 00 00 00 00 00 to request WriteDataByIdentifier Service");
	SendDiag_Request_Verify_Negative_Response(DiagAnchor3,"2E FE B0","7F 2E 13");
  TestStep("5","Send request 2E FE B0 00 00 00 00 00 00 00 00 00 00 00 00 00 00 00 00 00 00 00 00 00 00 00 00 00 00 00 00 00 00 00 00 00 00 00 00 00 00 to WriteDataByIdentifier");
        SendDiag_Request_Verify_Negative_Response(DiagAnchor3,"2E FE B0 00 00","7F 2E 13");
  TestCaseComment("Postcondition");
  TestStep("6","Send request 10 01 to enter default diagnostic session");
	SendDiag_Request_Verify_Response(DiagAnchor3,"10 01","50 01 00 32 01 F4");
  TestStep("7","Stop TesterPresent 3E 00");
	      SendDiag_Request_Verify_Response(DiagAnchor3,"3E 00","7E 00");
}


testcase TCS_PK_FCA_AnchorUDSServer_WriteDataByIdentifier_NRC13_DIDFEB1_ExtendedSession_NoSecurityLevel_36123()
{
 testCaseComment("Precondition");
	TestStep("1","Send TesterPresent 3E 00 every 4000ms");
	      SendDiag_Request_Verify_Response(DiagAnchor3,"3E 00","7E 00");
       	TestStep("2","Send request 10 01 to enter default diagnostic session");
	      SendDiag_Request_Verify_Response(DiagAnchor3,"10 01","50 01 00 32 01 F4");
  testCaseComment("Actions");
  TestStep("3","Send request 10 03 to enter Extended Diagnostic Session");
	SendDiag_Request_Verify_Response(DiagAnchor3,"10 03","50 03 00 32 01 F4");
   TestStep("4","Send request 2E FE B1 00 00 00 00 00 to request WriteDataByIdentifier Service");
	SendDiag_Request_Verify_Negative_Response(DiagAnchor3,"2E FE B1 00 00 00 00 00","7F 2E 13");
  TestStep("5","Send request 2E FE B1 00 00 00 00 00 00 to WriteDataByIdentifier");
        SendDiag_Request_Verify_Negative_Response(DiagAnchor3,"2E FE B1 00 00 00 00 00 00","7F 2E 13");
  TestCaseComment("Postcondition");
  TestStep("6","Send request 10 01 to enter default diagnostic session");
	SendDiag_Request_Verify_Response(DiagAnchor3,"10 01","50 01 00 32 01 F4");
  TestStep("7","Stop TesterPresent 3E 00");
	      SendDiag_Request_Verify_Response(DiagAnchor3,"3E 00","7E 00");
}


testcase TCS_PK_FCA_AnchorUDSServer_WriteDataByIdentifier_NRC13_DIDFEB2_ExtendedSession_NoSecurityLevel_36159()
{
 testCaseComment("Precondition");
	TestStep("1","Send TesterPresent 3E 00 every 4000ms");
	      SendDiag_Request_Verify_Response(DiagAnchor3,"3E 00","7E 00");
       	TestStep("2","Send request 10 01 to enter default diagnostic session");
	      SendDiag_Request_Verify_Response(DiagAnchor3,"10 01","50 01 00 32 01 F4");
  testCaseComment("Actions");
  TestStep("3","Send request 10 03 to enter Extended Diagnostic Session");
	SendDiag_Request_Verify_Response(DiagAnchor3,"10 03","50 03 00 32 01 F4");
   TestStep("4","Send request 2E FE B2 00 00 00 to request WriteDataByIdentifier Service");
	SendDiag_Request_Verify_Negative_Response(DiagAnchor3,"2E FE B2 00 00 00","7F 2E 13");
  TestStep("5","Send request 2E FE B2 00 00 00 00 00 to WriteDataByIdentifier");
        SendDiag_Request_Verify_Negative_Response(DiagAnchor3,"2E FE B2 00 00 00 00 00","7F 2E 13");
  TestCaseComment("Postcondition");
  TestStep("6","Send request 10 01 to enter default diagnostic session");
	SendDiag_Request_Verify_Response(DiagAnchor3,"10 01","50 01 00 32 01 F4");
  TestStep("7","Stop TesterPresent 3E 00");
	      SendDiag_Request_Verify_Response(DiagAnchor3,"3E 00","7E 00");
}


testcase TCS_PK_FCA_AnchorUDSServer_WriteDataByIdentifier_NRC13_DIDFED9_ExtendedSession_NoSecurityLevel_36165()
{
 testCaseComment("Precondition");
	TestStep("1","Send TesterPresent 3E 00 every 4000ms");
	      SendDiag_Request_Verify_Response(DiagAnchor3,"3E 00","7E 00");
       	TestStep("2","Send request 10 01 to enter default diagnostic session");
	      SendDiag_Request_Verify_Response(DiagAnchor3,"10 01","50 01 00 32 01 F4");
  testCaseComment("Actions");
  TestStep("3","Send request 10 03 to enter Extended Diagnostic Session");
	SendDiag_Request_Verify_Response(DiagAnchor3,"10 03","50 03 00 32 01 F4");
   TestStep("4","Send request 2E FE D9 to request WriteDataByIdentifier");
	SendDiag_Request_Verify_Negative_Response(DiagAnchor3,"2E FE D9","7F 2E 13");
  TestStep("5","Send request 2E FE D9 00 00 to WriteDataByIdentifier");
        SendDiag_Request_Verify_Negative_Response(DiagAnchor3,"2E FE D9 00 00","7F 2E 13");
  TestCaseComment("Postcondition");
  TestStep("6","Send request 10 01 to enter default diagnostic session");
	SendDiag_Request_Verify_Response(DiagAnchor3,"10 01","50 01 00 32 01 F4");
  TestStep("7","Stop TesterPresent 3E 00");
	      SendDiag_Request_Verify_Response(DiagAnchor3,"3E 00","7E 00");
}


testcase TCS_PK_FCA_AnchorUDSServer_WriteDataByIdentifier_NRC13_MinimumLengthTest_ExtendedSession_NoSecurityLeve_36171()
{
 testCaseComment("Precondition");
	TestStep("1","Send TesterPresent 3E 00 every 4000ms");
	      SendDiag_Request_Verify_Response(DiagAnchor3,"3E 00","7E 00");
       	TestStep("2","Send request 10 01 to enter default diagnostic session");
	      SendDiag_Request_Verify_Response(DiagAnchor3,"10 01","50 01 00 32 01 F4");
  testCaseComment("Actions");
  TestStep("3","Send request 10 03 to enter Extended Diagnostic Session");
	SendDiag_Request_Verify_Response(DiagAnchor3,"10 03","50 03 00 32 01 F4");
   TestStep("4","Send request 2E to request WriteDataByIdentifier SID");
	SendDiag_Request_Verify_Negative_Response(DiagAnchor3,"2E","7F 2E 13");
  TestStep("5","Send request 2E 00 to WriteDataByIdentifier");
        SendDiag_Request_Verify_Negative_Response(DiagAnchor3,"2E 00","7F 2E 13");
  TestCaseComment("Postcondition");
  TestStep("6","Send request 10 01 to enter default diagnostic session");
	SendDiag_Request_Verify_Response(DiagAnchor3,"10 01","50 01 00 32 01 F4");
  TestStep("7","Stop TesterPresent 3E 00");
	      SendDiag_Request_Verify_Response(DiagAnchor3,"3E 00","7E 00");
}


///////////////////////////////////ReadDataByIdentifier_NRC33//////////////////////////////


testcase TCS_PK_FCA_AnchorUDSServer_ReadDataByIdentifier_NRC33_DIDFE03_BLEAddress_ExtendedSession_NoSecurityLevel_54678()
{
	testCaseComment("Precondition");
	TestStep("1","Send TesterPresent 3E 00 every 4000ms");
	SendDiag_Request_Verify_Response(DiagAnchor3,"3E 00","7E 00");
	TestStep("2","Send request 10 01 to enter Default Diagnostic Session");
	SendDiag_Request_Verify_Response(DiagAnchor3,"10 01","50 01 00 32 01 F4");
  testCaseComment("Actions");
  TestStep("3","Send request 10 03 to enter Extended Diagnostic Session");
	SendDiag_Request_Verify_Response(DiagAnchor3,"10 03","50 03 00 32 01 F4");
  TestStep("4","Send request 22 FE 03 to request ReadDataByIdentifier Service");
	SendDiag_Request_Verify_Negative_Response(DiagAnchor3,"22 FE 03","7F 22 33");
  TestCaseComment("Postcondition");
	TestStep("5","Send request 10 01 to enter default diagnostic session");
	SendDiag_Request_Verify_Response(DiagAnchor3,"10 01","50 01 00 32 01 F4");
  TestStep("6"," Stop Sending TesterPresent 3E 00 every 4000ms");
}


testcase TCS_PK_FCA_AnchorUDSServer_ReadDataByIdentifier_NRC33_DIDFE03_BLEAddress_ExtendedSession_SecurityLevel0x65_54679()
{
	testCaseComment("Precondition");
	TestStep("1","Send TesterPresent 3E 00 every 4000ms");
	SendDiag_Request_Verify_Response(DiagAnchor3,"3E 00","7E 00");
	TestStep("2","Send request 10 01 to enter default diagnostic session");
	SendDiag_Request_Verify_Response(DiagAnchor3,"10 01","50 01 00 32 01 F4");
	testCaseComment("Actions");
  TestStep("3","Send request 10 03 to enter Extended Diagnostic Session");
	SendDiag_Request_Verify_Response(DiagAnchor3,"10 03","50 03 00 32 01 F4");
  TestStep("4,5","Send Security Seed Request 65 and Key 66 in DiagAnchor");  
  Security_Seed_Key_Access(Anch3,Physical,Incar_1);
  TestStep("6","Send request 22 FE 03 to request ReadDataByIdentifier Service");
	SendDiag_Request_Verify_Negative_Response(DiagAnchor3,"22 FE 03","7F 22 33");
	TestCaseComment("Postcondition");
	TestStep("7","Send request 10 01 to enter default diagnostic session");
	SendDiag_Request_Verify_Response(DiagAnchor3,"10 01","50 01 00 32 01 F4");
	TestStep("8"," Stop Sending TesterPresent 3E 00 every 4000ms");
}


testcase TCS_PK_FCA_AnchorUDSServer_ReadDataByIdentifier_NRC33_DIDFE04_BoschEOLLock_ExtendedSession_NoSecurityLevel_54680()
{
	testCaseComment("Precondition");
	TestStep("1","Send TesterPresent 3E 00 every 4000ms");
	SendDiag_Request_Verify_Response(DiagAnchor3,"3E 00","7E 00");
	TestStep("2","Send request 10 01 to enter Default Diagnostic Session");
	SendDiag_Request_Verify_Response(DiagAnchor3,"10 01","50 01 00 32 01 F4");
  testCaseComment("Actions");
  TestStep("3","Send request 10 03 to enter Extended Diagnostic Session");
	SendDiag_Request_Verify_Response(DiagAnchor3,"10 03","50 03 00 32 01 F4");
  TestStep("4","Send request 22 FE 04 to request ReadDataByIdentifier Service");
	SendDiag_Request_Verify_Negative_Response(DiagAnchor3,"22 FE 04","7F 22 33");
  TestCaseComment("Postcondition");
	TestStep("5","Send request 10 01 to enter default diagnostic session");
	SendDiag_Request_Verify_Response(DiagAnchor3,"10 01","50 01 00 32 01 F4");
  TestStep("6"," Stop Sending TesterPresent 3E 00 every 4000ms");
}


testcase TCS_PK_FCA_AnchorUDSServer_ReadDataByIdentifier_NRC33_DIDFE04_BoschEOLLock_ExtendedSession_SecurityLevel0x65_54681()
{
	testCaseComment("Precondition");
	TestStep("1","Send TesterPresent 3E 00 every 4000ms");
	SendDiag_Request_Verify_Response(DiagAnchor3,"3E 00","7E 00");
	TestStep("2","Send request 10 01 to enter default diagnostic session");
	SendDiag_Request_Verify_Response(DiagAnchor3,"10 01","50 01 00 32 01 F4");
	testCaseComment("Actions");
  TestStep("3","Send request 10 03 to enter Extended Diagnostic Session");
	SendDiag_Request_Verify_Response(DiagAnchor3,"10 03","50 03 00 32 01 F4");
  TestStep("4,5","Send Security Seed Request 65 and Key 66 in DiagAnchor");  
  Security_Seed_Key_Access(Anch3,Physical,Incar_1);
  TestStep("6","Send request 22 FE 04 to request ReadDataByIdentifier Service");
	SendDiag_Request_Verify_Negative_Response(DiagAnchor3,"22 FE 04","7F 22 33");
	TestCaseComment("Postcondition");
	TestStep("7","Send request 10 01 to enter default diagnostic session");
	SendDiag_Request_Verify_Response(DiagAnchor3,"10 01","50 01 00 32 01 F4");
	TestStep("8"," Stop Sending TesterPresent 3E 00 every 4000ms");
}


testcase TCS_PK_FCA_AnchorUDSServer_ReadDataByIdentifier_NRC33_DIDFE05_TimeSinceResetUWB_ExtendedSession_NoSecurityLevel_54682()
{
	testCaseComment("Precondition");
	TestStep("1","Send TesterPresent 3E 00 every 4000ms");
	SendDiag_Request_Verify_Response(DiagAnchor3,"3E 00","7E 00");
	TestStep("2","Send request 10 01 to enter Default Diagnostic Session");
	SendDiag_Request_Verify_Response(DiagAnchor3,"10 01","50 01 00 32 01 F4");
  testCaseComment("Actions");
  TestStep("3","Send request 10 03 to enter Extended Diagnostic Session");
	SendDiag_Request_Verify_Response(DiagAnchor3,"10 03","50 03 00 32 01 F4");
  TestStep("4","Send request 22 FE 05 to request TimeSinceResetUWB DID");
	SendDiag_Request_Verify_Negative_Response(DiagAnchor3,"22 FE 05","7F 22 33");
  TestCaseComment("Postcondition");
	TestStep("5","Send request 10 01 to enter default diagnostic session");
	SendDiag_Request_Verify_Response(DiagAnchor3,"10 01","50 01 00 32 01 F4");
  TestStep("6"," Stop Sending TesterPresent 3E 00 every 4000ms");
}	


testcase TCS_PK_FCA_AnchorUDSServer_ReadDataByIdentifier_NRC33_DIDFE05_TimeSinceResetUWB_ExtendedSession_SecurityLevel0x65_54684()
{
	testCaseComment("Precondition");
	TestStep("1","Send TesterPresent 3E 00 every 4000ms");
	SendDiag_Request_Verify_Response(DiagAnchor3,"3E 00","7E 00");
	TestStep("2","Send request 10 01 to enter default diagnostic session");
	SendDiag_Request_Verify_Response(DiagAnchor3,"10 01","50 01 00 32 01 F4");
	testCaseComment("Actions");
  TestStep("3","Send request 10 03 to enter Extended Diagnostic Session");
	SendDiag_Request_Verify_Response(DiagAnchor3,"10 03","50 03 00 32 01 F4");
  TestStep("4,5","Send Security Seed Request 65 and Key 66 in DiagAnchor");  
  Security_Seed_Key_Access(Anch3,Physical,Incar_1);
  TestStep("6","Send request 22 FE 05 to request ReadDataByIdentifier Service");
	SendDiag_Request_Verify_Negative_Response(DiagAnchor3,"22 FE 05","7F 22 33");
	TestCaseComment("Postcondition");
	TestStep("7","Send request 10 01 to enter default diagnostic session");
	SendDiag_Request_Verify_Response(DiagAnchor3,"10 01","50 01 00 32 01 F4");
	TestStep("8"," Stop Sending TesterPresent 3E 00 every 4000ms");
}


testcase TCS_PK_FCA_AnchorUDSServer_ReadDataByIdentifier_NRC33_DIDFE06_TimeSinceReset_ExtendedSession_NoSecurityLevel_54685()
{
	testCaseComment("Precondition");
	TestStep("1","Send TesterPresent 3E 00 every 4000ms");
	SendDiag_Request_Verify_Response(DiagAnchor3,"3E 00","7E 00");
	TestStep("2","Send request 10 01 to enter Default Diagnostic Session");
	SendDiag_Request_Verify_Response(DiagAnchor3,"10 01","50 01 00 32 01 F4");
  testCaseComment("Actions");
  TestStep("3","Send request 10 03 to enter Extended Diagnostic Session");
	SendDiag_Request_Verify_Response(DiagAnchor3,"10 03","50 03 00 32 01 F4");
  TestStep("4","Send request 22 FE 06 to request TimeSinceResetUWB DID");
	SendDiag_Request_Verify_Negative_Response(DiagAnchor3,"22 FE 06","7F 22 33");
  TestCaseComment("Postcondition");
	TestStep("5","Send request 10 01 to enter default diagnostic session");
	SendDiag_Request_Verify_Response(DiagAnchor3,"10 01","50 01 00 32 01 F4");
  TestStep("6"," Stop Sending TesterPresent 3E 00 every 4000ms");
}	


testcase TCS_PK_FCA_AnchorUDSServer_ReadDataByIdentifier_NRC33_DIDFE06_TimeSinceReset_ExtendedSession_SecurityLevel0x65_54687()
{
	testCaseComment("Precondition");
	TestStep("1","Send TesterPresent 3E 00 every 4000ms");
	SendDiag_Request_Verify_Response(DiagAnchor3,"3E 00","7E 00");
	TestStep("2","Send request 10 01 to enter default diagnostic session");
	SendDiag_Request_Verify_Response(DiagAnchor3,"10 01","50 01 00 32 01 F4");
	testCaseComment("Actions");
  TestStep("3","Send request 10 03 to enter Extended Diagnostic Session");
	SendDiag_Request_Verify_Response(DiagAnchor3,"10 03","50 03 00 32 01 F4");
  TestStep("4,5","Send Security Seed Request 65 and Key 66 in DiagAnchor");  
  Security_Seed_Key_Access(Anch3,Physical,Incar_1);
  TestStep("6","Send request 22 FE 06 to request ReadDataByIdentifier Service");
	SendDiag_Request_Verify_Negative_Response(DiagAnchor3,"22 FE 06","7F 22 33");
	TestCaseComment("Postcondition");
	TestStep("7","Send request 10 01 to enter default diagnostic session");
	SendDiag_Request_Verify_Response(DiagAnchor3,"10 01","50 01 00 32 01 F4");
	TestStep("8"," Stop Sending TesterPresent 3E 00 every 4000ms");
}


testcase TCS_PK_FCA_AnchorUDSServer_ReadDataByIdentifier_NRC33_DIDFE07_CANIdx_ExtendedSession_NoSecurityLevel_54691()
{
	testCaseComment("Precondition");
	TestStep("1","Send TesterPresent 3E 00 every 4000ms");
	SendDiag_Request_Verify_Response(DiagAnchor3,"3E 00","7E 00");
	TestStep("2","Send request 10 01 to enter Default Diagnostic Session");
	SendDiag_Request_Verify_Response(DiagAnchor3,"10 01","50 01 00 32 01 F4");
  testCaseComment("Actions");
  TestStep("3","Send request 10 03 to enter Extended Diagnostic Session");
	SendDiag_Request_Verify_Response(DiagAnchor3,"10 03","50 03 00 32 01 F4");
  TestStep("4","Send request 22 FE 07 to request TimeSinceResetUWB DID");
	SendDiag_Request_Verify_Negative_Response(DiagAnchor3,"22 FE 07","7F 22 33");
  TestCaseComment("Postcondition");
	TestStep("5","Send request 10 01 to enter default diagnostic session");
	SendDiag_Request_Verify_Response(DiagAnchor3,"10 01","50 01 00 32 01 F4");
  TestStep("6"," Stop Sending TesterPresent 3E 00 every 4000ms");
}


testcase TCS_PK_FCA_AnchorUDSServer_ReadDataByIdentifier_NRC33_DIDFE07_CANIdx_ExtendedSession_SecurityLevel0x65_54396()
{
	testCaseComment("Precondition");
	TestStep("1","Send TesterPresent 3E 00 every 4000ms");
	SendDiag_Request_Verify_Response(DiagAnchor3,"3E 00","7E 00");
	TestStep("2","Send request 10 01 to enter default diagnostic session");
	SendDiag_Request_Verify_Response(DiagAnchor3,"10 01","50 01 00 32 01 F4");
	testCaseComment("Actions");
  TestStep("3","Send request 10 03 to enter Extended Diagnostic Session");
	SendDiag_Request_Verify_Response(DiagAnchor3,"10 03","50 03 00 32 01 F4");
  TestStep("4,5","Send Security Seed Request 65 and Key 66 in DiagAnchor");  
  Security_Seed_Key_Access(Anch3,Physical,Incar_1);
  TestStep("6","Send request 22 FE 07 to request ReadDataByIdentifier Service");
	SendDiag_Request_Verify_Negative_Response(DiagAnchor3,"22 FE 07","7F 22 33");
	TestCaseComment("Postcondition");
	TestStep("7","Send request 10 01 to enter default diagnostic session");
	SendDiag_Request_Verify_Response(DiagAnchor3,"10 01","50 01 00 32 01 F4");
	TestStep("8"," Stop Sending TesterPresent 3E 00 every 4000ms");
}


testcase TCS_PK_FCA_AnchorUDSServer_ReadDataByIdentifier_NRC33_DIDFE0B_R4ExtUwbDiag_ExtendedSession_0x65SecurityLevel_54397()
{
	testCaseComment("Precondition");
	TestStep("1","Send TesterPresent 3E 00 every 4000ms");
	SendDiag_Request_Verify_Response(DiagAnchor3,"3E 00","7E 00");
	TestStep("2","Send request 10 01 to enter default diagnostic session");
	SendDiag_Request_Verify_Response(DiagAnchor3,"10 01","50 01 00 32 01 F4");
	testCaseComment("Actions");
  TestStep("3","Send request 10 03 to enter Extended Diagnostic Session");
	SendDiag_Request_Verify_Response(DiagAnchor3,"10 03","50 03 00 32 01 F4");
  TestStep("4,5","Send Security Seed Request 65 and Key 66 in DiagAnchor");  
  Security_Seed_Key_Access(Anch3,Physical,Incar_1);
  TestStep("6","Send request 22 FE 0B to request ReadDataByIdentifier Service");
	SendDiag_Request_Verify_Negative_Response(DiagAnchor3,"22 FE 0B","7F 22 33");
	TestCaseComment("Postcondition");
	TestStep("7","Send request 10 01 to enter default diagnostic session");
	SendDiag_Request_Verify_Response(DiagAnchor3,"10 01","50 01 00 32 01 F4");
	TestStep("8"," Stop Sending TesterPresent 3E 00 every 4000ms");
}


testcase TCS_PK_FCA_AnchorUDSServer_ReadDataByIdentifier_NRC33_DIDFE0B_R4ExtUwbDiag_ExtendedSession_NoSecurityLevel_54399()
{
	testCaseComment("Precondition");
	TestStep("1","Send TesterPresent 3E 00 every 4000ms");
	SendDiag_Request_Verify_Response(DiagAnchor3,"3E 00","7E 00");
	TestStep("2","Send request 10 01 to enter Default Diagnostic Session");
	SendDiag_Request_Verify_Response(DiagAnchor3,"10 01","50 01 00 32 01 F4");
  testCaseComment("Actions");
  TestStep("3","Send request 10 03 to enter Extended Diagnostic Session");
	SendDiag_Request_Verify_Response(DiagAnchor3,"10 03","50 03 00 32 01 F4");
  TestStep("4","Send request 22 FE 0B");
	SendDiag_Request_Verify_Negative_Response(DiagAnchor3,"22 FE 0B","7F 22 33");
  TestCaseComment("Postcondition");
	TestStep("5","Send request 10 01 to enter default diagnostic session");
	SendDiag_Request_Verify_Response(DiagAnchor3,"10 01","50 01 00 32 01 F4");
  TestStep("6"," Stop Sending TesterPresent 3E 00 every 4000ms");
}


testcase TCS_PK_FCA_AnchorUDSServer_ReadDataByIdentifier_NRC33_DIDFE0E_SupplyVoltage_ExtendedSession_NoSecurityLevel_54395()
{
	testCaseComment("Precondition");
	TestStep("1","Send TesterPresent 3E 00 every 4000ms");
	SendDiag_Request_Verify_Response(DiagAnchor3,"3E 00","7E 00");
	TestStep("2","Send request 10 01 to enter Default Diagnostic Session");
	SendDiag_Request_Verify_Response(DiagAnchor3,"10 01","50 01 00 32 01 F4");
  testCaseComment("Actions");
  TestStep("3","Send request 10 03 to enter Extended Diagnostic Session");
	SendDiag_Request_Verify_Response(DiagAnchor3,"10 03","50 03 00 32 01 F4");
  TestStep("4","Send request 22 FE 0E to request ReadDataByIdentifier service");
	SendDiag_Request_Verify_Negative_Response(DiagAnchor3,"22 FE 0E","7F 22 33");
  TestCaseComment("Postcondition");
	TestStep("5","Send request 10 01 to enter default diagnostic session");
	SendDiag_Request_Verify_Response(DiagAnchor3,"10 01","50 01 00 32 01 F4");
  TestStep("6"," Stop Sending TesterPresent 3E 00 every 4000ms");
}


testcase TCS_PK_FCA_AnchorUDSServer_ReadDataByIdentifier_NRC33_DIDFE0E_SupplyVoltage_ExtendedSession_SecurityLevel0x65_54402()
{
	testCaseComment("Precondition");
	TestStep("1","Send TesterPresent 3E 00 every 4000ms");
	SendDiag_Request_Verify_Response(DiagAnchor3,"3E 00","7E 00");
	TestStep("2","Send request 10 01 to enter default diagnostic session");
	SendDiag_Request_Verify_Response(DiagAnchor3,"10 01","50 01 00 32 01 F4");
	testCaseComment("Actions");
  TestStep("3","Send request 10 03 to enter Extended Diagnostic Session");
	SendDiag_Request_Verify_Response(DiagAnchor3,"10 03","50 03 00 32 01 F4");
  TestStep("4,5","Send Security Seed Request 65 and Key 66 in DiagAnchor");  
  Security_Seed_Key_Access(Anch3,Physical,Incar_1);
  TestStep("6","Send request 22 FE 0E to request ReadDataByIdentifier Service");
	SendDiag_Request_Verify_Negative_Response(DiagAnchor3,"22 FE 0E","7F 22 33");
	TestCaseComment("Postcondition");
	TestStep("7","Send request 10 01 to enter default diagnostic session");
	SendDiag_Request_Verify_Response(DiagAnchor3,"10 01","50 01 00 32 01 F4");
	TestStep("8"," Stop Sending TesterPresent 3E 00 every 4000ms");
}



testcase TCS_PK_FCA_AnchorUDSServer_ReadDataByIdentifier_NRC33_DIDFE11_SWInformation_ExtendedSession_NoSecurityLevel_54405()
{
	testCaseComment("Precondition");
	TestStep("1","Send TesterPresent 3E 00 every 4000ms");
	SendDiag_Request_Verify_Response(DiagAnchor3,"3E 00","7E 00");
	TestStep("2","Send request 10 01 to enter Default Diagnostic Session");
	SendDiag_Request_Verify_Response(DiagAnchor3,"10 01","50 01 00 32 01 F4");
  testCaseComment("Actions");
  TestStep("3","Send request 10 03 to enter Extended Diagnostic Session");
	SendDiag_Request_Verify_Response(DiagAnchor3,"10 03","50 03 00 32 01 F4");
  TestStep("4","Send request 22 FE 11 to request ReadDataByIdentifier service");
	SendDiag_Request_Verify_Negative_Response(DiagAnchor3,"22 FE 11","7F 22 33");
  TestCaseComment("Postcondition");
	TestStep("5","Send request 10 01 to enter default diagnostic session");
	SendDiag_Request_Verify_Response(DiagAnchor3,"10 01","50 01 00 32 01 F4");
  TestStep("6"," Stop Sending TesterPresent 3E 00 every 4000ms");
}


testcase TCS_PK_FCA_AnchorUDSServer_ReadDataByIdentifier_NRC33_DIDFE11_SWInformation_ProgrammingSession_NoSecurityLevel_54401()
{
	testCaseComment("Precondition");
	TestStep("1","Send TesterPresent 3E 00 every 4000ms");
	SendDiag_Request_Verify_Response(DiagAnchor3,"3E 00","7E 00");
	TestStep("2","Send request 10 01 to enter default diagnostic session");
	SendDiag_Request_Verify_Response(DiagAnchor3,"10 01","50 01 00 32 01 F4");
	 TestStep("3","Send request 10 03 to enter Extended Diagnostic Session");
	SendDiag_Request_Verify_Response(DiagAnchor3,"10 03","50 03 00 32 01 F4");
  TestStep("4,5","Send Security Seed Request 61 and Key 62 in DiagAnchor");  
  Security_Seed_Key_Access(Anch3,Physical,Bosch);
  testCaseComment("Actions");
  TestStep("6","Send request 10 02 to enter default diagnostic session");
	SendDiag_Request_Verify_Response(DiagAnchor3,"10 02","50 02 00 32 01 F4");
  TestStep("7","Send request 22 FE 11 to request ReadDataByIdentifier Service");
	SendDiag_Request_Verify_Negative_Response(DiagAnchor3,"22 FE 11","7F 22 33");
	TestCaseComment("Postcondition");
	TestStep("8","Send request 10 01 to enter default diagnostic session");
	SendDiag_Request_Verify_Response(DiagAnchor3,"10 01","50 01 00 32 01 F4");
	TestStep("9"," Stop Sending TesterPresent 3E 00 every 4000ms");
}


testcase TCS_PK_FCA_AnchorUDSServer_ReadDataByID_NRC33_DIDFE13_UWBChipVersion_Extended_NoSecurityand0x65Security_54407()
{
	testCaseComment("Precondition");
	TestStep("1","Send TesterPresent 3E 00 every 4000ms");
	SendDiag_Request_Verify_Response(DiagAnchor3,"3E 00","7E 00");
	TestStep("2","Send request 10 01 to enter default diagnostic session");
	SendDiag_Request_Verify_Response(DiagAnchor3,"10 01","50 01 00 32 01 F4");
	 testCaseComment("Actions");
	 TestStep("3","Send request 10 03 to enter Extended Diagnostic Session");
	SendDiag_Request_Verify_Response(DiagAnchor3,"10 03","50 03 00 32 01 F4");
	TestStep("4","Send request 22 FE 13 to request ReadDataByIdentifier Service");
	SendDiag_Request_Verify_Negative_Response(DiagAnchor3,"22 FE 13","7F 22 33");
  TestStep("5,6","Send Security Seed Request 65 and Key 66 in DiagAnchor");  
  Security_Seed_Key_Access(Anch3,Physical,Incar_1);
  TestStep("7","Send request 22 FE 13 to request ReadDataByIdentifier Service");
	SendDiag_Request_Verify_Negative_Response(DiagAnchor3,"22 FE 13","7F 22 33");
  TestCaseComment("Postcondition");
	TestStep("8","Send request 10 01 to enter default diagnostic session");
	SendDiag_Request_Verify_Response(DiagAnchor3,"10 01","50 01 00 32 01 F4");
	TestStep("9"," Stop Sending TesterPresent 3E 00 every 4000ms");
}


testcase TCS_PK_FCA_AnchorUDSServer_ReadDataByID_NRC33_DIDFE14_SWInformation_Extended_NoSecurityand0x65Security_54408()
{
	testCaseComment("Precondition");
	TestStep("1","Send TesterPresent 3E 00 every 4000ms");
	SendDiag_Request_Verify_Response(DiagAnchor3,"3E 00","7E 00");
	TestStep("2","Send request 10 01 to enter default diagnostic session");
	SendDiag_Request_Verify_Response(DiagAnchor3,"10 01","50 01 00 32 01 F4");
	 testCaseComment("Actions");
	 TestStep("3","Send request 10 03 to enter Extended Diagnostic Session");
	SendDiag_Request_Verify_Response(DiagAnchor3,"10 03","50 03 00 32 01 F4");
	TestStep("4","Send request 22 FE 14 to request ReadDataByIdentifier Service");
	SendDiag_Request_Verify_Negative_Response(DiagAnchor3,"22 FE 14","7F 22 33");
  TestStep("5,6","Send Security Seed Request 65 and Key 66 in DiagAnchor");  
  Security_Seed_Key_Access(Anch3,Physical,Incar_1);
  TestStep("7","Send request 22 FE 14 to request ReadDataByIdentifier Service");
	SendDiag_Request_Verify_Negative_Response(DiagAnchor3,"22 FE 14","7F 22 33");
  TestCaseComment("Postcondition");
	TestStep("8","Send request 10 01 to enter default diagnostic session");
	SendDiag_Request_Verify_Response(DiagAnchor3,"10 01","50 01 00 32 01 F4");
	TestStep("9"," Stop Sending TesterPresent 3E 00 every 4000ms");
}


testcase TCS_PK_FCA_AnchorUDSServer_ReadDataByIdentifier_NRC33_DIDFE1A_BLEorMiniMCURuntimeStats_ExtendedSession_0x65SecurityLevel_54410()
{
	testCaseComment("Precondition");
	TestStep("1","Send TesterPresent 3E 00 every 4000ms");
	SendDiag_Request_Verify_Response(DiagAnchor3,"3E 00","7E 00");
	TestStep("2","Send request 10 01 to enter default diagnostic session");
	SendDiag_Request_Verify_Response(DiagAnchor3,"10 01","50 01 00 32 01 F4");
	testCaseComment("Actions");
  TestStep("3","Send request 10 03 to enter Extended Diagnostic Session");
	SendDiag_Request_Verify_Response(DiagAnchor3,"10 03","50 03 00 32 01 F4");
  TestStep("4,5","Send Security Seed Request 65 and Key 66 in DiagAnchor");  
  Security_Seed_Key_Access(Anch3,Physical,Incar_1);
  TestStep("6","Send request 22 FE 1A to request ReadDataByIdentifier Service");
	SendDiag_Request_Verify_Negative_Response(DiagAnchor3,"22 FE 1A","7F 22 33");
	TestCaseComment("Postcondition");
	TestStep("7","Send request 10 01 to enter default diagnostic session");
	SendDiag_Request_Verify_Response(DiagAnchor3,"10 01","50 01 00 32 01 F4");
	TestStep("8"," Stop Sending TesterPresent 3E 00 every 4000ms");
}


testcase TCS_PK_FCA_AnchorUDSServer_ReadDataByIdentifier_NRC33_DIDFE1A_BLEorMiniMCURuntimeStats_ExtendedSession_NoSecurityLevel_54411()
{
	testCaseComment("Precondition");
	TestStep("1","Send TesterPresent 3E 00 every 4000ms");
	SendDiag_Request_Verify_Response(DiagAnchor3,"3E 00","7E 00");
	TestStep("2","Send request 10 01 to enter Default Diagnostic Session");
	SendDiag_Request_Verify_Response(DiagAnchor3,"10 01","50 01 00 32 01 F4");
  testCaseComment("Actions");
  TestStep("3","Send request 10 03 to enter Extended Diagnostic Session");
	SendDiag_Request_Verify_Response(DiagAnchor3,"10 03","50 03 00 32 01 F4");
  TestStep("4","Send request 22 FE 1A to request ReadDataByIdentifier service");
	SendDiag_Request_Verify_Negative_Response(DiagAnchor3,"22 FE 1A","7F 22 33");
  TestCaseComment("Postcondition");
	TestStep("5","Send request 10 01 to enter default diagnostic session");
	SendDiag_Request_Verify_Response(DiagAnchor3,"10 01","50 01 00 32 01 F4");
  TestStep("6"," Stop Sending TesterPresent 3E 00 every 4000ms");
}


testcase TCS_PK_FCA_AnchorUDSServer_ReadDataByIdentifier_NRC33_DIDFE1C_UWBRuntimeStats_ExtendedSession_0x65SecurityLevel_54413()
{
	testCaseComment("Precondition");
	TestStep("1","Send TesterPresent 3E 00 every 4000ms");
	SendDiag_Request_Verify_Response(DiagAnchor3,"3E 00","7E 00");
	TestStep("2","Send request 10 01 to enter default diagnostic session");
	SendDiag_Request_Verify_Response(DiagAnchor3,"10 01","50 01 00 32 01 F4");
	testCaseComment("Actions");
  TestStep("3","Send request 10 03 to enter Extended Diagnostic Session");
	SendDiag_Request_Verify_Response(DiagAnchor3,"10 03","50 03 00 32 01 F4");
  TestStep("4,5","Send Security Seed Request 65 and Key 66 in DiagAnchor");  
  Security_Seed_Key_Access(Anch3,Physical,Incar_1);
  TestStep("6","Send request 22 FE 1C to request ReadDataByIdentifier Service");
	SendDiag_Request_Verify_Negative_Response(DiagAnchor3,"22 FE 1C","7F 22 33");
	TestCaseComment("Postcondition");
	TestStep("7","Send request 10 01 to enter default diagnostic session");
	SendDiag_Request_Verify_Response(DiagAnchor3,"10 01","50 01 00 32 01 F4");
	TestStep("8"," Stop Sending TesterPresent 3E 00 every 4000ms");
}


testcase TCS_PK_FCA_AnchorUDSServer_ReadDataByIdentifier_NRC33_DIDFE1C_UWBRuntimeStats_ExtendedSession_NoSecurityLevel_54414()
{
	testCaseComment("Precondition");
	TestStep("1","Send TesterPresent 3E 00 every 4000ms");
	SendDiag_Request_Verify_Response(DiagAnchor3,"3E 00","7E 00");
	TestStep("2","Send request 10 01 to enter Default Diagnostic Session");
	SendDiag_Request_Verify_Response(DiagAnchor3,"10 01","50 01 00 32 01 F4");
  testCaseComment("Actions");
  TestStep("3","Send request 10 03 to enter Extended Diagnostic Session");
	SendDiag_Request_Verify_Response(DiagAnchor3,"10 03","50 03 00 32 01 F4");
  TestStep("4","Send request 22 FE 1C to request ReadDataByIdentifier service");
	SendDiag_Request_Verify_Negative_Response(DiagAnchor3,"22 FE 1C","7F 22 33");
  TestCaseComment("Postcondition");
	TestStep("5","Send request 10 01 to enter default diagnostic session");
	SendDiag_Request_Verify_Response(DiagAnchor3,"10 01","50 01 00 32 01 F4");
  TestStep("6"," Stop Sending TesterPresent 3E 00 every 4000ms");
}


testcase TCS_PK_FCA_AnchorUDSServer_ReadDataByIdentifier_NRC33_DIDFE25_SwupStatus_ProgrammingSession_NoSecurityLevel_54416()
{
	testCaseComment("Precondition");
	TestStep("1","Send TesterPresent 3E 00 every 4000ms");
	SendDiag_Request_Verify_Response(DiagAnchor3,"3E 00","7E 00");
	TestStep("2","Send request 10 01 to enter default diagnostic session");
	SendDiag_Request_Verify_Response(DiagAnchor3,"10 01","50 01 00 32 01 F4");
	 TestStep("3","Send request 10 03 to enter Extended Diagnostic Session");
	SendDiag_Request_Verify_Response(DiagAnchor3,"10 03","50 03 00 32 01 F4");
	TestStep("4,5","Send Security Seed Request 61 and Key 62 in DiagAnchor");  
  Security_Seed_Key_Access(Anch3,Physical,Bosch);
	testCaseComment("Actions");
	TestStep("6","Send request 10 02 to enter Programming Diagnostic Session");
	SendDiag_Request_Verify_Response(DiagAnchor3,"10 03","50 03 00 32 01 F4");
	TestStep("7","Send request 22 FE 25 to request ReadDataByIdentifier Service");
	SendDiag_Request_Verify_Negative_Response(DiagAnchor3,"22 FE 25","7F 22 33");
  TestCaseComment("Postcondition");
	TestStep("8","Send request 10 01 to enter default diagnostic session");
	SendDiag_Request_Verify_Response(DiagAnchor3,"10 01","50 01 00 32 01 F4");
	TestStep("9"," Stop Sending TesterPresent 3E 00 every 4000ms");
}


testcase TCS_PK_FCA_AnchorUDSServer_ReadDataByIdentifier_NRC33_DIDFE25_Swupstatus_ProgrammingSession_SecurityLevel0x65_54412()
{
	testCaseComment("Precondition");
	TestStep("1","Send TesterPresent 3E 00 every 4000ms");
	SendDiag_Request_Verify_Response(DiagAnchor3,"3E 00","7E 00");
	TestStep("2","Send request 10 01 to enter default diagnostic session");
	SendDiag_Request_Verify_Response(DiagAnchor3,"10 01","50 01 00 32 01 F4");
	 TestStep("3","Send request 10 03 to enter Extended Diagnostic Session");
	SendDiag_Request_Verify_Response(DiagAnchor3,"10 03","50 03 00 32 01 F4");
	TestStep("4,5","Send Security Seed Request 61 and Key 62 in DiagAnchor");  
  Security_Seed_Key_Access(Anch3,Physical,Bosch);
	testCaseComment("Actions");
	TestStep("6","Send request 10 02 to enter Programming Diagnostic Session");
	SendDiag_Request_Verify_Response(DiagAnchor3,"10 03","50 03 00 32 01 F4");
	TestStep("7,8","Send Security Seed Request 65 and Key 66 in DiagAnchor");  
  Security_Seed_Key_Access(Anch3,Physical,Incar_1);
	TestStep("9","Send request 22 FE 25 to request ReadDataByIdentifier Service");
	SendDiag_Request_Verify_Negative_Response(DiagAnchor3,"22 FE 25","7F 22 33");
  TestCaseComment("Postcondition");
	TestStep("10","Send request 10 01 to enter default diagnostic session");
	SendDiag_Request_Verify_Response(DiagAnchor3,"10 01","50 01 00 32 01 F4");
	TestStep("11"," Stop Sending TesterPresent 3E 00 every 4000ms");
}


testcase TCS_PK_FCA_AnchorUDSServer_ReadDataByIdentifier_NRC33_DIDFE26_R4AppSignature_ProgrammingSession_NoSecurityLevel_54419()
{
	testCaseComment("Precondition");
	TestStep("1","Send TesterPresent 3E 00 every 4000ms");
	SendDiag_Request_Verify_Response(DiagAnchor3,"3E 00","7E 00");
	TestStep("2","Send request 10 01 to enter default diagnostic session");
	SendDiag_Request_Verify_Response(DiagAnchor3,"10 01","50 01 00 32 01 F4");
	 TestStep("3","Send request 10 03 to enter Extended Diagnostic Session");
	SendDiag_Request_Verify_Response(DiagAnchor3,"10 03","50 03 00 32 01 F4");
	TestStep("4,5","Send Security Seed Request 61 and Key 62 in DiagAnchor");  
  Security_Seed_Key_Access(Anch3,Physical,Bosch);
	testCaseComment("Actions");
	TestStep("6","Send request 10 02 to enter Programming Diagnostic Session");
	SendDiag_Request_Verify_Response(DiagAnchor3,"10 03","50 03 00 32 01 F4");
	TestStep("7","Send request 22 FE 26 to request ReadDataByIdentifier Service");
	SendDiag_Request_Verify_Negative_Response(DiagAnchor3,"22 FE 26","7F 22 33");
  TestCaseComment("Postcondition");
	TestStep("8","Send request 10 01 to enter default diagnostic session");
	SendDiag_Request_Verify_Response(DiagAnchor3,"10 01","50 01 00 32 01 F4");
	TestStep("9"," Stop Sending TesterPresent 3E 00 every 4000ms");
}


testcase TCS_PK_FCA_AnchorUDSServer_ReadDataByIdentifier_NRC33_DIDFE26_R4AppSignature_ProgrammingSession_SecurityLevel0x65_54421()
{
	testCaseComment("Precondition");
	TestStep("1","Send TesterPresent 3E 00 every 4000ms");
	SendDiag_Request_Verify_Response(DiagAnchor3,"3E 00","7E 00");
	TestStep("2","Send request 10 01 to enter default diagnostic session");
	SendDiag_Request_Verify_Response(DiagAnchor3,"10 01","50 01 00 32 01 F4");
	 TestStep("3","Send request 10 03 to enter Extended Diagnostic Session");
	SendDiag_Request_Verify_Response(DiagAnchor3,"10 03","50 03 00 32 01 F4");
	TestStep("4,5","Send Security Seed Request 61 and Key 62 in DiagAnchor");  
  Security_Seed_Key_Access(Anch3,Physical,Bosch);
	testCaseComment("Actions");
	TestStep("6","Send request 10 02 to enter Programming Diagnostic Session");
	SendDiag_Request_Verify_Response(DiagAnchor3,"10 03","50 03 00 32 01 F4");
	TestStep("7,8","Send Security Seed Request 65 and Key 66 in DiagAnchor");  
  Security_Seed_Key_Access(Anch3,Physical,Incar_1);
	TestStep("9","Send request 22 FE 26 to request ReadDataByIdentifier Service");
	SendDiag_Request_Verify_Negative_Response(DiagAnchor3,"22 FE 26","7F 22 33");
  TestCaseComment("Postcondition");
	TestStep("10","Send request 10 01 to enter default diagnostic session");
	SendDiag_Request_Verify_Response(DiagAnchor3,"10 01","50 01 00 32 01 F4");
	TestStep("11"," Stop Sending TesterPresent 3E 00 every 4000ms");
}


testcase TCS_PK_FCA_AnchorUDSServer_ReadDataByIdentifier_NRC33_DIDFE27_R4DspSignature_ProgrammingSession_NoSecurityLevel_54422()
{
	testCaseComment("Precondition");
	TestStep("1","Send TesterPresent 3E 00 every 4000ms");
	SendDiag_Request_Verify_Response(DiagAnchor3,"3E 00","7E 00");
	TestStep("2","Send request 10 01 to enter default diagnostic session");
	SendDiag_Request_Verify_Response(DiagAnchor3,"10 01","50 01 00 32 01 F4");
	 TestStep("3","Send request 10 03 to enter Extended Diagnostic Session");
	SendDiag_Request_Verify_Response(DiagAnchor3,"10 03","50 03 00 32 01 F4");
	TestStep("4,5","Send Security Seed Request 61 and Key 62 in DiagAnchor");  
  Security_Seed_Key_Access(Anch3,Physical,Bosch);
	testCaseComment("Actions");
	TestStep("6","Send request 10 02 to enter Programming Diagnostic Session");
	SendDiag_Request_Verify_Response(DiagAnchor3,"10 03","50 03 00 32 01 F4");
	TestStep("7","Send request 22 FE 27 to request ReadDataByIdentifier Service");
	SendDiag_Request_Verify_Negative_Response(DiagAnchor3,"22 FE 27","7F 22 33");
  TestCaseComment("Postcondition");
	TestStep("8","Send request 10 01 to enter default diagnostic session");
	SendDiag_Request_Verify_Response(DiagAnchor3,"10 01","50 01 00 32 01 F4");
	TestStep("9"," Stop Sending TesterPresent 3E 00 every 4000ms");
}


testcase TCS_PK_FCA_AnchorUDSServer_ReadDataByIdentifier_NRC33_DIDFE27_R4DspSignature_ProgrammingSession_SecurityLevel0x65_54423()
{
	testCaseComment("Precondition");
	TestStep("1","Send TesterPresent 3E 00 every 4000ms");
	SendDiag_Request_Verify_Response(DiagAnchor3,"3E 00","7E 00");
	TestStep("2","Send request 10 01 to enter default diagnostic session");
	SendDiag_Request_Verify_Response(DiagAnchor3,"10 01","50 01 00 32 01 F4");
	 TestStep("3","Send request 10 03 to enter Extended Diagnostic Session");
	SendDiag_Request_Verify_Response(DiagAnchor3,"10 03","50 03 00 32 01 F4");
	TestStep("4,5","Send Security Seed Request 61 and Key 62 in DiagAnchor");  
  Security_Seed_Key_Access(Anch3,Physical,Bosch);
	testCaseComment("Actions");
	TestStep("6","Send request 10 02 to enter Programming Diagnostic Session");
	SendDiag_Request_Verify_Response(DiagAnchor3,"10 03","50 03 00 32 01 F4");
	TestStep("7,8","Send Security Seed Request 65 and Key 66 in DiagAnchor");  
  Security_Seed_Key_Access(Anch3,Physical,Incar_1);
	TestStep("9","Send request 22 FE 27 to request ReadDataByIdentifier Service");
	SendDiag_Request_Verify_Negative_Response(DiagAnchor3,"22 FE 27","7F 22 33");
  TestCaseComment("Postcondition");
	TestStep("10","Send request 10 01 to enter default diagnostic session");
	SendDiag_Request_Verify_Response(DiagAnchor3,"10 01","50 01 00 32 01 F4");
	TestStep("11"," Stop Sending TesterPresent 3E 00 every 4000ms");
}


testcase TCS_PK_FCA_AnchorUDSServer_ReadDataByIdentifier_NRC33_DIDFE33_BLEChipTemp_ExtendedSession_NoSecurityLevel_54424()
{
	testCaseComment("Precondition");
	TestStep("1","Send TesterPresent 3E 00 every 4000ms");
	SendDiag_Request_Verify_Response(DiagAnchor3,"3E 00","7E 00");
	TestStep("2","Send request 10 01 to enter Default Diagnostic Session");
	SendDiag_Request_Verify_Response(DiagAnchor3,"10 01","50 01 00 32 01 F4");
  testCaseComment("Actions");
  TestStep("3","Send request 10 03 to enter Extended Diagnostic Session");
	SendDiag_Request_Verify_Response(DiagAnchor3,"10 03","50 03 00 32 01 F4");
  TestStep("4","Send request 22 FE 33 to request ReadDataByIdentifier service");
	SendDiag_Request_Verify_Negative_Response(DiagAnchor3,"22 FE 33","7F 22 33");
  TestCaseComment("Postcondition");
	TestStep("5","Send request 10 01 to enter default diagnostic session");
	SendDiag_Request_Verify_Response(DiagAnchor3,"10 01","50 01 00 32 01 F4");
  TestStep("6"," Stop Sending TesterPresent 3E 00 every 4000ms");
}


testcase TCS_PK_FCA_AnchorUDSServer_ReadDataByIdentifier_NRC33_DIDFE33_BLEChipTemp_ExtendedSession_SecurityLevel0x65_54425()
{
	testCaseComment("Precondition");
	TestStep("1","Send TesterPresent 3E 00 every 4000ms");
	SendDiag_Request_Verify_Response(DiagAnchor3,"3E 00","7E 00");
	TestStep("2","Send request 10 01 to enter default diagnostic session");
	SendDiag_Request_Verify_Response(DiagAnchor3,"10 01","50 01 00 32 01 F4");
	testCaseComment("Actions");
  TestStep("3","Send request 10 03 to enter Extended Diagnostic Session");
	SendDiag_Request_Verify_Response(DiagAnchor3,"10 03","50 03 00 32 01 F4");
  TestStep("4,5","Send Security Seed Request 65 and Key 66 in DiagAnchor");  
  Security_Seed_Key_Access(Anch3,Physical,Incar_1);
  TestStep("6","Send request 22 FE 33 to request ReadDataByIdentifier Service");
	SendDiag_Request_Verify_Negative_Response(DiagAnchor3,"22 FE 33","7F 22 33");
	TestCaseComment("Postcondition");
	TestStep("7","Send request 10 01 to enter default diagnostic session");
	SendDiag_Request_Verify_Response(DiagAnchor3,"10 01","50 01 00 32 01 F4");
	TestStep("8"," Stop Sending TesterPresent 3E 00 every 4000ms");
}


testcase TCS_PK_FCA_AnchorUDSServer_ReadDataByIdentifier_NRC33_DIDFE34_BLEResetCount_ExtendedSession_NoSecurityLevel_54426()
{
	testCaseComment("Precondition");
	TestStep("1","Send TesterPresent 3E 00 every 4000ms");
	SendDiag_Request_Verify_Response(DiagAnchor3,"3E 00","7E 00");
	TestStep("2","Send request 10 01 to enter Default Diagnostic Session");
	SendDiag_Request_Verify_Response(DiagAnchor3,"10 01","50 01 00 32 01 F4");
  testCaseComment("Actions");
  TestStep("3","Send request 10 03 to enter Extended Diagnostic Session");
	SendDiag_Request_Verify_Response(DiagAnchor3,"10 03","50 03 00 32 01 F4");
  TestStep("4","Send request 22 FE 34 to request ReadDataByIdentifier service");
	SendDiag_Request_Verify_Negative_Response(DiagAnchor3,"22 FE 34","7F 22 33");
  TestCaseComment("Postcondition");
	TestStep("5","Send request 10 01 to enter default diagnostic session");
	SendDiag_Request_Verify_Response(DiagAnchor3,"10 01","50 01 00 32 01 F4");
  TestStep("6"," Stop Sending TesterPresent 3E 00 every 4000ms");
}


testcase TCS_PK_FCA_AnchorUDSServer_ReadDataByIdentifier_NRC33_DIDFE34_BLEResetCount_ExtendedSession_SecurityLevel0x65_54428()
{
	testCaseComment("Precondition");
	TestStep("1","Send TesterPresent 3E 00 every 4000ms");
	SendDiag_Request_Verify_Response(DiagAnchor3,"3E 00","7E 00");
	TestStep("2","Send request 10 01 to enter default diagnostic session");
	SendDiag_Request_Verify_Response(DiagAnchor3,"10 01","50 01 00 32 01 F4");
	testCaseComment("Actions");
  TestStep("3","Send request 10 03 to enter Extended Diagnostic Session");
	SendDiag_Request_Verify_Response(DiagAnchor3,"10 03","50 03 00 32 01 F4");
  TestStep("4,5","Send Security Seed Request 65 and Key 66 in DiagAnchor");  
  Security_Seed_Key_Access(Anch3,Physical,Incar_1);
  TestStep("6","Send request 22 FE 34 to request ReadDataByIdentifier Service");
	SendDiag_Request_Verify_Negative_Response(DiagAnchor3,"22 FE 34","7F 22 33");
	TestCaseComment("Postcondition");
	TestStep("7","Send request 10 01 to enter default diagnostic session");
	SendDiag_Request_Verify_Response(DiagAnchor3,"10 01","50 01 00 32 01 F4");
	TestStep("8"," Stop Sending TesterPresent 3E 00 every 4000ms");
}


testcase TCS_PK_FCA_AnchorUDSServer_ReadDataByIdentifier_NRC33_DIDFE35_BLEResetCause_ExtendedSession_SecurityLevel0x65_54430()
{
	testCaseComment("Precondition");
	TestStep("1","Send TesterPresent 3E 00 every 4000ms");
	SendDiag_Request_Verify_Response(DiagAnchor3,"3E 00","7E 00");
	TestStep("2","Send request 10 01 to enter default diagnostic session");
	SendDiag_Request_Verify_Response(DiagAnchor3,"10 01","50 01 00 32 01 F4");
	testCaseComment("Actions");
  TestStep("3","Send request 10 03 to enter Extended Diagnostic Session");
	SendDiag_Request_Verify_Response(DiagAnchor3,"10 03","50 03 00 32 01 F4");
  TestStep("4,5","Send Security Seed Request 65 and Key 66 in DiagAnchor");  
  Security_Seed_Key_Access(Anch3,Physical,Incar_1);
  TestStep("6","Send request 22 FE 35 to request ReadDataByIdentifier Service");
	SendDiag_Request_Verify_Negative_Response(DiagAnchor3,"22 FE 35","7F 22 33");
	TestCaseComment("Postcondition");
	TestStep("7","Send request 10 01 to enter default diagnostic session");
	SendDiag_Request_Verify_Response(DiagAnchor3,"10 01","50 01 00 32 01 F4");
	TestStep("8"," Stop Sending TesterPresent 3E 00 every 4000ms");
}


testcase TCS_PK_FCA_AnchorUDSServer_ReadDataByIdentifier_NRC33_DIDFE35_Last10BLEResetCause_ExtendedSession_NoSecurityLevel_54431()
{
	testCaseComment("Precondition");
	TestStep("1","Send TesterPresent 3E 00 every 4000ms");
	SendDiag_Request_Verify_Response(DiagAnchor3,"3E 00","7E 00");
	TestStep("2","Send request 10 01 to enter Default Diagnostic Session");
	SendDiag_Request_Verify_Response(DiagAnchor3,"10 01","50 01 00 32 01 F4");
  testCaseComment("Actions");
  TestStep("3","Send request 10 03 to enter Extended Diagnostic Session");
	SendDiag_Request_Verify_Response(DiagAnchor3,"10 03","50 03 00 32 01 F4");
  TestStep("4","Send request 22 FE 35 to request ReadDataByIdentifier service");
	SendDiag_Request_Verify_Negative_Response(DiagAnchor3,"22 FE 35","7F 22 33");
  TestCaseComment("Postcondition");
	TestStep("5","Send request 10 01 to enter default diagnostic session");
	SendDiag_Request_Verify_Response(DiagAnchor3,"10 01","50 01 00 32 01 F4");
  TestStep("6"," Stop Sending TesterPresent 3E 00 every 4000ms");
}


testcase TCS_PK_FCA_AnchorUDSServer_ReadDataByIdentifier_NRC33_DIDFE40_ExtendedSession_NoSecurityLeveland0x65SecurityLevel_54427()
{
	testCaseComment("Precondition");
	TestStep("1","Send TesterPresent 3E 00 every 4000ms");
	SendDiag_Request_Verify_Response(DiagAnchor3,"3E 00","7E 00");
	TestStep("2","Send request 10 01 to enter default diagnostic session");
	SendDiag_Request_Verify_Response(DiagAnchor3,"10 01","50 01 00 32 01 F4");
	testCaseComment("Actions");
	 TestStep("3","Send request 10 03 to enter Extended Diagnostic Session");
	SendDiag_Request_Verify_Response(DiagAnchor3,"10 03","50 03 00 32 01 F4");
	TestStep("4","Send request 22 FE 40 to request ReadDataByIdentifier Service");
	SendDiag_Request_Verify_Negative_Response(DiagAnchor3,"22 FE 40","7F 22 33");
	TestStep("5,6","Send Security Seed Request 61 and Key 62 in DiagAnchor");  
  Security_Seed_Key_Access(Anch3,Physical,Bosch);
	TestStep("7","Send request 22 FE 40 to request ReadDataByIdentifier Service");
	SendDiag_Request_Verify_Negative_Response(DiagAnchor3,"22 FE 40","7F 22 33");
  TestCaseComment("Postcondition");
	TestStep("8","Send request 10 01 to enter default diagnostic session");
	SendDiag_Request_Verify_Response(DiagAnchor3,"10 01","50 01 00 32 01 F4");
	TestStep("9"," Stop Sending TesterPresent 3E 00 every 4000ms");
}


testcase TCS_PK_FCA_AnchorUDSServer_ReadDataByIdentifier_NRC33_DIDFE43_ExtendedSession_0x65SecurityLevel_54436()
{
	testCaseComment("Precondition");
	TestStep("1","Send TesterPresent 3E 00 every 4000ms");
	SendDiag_Request_Verify_Response(DiagAnchor3,"3E 00","7E 00");
	TestStep("2","Send request 10 01 to enter default diagnostic session");
	SendDiag_Request_Verify_Response(DiagAnchor3,"10 01","50 01 00 32 01 F4");
	testCaseComment("Actions");
  TestStep("3","Send request 10 03 to enter Extended Diagnostic Session");
	SendDiag_Request_Verify_Response(DiagAnchor3,"10 03","50 03 00 32 01 F4");
  TestStep("4,5","Send Security Seed Request 65 and Key 66 in DiagAnchor");  
  Security_Seed_Key_Access(Anch3,Physical,Incar_1);
  TestStep("6","Send request 22 FE 43 to request ReadDataByIdentifier Service");
	SendDiag_Request_Verify_Negative_Response(DiagAnchor3,"22 FE 43","7F 22 33");
	TestCaseComment("Postcondition");
	TestStep("7","Send request 10 01 to enter default diagnostic session");
	SendDiag_Request_Verify_Response(DiagAnchor3,"10 01","50 01 00 32 01 F4");
	TestStep("8"," Stop Sending TesterPresent 3E 00 every 4000ms");
}


testcase TCS_PK_FCA_AnchorUDSServer_ReadDataByIdentifier_NRC33_DIDFE43_BLEResolvablePrivateAddress_ExtendedSession_NoSecurityLevel_54434()
{
	testCaseComment("Precondition");
	TestStep("1","Send TesterPresent 3E 00 every 4000ms");
	SendDiag_Request_Verify_Response(DiagAnchor3,"3E 00","7E 00");
	TestStep("2","Send request 10 01 to enter Default Diagnostic Session");
	SendDiag_Request_Verify_Response(DiagAnchor3,"10 01","50 01 00 32 01 F4");
  testCaseComment("Actions");
  TestStep("3","Send request 10 03 to enter Extended Diagnostic Session");
	SendDiag_Request_Verify_Response(DiagAnchor3,"10 03","50 03 00 32 01 F4");
  TestStep("4","Send request 22 FE 43 to request ReadDataByIdentifier service");
	SendDiag_Request_Verify_Negative_Response(DiagAnchor3,"22 FE 43","7F 22 33");
  TestCaseComment("Postcondition");
	TestStep("5","Send request 10 01 to enter default diagnostic session");
	SendDiag_Request_Verify_Response(DiagAnchor3,"10 01","50 01 00 32 01 F4");
  TestStep("6"," Stop Sending TesterPresent 3E 00 every 4000ms");
}


testcase TCS_PK_FCA_AnchorUDSServer_ReadDataByIdentifier_NRC33_DIDFEA1_AnchorIDTestMode_ExtendedSession_NoSecurityLevel_54438()
{
	testCaseComment("Precondition");
	TestStep("1","Send TesterPresent 3E 00 every 4000ms");
	SendDiag_Request_Verify_Response(DiagAnchor3,"3E 00","7E 00");
	TestStep("2","Send request 10 01 to enter Default Diagnostic Session");
	SendDiag_Request_Verify_Response(DiagAnchor3,"10 01","50 01 00 32 01 F4");
  testCaseComment("Actions");
  TestStep("3","Send request 10 03 to enter Extended Diagnostic Session");
	SendDiag_Request_Verify_Response(DiagAnchor3,"10 03","50 03 00 32 01 F4");
  TestStep("4","Send request 22 FE A1 to request ReadDataByIdentifier service");
	SendDiag_Request_Verify_Negative_Response(DiagAnchor3,"22 FE A1","7F 22 33");
  TestCaseComment("Postcondition");
	TestStep("5","Send request 10 01 to enter default diagnostic session");
	SendDiag_Request_Verify_Response(DiagAnchor3,"10 01","50 01 00 32 01 F4");
  TestStep("6"," Stop Sending TesterPresent 3E 00 every 4000ms");
}


testcase TCS_PK_FCA_AnchorUDSServer_ReadDataByIdentifier_NRC33_DIDFEA1_AnchorIDTestMode_ExtendedSession_SecurityLevel0x65_54440()
{
	testCaseComment("Precondition");
	TestStep("1","Send TesterPresent 3E 00 every 4000ms");
	SendDiag_Request_Verify_Response(DiagAnchor3,"3E 00","7E 00");
	TestStep("2","Send request 10 01 to enter default diagnostic session");
	SendDiag_Request_Verify_Response(DiagAnchor3,"10 01","50 01 00 32 01 F4");
	testCaseComment("Actions");
  TestStep("3","Send request 10 03 to enter Extended Diagnostic Session");
	SendDiag_Request_Verify_Response(DiagAnchor3,"10 03","50 03 00 32 01 F4");
  TestStep("4,5","Send Security Seed Request 65 and Key 66 in DiagAnchor");  
  Security_Seed_Key_Access(Anch3,Physical,Incar_1);
  TestStep("6","Send request 22 FE A1 to request ReadDataByIdentifier Service");
	SendDiag_Request_Verify_Negative_Response(DiagAnchor3,"22 FE A1","7F 22 33");
	TestCaseComment("Postcondition");
	TestStep("7","Send request 10 01 to enter default diagnostic session");
	SendDiag_Request_Verify_Response(DiagAnchor3,"10 01","50 01 00 32 01 F4");
	TestStep("8"," Stop Sending TesterPresent 3E 00 every 4000ms");
}


testcase TCS_PK_FCA_AnchorUDSServer_ReadDataByIdentifier_NRC33_DIDFEA4_RFTestMode_ExtendedSession_NoSecurityLevel_54437()
{
	testCaseComment("Precondition");
	TestStep("1","Send TesterPresent 3E 00 every 4000ms");
	SendDiag_Request_Verify_Response(DiagAnchor3,"3E 00","7E 00");
	TestStep("2","Send request 10 01 to enter Default Diagnostic Session");
	SendDiag_Request_Verify_Response(DiagAnchor3,"10 01","50 01 00 32 01 F4");
  testCaseComment("Actions");
  TestStep("3","Send request 10 03 to enter Extended Diagnostic Session");
	SendDiag_Request_Verify_Response(DiagAnchor3,"10 03","50 03 00 32 01 F4");
  TestStep("4","Send request 22 FE A4 to request ReadDataByIdentifier service");
	SendDiag_Request_Verify_Negative_Response(DiagAnchor3,"22 FE A4","7F 22 33");
  TestCaseComment("Postcondition");
	TestStep("5","Send request 10 01 to enter default diagnostic session");
	SendDiag_Request_Verify_Response(DiagAnchor3,"10 01","50 01 00 32 01 F4");
  TestStep("6"," Stop Sending TesterPresent 3E 00 every 4000ms");
}


testcase TCS_PK_FCA_AnchorUDSServer_ReadDataByIdentifier_NRC33_DIDFEA4_RFTestMode_ExtendedSession_SecurityLevel0x65_54392()
{
	testCaseComment("Precondition");
	TestStep("1","Send TesterPresent 3E 00 every 4000ms");
	SendDiag_Request_Verify_Response(DiagAnchor3,"3E 00","7E 00");
	TestStep("2","Send request 10 01 to enter default diagnostic session");
	SendDiag_Request_Verify_Response(DiagAnchor3,"10 01","50 01 00 32 01 F4");
	testCaseComment("Actions");
  TestStep("3","Send request 10 03 to enter Extended Diagnostic Session");
	SendDiag_Request_Verify_Response(DiagAnchor3,"10 03","50 03 00 32 01 F4");
  TestStep("4,5","Send Security Seed Request 65 and Key 66 in DiagAnchor");  
  Security_Seed_Key_Access(Anch3,Physical,Incar_1);
  TestStep("6","Send request 22 FE A4 to request ReadDataByIdentifier Service");
	SendDiag_Request_Verify_Negative_Response(DiagAnchor3,"22 FE A4","7F 22 33");
	TestCaseComment("Postcondition");
	TestStep("7","Send request 10 01 to enter default diagnostic session");
	SendDiag_Request_Verify_Response(DiagAnchor3,"10 01","50 01 00 32 01 F4");
	TestStep("8"," Stop Sending TesterPresent 3E 00 every 4000ms");
}


testcase TCS_PK_FCA_AnchorUDSServer_ReadDataByIdentifier_NRC33_DIDFEB0_ExtendedSession_0x65SecurityLevel_54394()
{
	testCaseComment("Precondition");
	TestStep("1","Send TesterPresent 3E 00 every 4000ms");
	SendDiag_Request_Verify_Response(DiagAnchor3,"3E 00","7E 00");
	TestStep("2","Send request 10 01 to enter default diagnostic session");
	SendDiag_Request_Verify_Response(DiagAnchor3,"10 01","50 01 00 32 01 F4");
	testCaseComment("Actions");
  TestStep("3","Send request 10 03 to enter Extended Diagnostic Session");
	SendDiag_Request_Verify_Response(DiagAnchor3,"10 03","50 03 00 32 01 F4");
  TestStep("4,5","Send Security Seed Request 65 and Key 66 in DiagAnchor");  
  Security_Seed_Key_Access(Anch3,Physical,Incar_1);
  TestStep("6","Send request 22 FE B0 to request ReadDataByIdentifier Service");
	SendDiag_Request_Verify_Negative_Response(DiagAnchor3,"22 FE B0","7F 22 33");
	TestCaseComment("Postcondition");
	TestStep("7","Send request 10 01 to enter default diagnostic session");
	SendDiag_Request_Verify_Response(DiagAnchor3,"10 01","50 01 00 32 01 F4");
	TestStep("8"," Stop Sending TesterPresent 3E 00 every 4000ms");
}


testcase TCS_PK_FCA_AnchorUDSServer_ReadDataByIdentifier_NRC33_DIDFEB0_ExtendedSession_NoSecurityLevel_54389()
{
	testCaseComment("Precondition");
	TestStep("1","Send TesterPresent 3E 00 every 4000ms");
	SendDiag_Request_Verify_Response(DiagAnchor3,"3E 00","7E 00");
	TestStep("2","Send request 10 01 to enter Default Diagnostic Session");
	SendDiag_Request_Verify_Response(DiagAnchor3,"10 01","50 01 00 32 01 F4");
  testCaseComment("Actions");
  TestStep("3","Send request 10 03 to enter Extended Diagnostic Session");
	SendDiag_Request_Verify_Response(DiagAnchor3,"10 03","50 03 00 32 01 F4");
  TestStep("4","Send request 22 FE B0 to request ReadDataByIdentifier service");
	SendDiag_Request_Verify_Negative_Response(DiagAnchor3,"22 FE B0","7F 22 33");
  TestCaseComment("Postcondition");
	TestStep("5","Send request 10 01 to enter default diagnostic session");
	SendDiag_Request_Verify_Response(DiagAnchor3,"10 01","50 01 00 32 01 F4");
  TestStep("6"," Stop Sending TesterPresent 3E 00 every 4000ms");
}


testcase TCS_PK_FCA_AnchorUDSServer_ReadDataByIdentifier_NRC33_DIDFEB1_UWBRadioTXPower_ExtendedSession_0x65SecurityLevel_54560()
{
	testCaseComment("Precondition");
	TestStep("1","Send TesterPresent 3E 00 every 4000ms");
	SendDiag_Request_Verify_Response(DiagAnchor3,"3E 00","7E 00");
	TestStep("2","Send request 10 01 to enter default diagnostic session");
	SendDiag_Request_Verify_Response(DiagAnchor3,"10 01","50 01 00 32 01 F4");
	 TestStep("3","Send request 10 03 to enter Extended Diagnostic Session");
	SendDiag_Request_Verify_Response(DiagAnchor3,"10 03","50 03 00 32 01 F4");
	TestStep("4,5","Send Security Seed Request 61 and Key 62 in DiagAnchor");  
  Security_Seed_Key_Access(Anch3,Physical,Bosch);
	testCaseComment("Actions");
	TestStep("6","Send request 10 02 to enter Programming Diagnostic Session");
	SendDiag_Request_Verify_Response(DiagAnchor3,"10 03","50 03 00 32 01 F4");
	TestStep("7,8","Send Security Seed Request 65 and Key 66 in DiagAnchor");  
  Security_Seed_Key_Access(Anch3,Physical,Incar_1);
	TestStep("9","Send request 22 FE B1 to request ReadDataByIdentifier Service");
	SendDiag_Request_Verify_Negative_Response(DiagAnchor3,"22 FE B1","7F 22 33");
  TestCaseComment("Postcondition");
	TestStep("10","Send request 10 01 to enter default diagnostic session");
	SendDiag_Request_Verify_Response(DiagAnchor3,"10 01","50 01 00 32 01 F4");
	TestStep("11"," Stop Sending TesterPresent 3E 00 every 4000ms");
}


testcase TCS_PK_FCA_AnchorUDSServer_ReadDataByIdentifier_NRC33_DIDFEB1_UWBRadioTXPower_ExtendedSession_NoSecurityLevel_54561()
{
	testCaseComment("Precondition");
	TestStep("1","Send TesterPresent 3E 00 every 4000ms");
	SendDiag_Request_Verify_Response(DiagAnchor3,"3E 00","7E 00");
	TestStep("2","Send request 10 01 to enter Default Diagnostic Session");
	SendDiag_Request_Verify_Response(DiagAnchor3,"10 01","50 01 00 32 01 F4");
  testCaseComment("Actions");
  TestStep("3","Send request 10 03 to enter Extended Diagnostic Session");
	SendDiag_Request_Verify_Response(DiagAnchor3,"10 03","50 03 00 32 01 F4");
  TestStep("4","Send request 22 FE B1 to request ReadDataByIdentifier service");
	SendDiag_Request_Verify_Negative_Response(DiagAnchor3,"22 FE B1","7F 22 33");
  TestCaseComment("Postcondition");
	TestStep("5","Send request 10 01 to enter default diagnostic session");
	SendDiag_Request_Verify_Response(DiagAnchor3,"10 01","50 01 00 32 01 F4");
  TestStep("6"," Stop Sending TesterPresent 3E 00 every 4000ms");
}


testcase TCS_PK_FCA_AnchorUDSServer_ReadDataByIdentifier_NRC33_DIDFEB2_ExtendedSession_0x65SecurityLevel_54559()
{
	testCaseComment("Precondition");
	TestStep("1","Send TesterPresent 3E 00 every 4000ms");
	SendDiag_Request_Verify_Response(DiagAnchor3,"3E 00","7E 00");
	TestStep("2","Send request 10 01 to enter default diagnostic session");
	SendDiag_Request_Verify_Response(DiagAnchor3,"10 01","50 01 00 32 01 F4");
	 TestStep("3","Send request 10 03 to enter Extended Diagnostic Session");
	SendDiag_Request_Verify_Response(DiagAnchor3,"10 03","50 03 00 32 01 F4");
	TestStep("4,5","Send Security Seed Request 61 and Key 62 in DiagAnchor");  
  Security_Seed_Key_Access(Anch3,Physical,Bosch);
	testCaseComment("Actions");
	TestStep("6","Send request 10 02 to enter Programming Diagnostic Session");
	SendDiag_Request_Verify_Response(DiagAnchor3,"10 03","50 03 00 32 01 F4");
	TestStep("7,8","Send Security Seed Request 65 and Key 66 in DiagAnchor");  
  Security_Seed_Key_Access(Anch3,Physical,Incar_1);
	TestStep("9","Send request 22 FE B2 to request ReadDataByIdentifier Service");
	SendDiag_Request_Verify_Negative_Response(DiagAnchor3,"22 FE B2","7F 22 33");
  TestCaseComment("Postcondition");
	TestStep("10","Send request 10 01 to enter default diagnostic session");
	SendDiag_Request_Verify_Response(DiagAnchor3,"10 01","50 01 00 32 01 F4");
	TestStep("11"," Stop Sending TesterPresent 3E 00 every 4000ms");
}


testcase TCS_PK_FCA_AnchorUDSServer_ReadDataByID_NRC33_DIDFEB2_Extended_NoSecurity_54704()
{
	testCaseComment("Precondition");
	TestStep("1","Send TesterPresent 3E 00 every 4000ms");
	SendDiag_Request_Verify_Response(DiagAnchor3,"3E 00","7E 00");
	TestStep("2","Send request 10 01 to enter Default Diagnostic Session");
	SendDiag_Request_Verify_Response(DiagAnchor3,"10 01","50 01 00 32 01 F4");
  testCaseComment("Actions");
  TestStep("3","Send request 10 03 to enter Extended Diagnostic Session");
	SendDiag_Request_Verify_Response(DiagAnchor3,"10 03","50 03 00 32 01 F4");
  TestStep("4","Send request 22 FE B2 to request ReadDataByIdentifier service");
	SendDiag_Request_Verify_Negative_Response(DiagAnchor3,"22 FE B2","7F 22 33");
  TestCaseComment("Postcondition");
	TestStep("5","Send request 10 01 to enter default diagnostic session");
	SendDiag_Request_Verify_Response(DiagAnchor3,"10 01","50 01 00 32 01 F4");
  TestStep("6"," Stop Sending TesterPresent 3E 00 every 4000ms");
}


testcase TCS_PK_FCA_AnchorUDSServer_ReadDataByIdentifier_NRC33_DIDFEE1_ECUChipVersions_ExtendedSession_NoSecurityLevel_54706()
{
	testCaseComment("Precondition");
	TestStep("1","Send TesterPresent 3E 00 every 4000ms");
	SendDiag_Request_Verify_Response(DiagAnchor3,"3E 00","7E 00");
	TestStep("2","Send request 10 01 to enter Default Diagnostic Session");
	SendDiag_Request_Verify_Response(DiagAnchor3,"10 01","50 01 00 32 01 F4");
  testCaseComment("Actions");
  TestStep("3","Send request 10 03 to enter Extended Diagnostic Session");
	SendDiag_Request_Verify_Response(DiagAnchor3,"10 03","50 03 00 32 01 F4");
  TestStep("4","Send request 22 FE E1 to request ReadDataByIdentifier service");
	SendDiag_Request_Verify_Negative_Response(DiagAnchor3,"22 FE E1","7F 22 33");
  TestCaseComment("Postcondition");
	TestStep("5","Send request 10 01 to enter default diagnostic session");
	SendDiag_Request_Verify_Response(DiagAnchor3,"10 01","50 01 00 32 01 F4");
  TestStep("6"," Stop Sending TesterPresent 3E 00 every 4000ms");
}






///////////////////////////////////RoutineControl_NRC33////////////////////////////////////////

testcase TCS_PK_FCA_AnchorUDS_RoutineControl_NRC33_RIDFA01_BLERxSensitivityTest_SFID0x01_Extended_NoSecurity0x65Security_46904()
///////TestCase needs to be executed only on Combi-Anchor
{
  PreCondition_Anchor("TCS_PK_FCA_AnchorUDSServer_RoutineControl_NRC33_RIDFA01_BLERxSensitivityTest_SFID0x01_ExtendedSession_NoSecurityLevelAnd0x65SecurityLevel_46904");
  testCaseComment("Actions");
  TestStep("1","Send request 10 03 to enter Extended Diagnostic Session");
	SendDiag_Request_Verify_Response(DiagAnchor3,"10 03","50 03 00 32 01 F4");
  TestStep("2","Send request 31 01 FA 01 80 EA CA 80 00 01 30 00 00 01 to request routine control services");
        SendDiag_Request_Verify_Negative_Response(DiagAnchor3,"31 01 FA 01 80 EA CA 80 00 01 30 00 00 01","7F 31 33");
  TestStep("3,4","Send security unlock request 65 and 66");   
       	Security_Seed_Key_Access(Anch3,Physical,Incar_1);
  TestStep("5","Send request 31 01 FA 01 80 EA CA 80 00 01 30 00 00 01 to request routine control services");
        SendDiag_Request_Verify_Negative_Response(DiagAnchor3,"31 01 FA 01 80 EA CA 80 00 01 30 00 00 01","7F 31 33");
  PostCondition_Anchor( );
  }
  
testcase TCS_PK_FCA_AnchorUDS_RoutineControl_NRC33_RIDFA02_BLETxPowerTest_SFID0x01_Extended_NoSecurity0x65Security_46910()
///////TestCase needs to be executed only on Combi-Anchor
{
  PreCondition_Anchor("TCS_PK_FCA_AnchorUDSServer_RoutineControl_NRC33_RIDFA02_BLETxPowerTest_SFID0x01_ExtendedSession_NoSecurityLevelAnd0x65SecurityLevel_46910");
  testCaseComment("Actions");
  TestStep("1","Send request 10 03 to enter Extended Diagnostic Session");
	SendDiag_Request_Verify_Response(DiagAnchor3,"10 03","50 03 00 32 01 F4");
  TestStep("2","Send request 31 01 FA 02 01 00 64 00 01 to request routine control services");
        SendDiag_Request_Verify_Negative_Response(DiagAnchor3,"31 01 FA 02 01 00 64 00 01","7F 31 33");
  TestStep("3,4","Send security unlock request 65 and 66");   
       	Security_Seed_Key_Access(Anch3,Physical,Incar_1);
  TestStep("5","Send request 31 01 FA 02 01 00 64 00 01 to request routine control services");
        SendDiag_Request_Verify_Negative_Response(DiagAnchor3,"31 01 FA 02 01 00 64 00 01","7F 31 33");
  PostCondition_Anchor( );
  }

testcase TCS_PK_FCA_AnchorUDS_RoutineControl_NRC33_RIDFA03_AnchorImcRoundTripTest_SFID0x01_Extended_NoSecurity0x65Security_46922()
{
  PreCondition_Anchor("testcase TCS_PK_FCA_AnchorUDSServer_RoutineControl_NRC33_RIDFA03_AnchorImcRoundTripTest_SFID0x01_ExtendedSession_NoSecurityLevelAnd0x65SecurityLevel_46922");
  testCaseComment("Actions");
  TestStep("1","Send request 10 03 to enter Extended Diagnostic Session");
	SendDiag_Request_Verify_Response(DiagAnchor3,"10 03","50 03 00 32 01 F4");
  TestStep("2","Send request 31 01 FA 03 00 10 10 to request routine control services");
        SendDiag_Request_Verify_Negative_Response(DiagAnchor3,"31 01 FA 03 00 10 10","7F 31 33");
  TestStep("3,4","Send security unlock request 65 and 66");   
       	Security_Seed_Key_Access(Anch3,Physical,Incar_1);
  TestStep("5","Send request 31 01 FA 03 00 10 10 to request routine control services");
        SendDiag_Request_Verify_Negative_Response(DiagAnchor3,"31 01 FA 03 00 10 10","7F 31 33");
  PostCondition_Anchor( );
  }

testcase TCS_PK_FCA_AnchorUDS_RoutineControl_NRC33_RIDFA04_BLERSSMeasurement_SFID0x01_Extended_NoSecurity0x65Security_46928()
///////TestCase needs to be executed only on Combi-Anchor
{
  PreCondition_Anchor("testcase TCS_PK_FCA_AnchorUDSServer_RoutineControl_NRC33_RIDFA04_BLERSSMeasurement_SFID0x01_ExtendedSession_NoSecurityLevelAnd0x65SecurityLevel_46928");
  testCaseComment("Actions");
  TestStep("1","Send request 10 03 to enter Extended Diagnostic Session");
	SendDiag_Request_Verify_Response(DiagAnchor3,"10 03","50 03 00 32 01 F4");
  TestStep("2","Send request 31 01 FA 04 01 0B B8 00 02 to request routine control services");
        SendDiag_Request_Verify_Negative_Response(DiagAnchor3,"31 01 FA 04 01 0B B8 00 02","7F 31 33");
  TestStep("3,4","Send security unlock request 65 and 66");   
       	Security_Seed_Key_Access(Anch3,Physical,Incar_1);
  TestStep("5","Send request 31 01 FA 04 01 0B B8 00 02 to request routine control services");
        SendDiag_Request_Verify_Negative_Response(DiagAnchor3,"31 01 FA 04 01 0B B8 00 02","7F 31 33");
  PostCondition_Anchor( );
  }

testcase TCS_PK_FCA_AnchorUDS_RoutineControl_NRC33_RIDFA05_FastSleep_ExtendedSession_NoSecurityLevelAnd0x65SecurityLevel_46940()
{
  PreCondition_Anchor("testcase TCS_PK_FCA_AnchorUDSServer_RoutineControl_NRC33_RIDFA05_FastSleep_ExtendedSession_NoSecurityLevelAnd0x65SecurityLevel_46940");
  testCaseComment("Actions");
  TestStep("1","Send request 10 03 to enter Extended Diagnostic Session");
	SendDiag_Request_Verify_Response(DiagAnchor3,"10 03","50 03 00 32 01 F4");
  TestStep("2","Send request 31 01 FA 05 00 to request routine control services");
        SendDiag_Request_Verify_Negative_Response(DiagAnchor3,"31 01 FA 05 00","7F 31 33");
  TestStep("3,4","Send security unlock request 65 and 66");   
       	Security_Seed_Key_Access(Anch3,Physical,Incar_1);
  TestStep("5","Send request 31 01 FA 05 00 to request routine control services");
        SendDiag_Request_Verify_Negative_Response(DiagAnchor3,"31 01 FA 05 00","7F 31 33");
  PostCondition_Anchor( );
  }
  
testcase TCS_PK_FCA_AnchorUDS_RoutineControl_NRC33_RIDFA08_uwbFramesTx_SFID0x01_ExtendedSession_NoSecurity0x65Security_46946()
{
  PreCondition_Anchor("testcase TCS_PK_FCA_AnchorUDSServer_RoutineControl_NRC33_RIDFA08_uwbFramesTx_SFID0x01_ExtendedSession_NoSecurityLevelAnd0x65SecurityLevel_46946");
  testCaseComment("Actions");
  TestStep("1","Send request 10 03 to enter Extended Diagnostic Session");
	SendDiag_Request_Verify_Response(DiagAnchor3,"10 03","50 03 00 32 01 F4");
  TestStep("2","Send request 31 01 FA 08 05 01 23 45 67 00 01 to request routine control services");
        SendDiag_Request_Verify_Negative_Response(DiagAnchor3,"31 01 FA 08 05 01 23 45 67 00 01","7F 31 33");
  TestStep("3,4","Send security unlock request 65 and 66");   
       	Security_Seed_Key_Access(Anch3,Physical,Incar_1);
  TestStep("5","Send request 31 01 FA 08 05 01 23 45 67 00 01 to request routine control services");
        SendDiag_Request_Verify_Negative_Response(DiagAnchor3,"31 01 FA 08 05 01 23 45 67 00 01","7F 31 33");
  PostCondition_Anchor( );
  }
  
testcase TCS_PK_FCA_AnchorUDS_RoutineControl_NRC33_RIDFA09_uwbFramesRx_SFID0x01_Extended_NoSecurity0x65Security_46952()
{
  PreCondition_Anchor("testcase TCS_PK_FCA_AnchorUDSServer_RoutineControl_NRC33_RIDFA09_uwbFramesRx_SFID0x01_ExtendedSession_NoSecurityLevelAnd0x65SecurityLevel_46952");
  testCaseComment("Actions");
  TestStep("1","Send request 10 03 to enter Extended Diagnostic Session");
	SendDiag_Request_Verify_Response(DiagAnchor3,"10 03","50 03 00 32 01 F4");
  TestStep("2","Send request 31 01 FA 09 13 88 05 00 01 to request routine control services");
        SendDiag_Request_Verify_Negative_Response(DiagAnchor3,"31 01 FA 09 13 88 05 00 01","7F 31 33");
  TestStep("3,4","Send security unlock request 65 and 66");   
       	Security_Seed_Key_Access(Anch3,Physical,Incar_1);
  TestStep("5","Send request 31 01 FA 09 13 88 05 00 01 to request routine control services");
        SendDiag_Request_Verify_Negative_Response(DiagAnchor3,"31 01 FA 09 13 88 05 00 01","7F 31 33");
  PostCondition_Anchor( );
  }

testcase TCS_PK_FCA_AnchorUDS_RoutineControl_NRC33_RIDFA0A_UWBTxLoopback_SFID0x01_Extended_NoSecurity0x65Security_46964()
{
  PreCondition_Anchor("testcase TCS_PK_FCA_AnchorUDSServer_RoutineControl_NRC33_RIDFA0A_UWBTxLoopback_SFID0x01_ExtendedSession_NoSecurityLevelAnd0x65SecurityLevel_46964");
  testCaseComment("Actions");
  TestStep("1","Send request 10 03 to enter Extended Diagnostic Session");
	SendDiag_Request_Verify_Response(DiagAnchor3,"10 03","50 03 00 32 01 F4");
  TestStep("2","Send request 31 01 FA 0A 00 00 00 05 to request routine control services");
        SendDiag_Request_Verify_Negative_Response(DiagAnchor3,"31 01 FA 0A 00 00 00 05","7F 31 33");
  TestStep("3,4","Send security unlock request 65 and 66");   
       	Security_Seed_Key_Access(Anch3,Physical,Incar_1);
  TestStep("5","Send request 31 01 FA 0A 00 00 00 05 to request routine control services");
        SendDiag_Request_Verify_Negative_Response(DiagAnchor3,"31 01 FA 0A 00 00 00 05","7F 31 33");
  PostCondition_Anchor( );
  }

testcase TCS_PK_FCA_AnchorUDS_RoutineControl_NRC33_RIDFA0B_CarrierWaveMode_SFID0x01_Extended_NoSecurityand0x65Security_46970()
{
  PreCondition_Anchor("testcase TCS_PK_FCA_AnchorUDSServer_RoutineControl_NRC33_RIDFA0B_CarrierWaveMode_SFID0x01_ExtendedSession_NoSecurityLeveland0x65SecurityLevel_46970");
  testCaseComment("Actions");
  TestStep("1","Send request 10 03 to enter Extended Diagnostic Session");
	SendDiag_Request_Verify_Response(DiagAnchor3,"10 03","50 03 00 32 01 F4");
  TestStep("2","Send request 31 01 FA 0B 05 00 01 to request routine control services");
        SendDiag_Request_Verify_Negative_Response(DiagAnchor3,"31 01 FA 0B 05 00 01","7F 31 33");
  TestStep("3,4","Send security unlock request 65 and 66");   
       	Security_Seed_Key_Access(Anch3,Physical,Incar_1);
  TestStep("5","Send request 31 01 FA 0B 05 00 01 to request routine control services");
        SendDiag_Request_Verify_Negative_Response(DiagAnchor3,"31 01 FA 0B 05 00 01","7F 31 33");
  PostCondition_Anchor( );
  }

testcase TCS_PK_FCA_AnchorUDS_RoutineControl_NRC33_RIDFA10_uwbCyclic_SFID0x01_Extended_NoSecurity0x65Security_46983()
{
  PreCondition_Anchor("testcase TCS_PK_FCA_AnchorUDSServer_RoutineControl_NRC33_RIDFA10_uwbCyclic_SFID0x01_ExtendedSession_NoSecurityLevelAnd0x65SecurityLevel_46983");
  testCaseComment("Actions");
  TestStep("1","Send request 10 03 to enter Extended Diagnostic Session");
	SendDiag_Request_Verify_Response(DiagAnchor3,"10 03","50 03 00 32 01 F4");
  TestStep("2","Send request 31 01 FA 10 01 01 01 00 01 01 01 to request routine control services");
        SendDiag_Request_Verify_Negative_Response(DiagAnchor3,"31 01 FA 10 01 01 01 00 01 01 01","7F 31 33");
  TestStep("3,4","Send security unlock request 65 and 66");   
       	Security_Seed_Key_Access(Anch3,Physical,Incar_1);
  TestStep("5","Send request 31 01 FA 10 01 01 01 00 01 01 01 to request routine control services");
        SendDiag_Request_Verify_Negative_Response(DiagAnchor3,"31 01 FA 10 01 01 01 00 01 01 01","7F 31 33");
  PostCondition_Anchor( );
  }

testcase TCS_PK_FCA_AnchorUDS_RoutineControl_NRC33_RIDFA11_Node2NodeRangingCCC_Extended_NoSecurity0x65Security_46989()
{
  PreCondition_Anchor("testcase TCS_PK_FCA_AnchorUDSServer_RoutineControl_NRC33_RIDFA11_Node2NodeRangingCCC_ExtendedSession_NoSecurityLevelAnd0x65SecurityLevel_46989");
  testCaseComment("Actions");
  TestStep("1","Send request 10 03 to enter Extended Diagnostic Session");
	SendDiag_Request_Verify_Response(DiagAnchor3,"10 03","50 03 00 32 01 F4");
  TestStep("2","Send request 31 01 FA 11 00 00 00 00 05 09 01 03 to request routine control services");
        SendDiag_Request_Verify_Negative_Response(DiagAnchor3,"31 01 FA 11 00 00 00 00 05 09 01 03","7F 31 33");
  TestStep("3,4","Send security unlock request 65 and 66");   
       	Security_Seed_Key_Access(Anch3,Physical,Incar_1);
  TestStep("5","Send request 31 01 FA 11 00 00 00 00 05 09 01 03 to request routine control services");
        SendDiag_Request_Verify_Negative_Response(DiagAnchor3,"31 01 FA 11 00 00 00 00 05 09 01 03","7F 31 33");
  PostCondition_Anchor( );
  }

testcase TCS_PK_FCA_AnchorUDS_RoutineControl_NRC33_RIDFA13_UWBTxTest_SFID0x01_Extended_NoSecurity0x65Security_47003()
{
  PreCondition_Anchor("testcase TCS_PK_FCA_AnchorUDSServer_RoutineControl_NRC33_RIDFA13_UWBTxTest_SFID0x01_ExtendedSession_NoSecurityLevelAnd0x65SecurityLevel_47003");
  testCaseComment("Actions");
  TestStep("1","Send request 10 03 to enter Extended Diagnostic Session");
	SendDiag_Request_Verify_Response(DiagAnchor3,"10 03","50 03 00 32 01 F4");
  TestStep("2","Send request 31 01 FA 13 00 00 00 09 03 79 01 to request routine control services");
        SendDiag_Request_Verify_Negative_Response(DiagAnchor3,"31 01 FA 13 00 00 00 09 03 79 01","7F 31 33");
  TestStep("3,4","Send security unlock request 65 and 66");   
       	Security_Seed_Key_Access(Anch3,Physical,Incar_1);
  TestStep("5","Send request 31 01 FA 13 00 00 00 09 03 79 01 to request routine control services");
        SendDiag_Request_Verify_Negative_Response(DiagAnchor3,"31 01 FA 13 00 00 00 09 03 79 01","7F 31 33");
  PostCondition_Anchor( );
  }
  
testcase TCS_PK_FCA_AnchorUDS_RoutineControl_NRC33_RIDFA21_StoreSHEKey_Extended_NoSecurity0x65Security_17690()
{
  PreCondition_Anchor("testcase TCS_PK_FCA_AnchorUDSServer_RoutineControl_NRC33_RIDFA21_StoreSHEKey_ExtendedSession_NoSecurityLevelAnd0x65SecurityLevel_17690");
  testCaseComment("Actions");
  TestStep("1","Send request 10 03 to enter Extended Diagnostic Session");
	SendDiag_Request_Verify_Response(DiagAnchor3,"10 03","50 03 00 32 01 F4");
  TestStep("2","Send request 31 01 FA 21 XX XX XX XX to request routine control services");
        SendDiag_Request_Verify_Negative_Response(DiagAnchor3,"31 01 FA 21 XX XX XX XX","7F 31 33");
  TestStep("3,4","Send security unlock request 65 and 66 XX");   
       	Security_Seed_Key_Access(Anch3,Physical,Incar_1);
  TestStep("5","Send request 31 01 FA 21 XX XX XX XX to request routine control services");
        SendDiag_Request_Verify_Negative_Response(DiagAnchor3,"31 01 FA 21 XX XX XX XX","7F 31 33");
  PostCondition_Anchor( );
  }

testcase TCS_PK_FCA_AnchorUDS_RoutineControl_NRC33_RIDFA22_ActivateSecureBoot_Extended_NoSecurity0x65Security_38471()
{
  PreCondition_Anchor("testcase TCS_PK_FCA_AnchorUDSServer_RoutineControl_NRC33_RIDFA22_ActivateSecureBoot_ExtendedSession_NoSecurityLevelAnd0x65SecurityLevel_38471");
  testCaseComment("Actions");
  TestStep("1","Send request 10 03 to enter Extended Diagnostic Session");
	SendDiag_Request_Verify_Response(DiagAnchor3,"10 03","50 03 00 32 01 F4");
  TestStep("2","Send request 31 01 FA 22 to request routine control services");
        SendDiag_Request_Verify_Negative_Response(DiagAnchor3,"31 01 FA 22","7F 31 33");
  TestStep("3,4","Send security unlock request 65 and 66 XX");   
       	Security_Seed_Key_Access(Anch3,Physical,Incar_1);
  TestStep("5","Send request 31 01 FA 22 to request routine control services");
        SendDiag_Request_Verify_Negative_Response(DiagAnchor3,"31 01 FA 22","7F 31 33");
  PostCondition_Anchor( );
  }

testcase TCS_PK_FCA_AnchorUDS_RoutineControl_NRC33_RIDFA23_GetSHEEraseChallenge_Extended_NoSecurity0x65Security_48530()
{
  PreCondition_Anchor("testcase TCS_PK_FCA_AnchorUDSServer_RoutineControl_NRC33_RIDFA23_GetSHEEraseChallenge_ExtendedSession_NoSecurityLevelAnd0x65SecurityLevel_48530");
  testCaseComment("Actions");
  TestStep("1","Send request 10 03 to enter Extended Diagnostic Session");
	SendDiag_Request_Verify_Response(DiagAnchor3,"10 03","50 03 00 32 01 F4");
  TestStep("2","Send request 31 01 FA 23 to request routine control services");
        SendDiag_Request_Verify_Negative_Response(DiagAnchor3,"31 01 FA 23","7F 31 33");
  TestStep("3,4","Send security unlock request 65 and 66 XX");   
       	Security_Seed_Key_Access(Anch3,Physical,Incar_1);
  TestStep("5","Send request 31 01 FA 23 to request routine control services");
        SendDiag_Request_Verify_Negative_Response(DiagAnchor3,"31 01 FA 23","7F 31 33");
  PostCondition_Anchor( );
  }

testcase TCS_PK_FCA_AnchorUDS_RoutineControl_NRC33_RIDFA24_EraseSHEKeys_Extended_NoSecurity0x65Security_43958()
{
  PreCondition_Anchor("testcase TCS_PK_FCA_AnchorUDSServer_RoutineControl_NRC33_RIDFA24_EraseSHEKeys_ExtendedSession_NoSecurityLevelAnd0x65SecurityLevel_43958");
  testCaseComment("Actions");
  TestStep("1","Send request 10 03 to enter Extended Diagnostic Session");
	SendDiag_Request_Verify_Response(DiagAnchor3,"10 03","50 03 00 32 01 F4");
  TestStep("2","Send request 31 01 FA 24 00 00 00 00 00 00 00 00 00 00 00 00 00 00 00 00 to request routine control services");
        SendDiag_Request_Verify_Negative_Response(DiagAnchor3,"31 01 FA 24 00 00 00 00 00 00 00 00 00 00 00 00 00 00 00 00","7F 31 33");
  TestStep("3,4","Send security unlock request 65 and 66 XX");   
       	Security_Seed_Key_Access(Anch3,Physical,Incar_1);
  TestStep("5","Send request 31 01 FA 24 00 00 00 00 00 00 00 00 00 00 00 00 00 00 00 00 to request routine control services");
        SendDiag_Request_Verify_Negative_Response(DiagAnchor3,"31 01 FA 24 00 00 00 00 00 00 00 00 00 00 00 00 00 00 00 00","7F 31 33");
  PostCondition_Anchor( );
  }

testcase TCS_PK_FCA_AnchorUDS_RoutineControl_NRC33_RIDFB32_SFID0x01_Extended_NoSecurity_47014()
{
  PreCondition_Anchor("testcase TCS_PK_FCA_AnchorUDSServer_RoutineControl_NRC33_RIDFB32_GenerateSecureCANInitialisationKeyPair_SFID0x01_ExtendedSession_NoSecurityLevell_47014");
  testCaseComment("Actions");
  TestStep("1","Send request 10 03 to enter Extended Diagnostic Session");
	SendDiag_Request_Verify_Response(DiagAnchor3,"10 03","50 03 00 32 01 F4");
  TestStep("2","Send request 31 01 FB 32 to request routine control services");
        SendDiag_Request_Verify_Negative_Response(DiagAnchor3,"31 01 FB 32","7F 31 33");
  PostCondition_Anchor( );
  }

testcase TCS_PK_FCA_AnchorUDS_RoutineControl_NRC33_RIDFB33_SFID0x01_Extended_NoSecurity0x65Security_47020()
{
  PreCondition_Anchor("testcase TCS_PK_FCA_AnchorUDSServer_RoutineControl_NRC33_RIDFB33_SetECULifeCycleToInfield_SFID0x01_ExtendedSession_NoSecurityLevelAnd0x65SecurityLevel_47020");
  testCaseComment("Actions");
  TestStep("1","Send request 10 03 to enter Extended Diagnostic Session");
	SendDiag_Request_Verify_Response(DiagAnchor3,"10 03","50 03 00 32 01 F4");
  TestStep("2","Send request 31 01 FB 33 00 00 00 00 00 00 00 00 00 00 00 00 00 00 00 00 00 00 00 00 00 00 00 00 00 00 00 00 00 00 00 00 to request routine control services");
        SendDiag_Request_Verify_Negative_Response(DiagAnchor3,"31 01 FB 33 00 00 00 00 00 00 00 00 00 00 00 00 00 00 00 00 00 00 00 00 00 00 00 00 00 00 00 00 00 00 00 00","7F 31 33");
  TestStep("3,4","Send security unlock request 65 and 66");   
       	Security_Seed_Key_Access(Anch3,Physical,Incar_1);
  TestStep("5","Send request 31 01 FB 33 00 00 00 00 00 00 00 00 00 00 00 00 00 00 00 00 00 00 00 00 00 00 00 00 00 00 00 00 00 00 00 00 to request routine control services");
        SendDiag_Request_Verify_Negative_Response(DiagAnchor3,"31 01 FB 33 00 00 00 00 00 00 00 00 00 00 00 00 00 00 00 00 00 00 00 00 00 00 00 00 00 00 00 00 00 00 00 00","7F 31 33");
  PostCondition_Anchor( );
  }

testcase TCS_PK_FCA_AnchorUDS_RoutineControl_NRC33_RIDFB35_SFID0x01_Extended_NoSecurity0x65Security_46996()
{
  PreCondition_Anchor("testcase TCS_PK_FCA_AnchorUDSServer_RoutineControl_NRC33_RIDFB35_WriteR4CEKCust_SFID0x01_ExtendedSession_NoSecurityLevelAnd0x65SecurityLevel_46996");
  testCaseComment("Actions");
  TestStep("1","Send request 10 03 to enter Extended Diagnostic Session");
	SendDiag_Request_Verify_Response(DiagAnchor3,"10 03","50 03 00 32 01 F4");
  TestStep("2","Send request 31 01 FB 35 00 11 22 33 44 55 66 77 88 99 AA BB CC DD EE FF to request routine control services");
        SendDiag_Request_Verify_Negative_Response(DiagAnchor3,"31 01 FB 35 00 11 22 33 44 55 66 77 88 99 AA BB CC DD EE FF","7F 31 33");
  TestStep("3,4","Send security unlock request 65 and 66 XX");   
       	Security_Seed_Key_Access(Anch3,Physical,Incar_1);
  TestStep("5","Send request 31 01 FB 35 00 11 22 33 44 55 66 77 88 99 AA BB CC DD EE FF to request routine control services");
        SendDiag_Request_Verify_Negative_Response(DiagAnchor3,"31 01 FB 35 00 11 22 33 44 55 66 77 88 99 AA BB CC DD EE FF","7F 31 33");
  PostCondition_Anchor( );
  }

testcase TCS_PK_FCA_AnchorUDS_RoutineControl_NRC33_RIDFB36_SFID0x01_Extended_NoSecurity0x65Security_47039()
{
  PreCondition_Anchor("testcase TCS_PK_FCA_AnchorUDSServer_RoutineControl_NRC33_RIDFB36_SetECULifecycleToAnalysis_SFID0x01_ExtendedSession_NoSecurityLevelAnd0x65SecurityLevel_47039");
  testCaseComment("Actions");
  TestStep("1","Send request 10 03 to enter Extended Diagnostic Session");
	SendDiag_Request_Verify_Response(DiagAnchor3,"10 03","50 03 00 32 01 F4");
  TestStep("2","Send request 31 01 FB 36 00 00 00 00 00 00 00 00 00 00 00 00 00 00 00 00 00 00 00 00 00 00 00 00 00 00 00 00 00 00 00 00 to request routine control services");
        SendDiag_Request_Verify_Negative_Response(DiagAnchor3,"31 01 FB 36 00 00 00 00 00 00 00 00 00 00 00 00 00 00 00 00 00 00 00 00 00 00 00 00 00 00 00 00 00 00 00 00","7F 31 33");
  TestStep("3,4","Send security unlock request 65 and 66");   
       	Security_Seed_Key_Access(Anch3,Physical,Incar_1);
  TestStep("5","Send request 31 01 FB 36 00 00 00 00 00 00 00 00 00 00 00 00 00 00 00 00 00 00 00 00 00 00 00 00 00 00 00 00 00 00 00 00 to request routine control services");
        SendDiag_Request_Verify_Negative_Response(DiagAnchor3,"31 01 FB 36 00 00 00 00 00 00 00 00 00 00 00 00 00 00 00 00 00 00 00 00 00 00 00 00 00 00 00 00 00 00 00 00","7F 31 33");
  PostCondition_Anchor( );
  }

testcase TCS_PK_FCA_AnchorUDS_RoutineControl_NRC33_RIDFB38_ExtendedSession_NoSecurity0x65Security_47045()
{
  PreCondition_Anchor("testcase TCS_PK_FCA_AnchorUDSServer_RoutineControl_NRC33_RIDFB38_WriteUwbReflashPubKey_ExtendedSession_NoSecurityLevelAnd0x65SecurityLevel_47045");
  testCaseComment("Actions");
  TestStep("1","Send request 10 03 to enter Extended Diagnostic Session");
	SendDiag_Request_Verify_Response(DiagAnchor3,"10 03","50 03 00 32 01 F4");
  TestStep("2","Send request 31 01 FB 38 00 00 00 00 00 00 00 00 00 00 00 00 00 00 00 00 00 00 00 00 00 00 00 00 00 00 00 00 00 00 00 00 00 00 00 00 00 00 00 00 00 00 00 00 00 00 00 00 00 00 00 00 00 00 00 00 00 00 00 00 00 00 00 00 00 to request routine control services");
        SendDiag_Request_Verify_Negative_Response(DiagAnchor3,"31 01 FB 38 00 00 00 00 00 00 00 00 00 00 00 00 00 00 00 00 00 00 00 00 00 00 00 00 00 00 00 00 00 00 00 00 00 00 00 00 00 00 00 00 00 00 00 00 00 00 00 00 00 00 00 00 00 00 00 00 00 00 00 00 00 00 00 00 00","7F 31 33");
  TestStep("3,4","Send security unlock request 65 and 66");   
       	Security_Seed_Key_Access(Anch3,Physical,Incar_1);
  TestStep("5","Send request 31 01 FB 38 00 00 00 00 00 00 00 00 00 00 00 00 00 00 00 00 00 00 00 00 00 00 00 00 00 00 00 00 00 00 00 00 00 00 00 00 00 00 00 00 00 00 00 00 00 00 00 00 00 00 00 00 00 00 00 00 00 00 00 00 00 00 00 00 00 to request routine control services");
        SendDiag_Request_Verify_Negative_Response(DiagAnchor3,"31 01 FB 38 00 00 00 00 00 00 00 00 00 00 00 00 00 00 00 00 00 00 00 00 00 00 00 00 00 00 00 00 00 00 00 00 00 00 00 00 00 00 00 00 00 00 00 00 00 00 00 00 00 00 00 00 00 00 00 00 00 00 00 00 00 00 00 00 00","7F 31 33");
  PostCondition_Anchor( );
  }

testcase TCS_PK_FCA_AnchorUDS_RoutineControl_NRC33_RIDFB40_SFID0x01_Extended_NoSecurity0x61Security_47051()
{
  PreCondition_Anchor("testcase TCS_PK_FCA_AnchorUDSServer_RoutineControl_NRC33_RIDFB40_MasterAnchorPairing1_SFID0x01_ExtendedSession_NoSecurityLevelAnd0x61SecurityLevel_47051");
  testCaseComment("Actions");
  TestStep("1","Send request 10 03 to enter Extended Diagnostic Session");
	SendDiag_Request_Verify_Response(DiagAnchor3,"10 03","50 03 00 32 01 F4");
  TestStep("2","Send request 31 00 FB 41 00 00 00 00 00 00 00 00 00 00 00 00 00 00 00 00 00 00 00 00 00 00 00 00 00 00 00 00 00 00 00 00 00 00 00 00 00 00 00 00 00 00 00 00 00 00 00 00 to request routine control services");
        SendDiag_Request_Verify_Negative_Response(DiagAnchor3,"31 00 FB 41 00 00 00 00 00 00 00 00 00 00 00 00 00 00 00 00 00 00 00 00 00 00 00 00 00 00 00 00 00 00 00 00 00 00 00 00 00 00 00 00 00 00 00 00 00 00 00 00","7F 31 33");
  TestStep("3,4","Send security unlock request 61 and 62");   
       	Security_Seed_Key_Access(Anch3,Physical,Bosch);
  TestStep("5","Send request 31 00 FB 41 00 00 00 00 00 00 00 00 00 00 00 00 00 00 00 00 00 00 00 00 00 00 00 00 00 00 00 00 00 00 00 00 00 00 00 00 00 00 00 00 00 00 00 00 00 00 00 00 to request routine control services");
        SendDiag_Request_Verify_Negative_Response(DiagAnchor3,"31 00 FB 41 00 00 00 00 00 00 00 00 00 00 00 00 00 00 00 00 00 00 00 00 00 00 00 00 00 00 00 00 00 00 00 00 00 00 00 00 00 00 00 00 00 00 00 00 00 00 00 00","7F 31 33");
  PostCondition_Anchor( );
  }

testcase TCS_PK_FCA_AnchorUDS_RoutineControl_NRC33_RIDFB41_SFID0x01_Extended_NoSecurity0x61Security_47064()
{
  PreCondition_Anchor("testcase TCS_PK_FCA_AnchorUDSServer_RoutineControl_NRC33_RIDFB41_MasterAnchorPairing2_SFID0x01_ExtendedSession_NoSecurityLevelAnd0x61SecurityLevel_47064");
  testCaseComment("Actions");
  TestStep("1","Send request 10 03 to enter Extended Diagnostic Session");
	SendDiag_Request_Verify_Response(DiagAnchor3,"10 03","50 03 00 32 01 F4");
  TestStep("2","Send request 31 00 FB 40 00 00 00 00 00 00 00 00 00 00 00 00 00 00 00 00 00 00 00 00 00 00 00 00 00 00 00 00 00 00 00 00 00 00 00 00 00 00 00 00 00 00 00 00 00 00 00 00 00 00 00 00 00 00 00 00 00 00 00 00 00 00 00 00 00 to request routine control services");
        SendDiag_Request_Verify_Negative_Response(DiagAnchor3,"31 00 FB 40 00 00 00 00 00 00 00 00 00 00 00 00 00 00 00 00 00 00 00 00 00 00 00 00 00 00 00 00 00 00 00 00 00 00 00 00 00 00 00 00 00 00 00 00 00 00 00 00 00 00 00 00 00 00 00 00 00 00 00 00 00 00 00 00 00","7F 31 33");
  TestStep("3,4","Send security unlock request 61 and 62");   
       	Security_Seed_Key_Access(Anch3,Physical,Bosch);
  TestStep("5","Send request 31 00 FB 40 00 00 00 00 00 00 00 00 00 00 00 00 00 00 00 00 00 00 00 00 00 00 00 00 00 00 00 00 00 00 00 00 00 00 00 00 00 00 00 00 00 00 00 00 00 00 00 00 00 00 00 00 00 00 00 00 00 00 00 00 00 00 00 00 00 to request routine control services");
        SendDiag_Request_Verify_Negative_Response(DiagAnchor3,"31 00 FB 40 00 00 00 00 00 00 00 00 00 00 00 00 00 00 00 00 00 00 00 00 00 00 00 00 00 00 00 00 00 00 00 00 00 00 00 00 00 00 00 00 00 00 00 00 00 00 00 00 00 00 00 00 00 00 00 00 00 00 00 00 00 00 00 00 00","7F 31 33");
  PostCondition_Anchor( );
  }


testcase TCS_PK_FCA_AnchorUDS_RoutineControl_NRC33_RIDFC03_SFID0x01_Programming_NoSecurity_47069()
{
  PreCondition_Anchor("TCS_PK_FCA_AnchorUDSServer_RoutineControl_NRC33_RIDFC03_CompareSWSignatures_SFID0x01_ProgrammingSession_NoSecurityLevel_47069");
  testCaseComment("Actions");
  TestStep("1","Send request 10 03 to enter Extended Diagnostic Session");
	SendDiag_Request_Verify_Response(DiagAnchor3,"10 03","50 03 00 32 01 F4");
  TestStep("2,3","Send security unlock request 61 and 62");   
       	Security_Seed_Key_Access(Anch3,Physical,Bosch);
  TestStep("4","Send request 10 02 to enter Programming Diagnostic Session");
	SendDiag_Request_Verify_Response(DiagAnchor3,"10 02","50 02 00 32 01 F4");
  TestStep("5","Send request 10 02 to enter Programming Diagnostic Session");
	SendDiag_Request_Verify_Response(DiagAnchor3,"10 02","50 02 00 32 01 F4");
  TestStep("6","Send request 31 01 FC 03 00 00 00 00 00 00 00 00 00 00 00 00 00 00 00 00 00 00 00 00 00 00 00 00 00 00 00 00 00 00 00 00 00 00 00 00 00 00 00 00 00 00 00 00 00 00 00 00 00 00 00 00 00 00 00 00 00 00 00 00 00 00 00 00 00 00 00 00 to request routine control services");
        SendDiag_Request_Verify_Negative_Response(DiagAnchor3,"31 01 FC 03 00 00 00 00 00 00 00 00 00 00 00 00 00 00 00 00 00 00 00 00 00 00 00 00 00 00 00 00 00 00 00 00 00 00 00 00 00 00 00 00 00 00 00 00 00 00 00 00 00 00 00 00 00 00 00 00 00 00 00 00 00 00 00 00 00 00 00 00","7F 31 33");
  PostCondition_Anchor( );
  }


testcase TCS_PK_FCA_AnchorUDS_RoutineControl_NRC33_RIDFC04_SFID0x01_Programming_NoSecurity_47058()
{
  PreCondition_Anchor("TCS_PK_FCA_AnchorUDSServer_RoutineControl_NRC33_RIDFC04_VerifySignature_SFID0x01_ProgrammingSession_NoSecurityLevel_47058");
  testCaseComment("Actions");
  TestStep("1","Send request 10 03 to enter Extended Diagnostic Session");
	SendDiag_Request_Verify_Response(DiagAnchor3,"10 03","50 03 00 32 01 F4");
  TestStep("2,3","Send security unlock request 61 and 62");   
       	Security_Seed_Key_Access(Anch3,Physical,Bosch);
  TestStep("4","Send request 10 02 to enter Programming Diagnostic Session");
	SendDiag_Request_Verify_Response(DiagAnchor3,"10 02","50 02 00 32 01 F4");
  TestStep("5","Send request 10 02 to enter Programming Diagnostic Session");
	SendDiag_Request_Verify_Response(DiagAnchor3,"10 02","50 02 00 32 01 F4");
  TestStep("6","Send request 31 01 FC 04 00 00 00 00 to request routine control services");
        SendDiag_Request_Verify_Negative_Response(DiagAnchor3,"31 01 FC 04 00 00 00 00","7F 31 33");
  PostCondition_Anchor( );
  }


//////////////////////////////////////////////RoutineControl_NRC31////////////////////////////////////

testcase TCS_PK_FCA_AnchorUDSServer_RoutineControl_NRC31_UnsupportedRIDInActiveSession_RIDFA01_ProgrammingSession_0x61SecurityLevel_46662()
///////TestCase needs to be executed only on Combi-Anchor
{
  PreCondition_Anchor("TCS_PK_FCA_AnchorUDSServer_RoutineControl_NRC31_UnsupportedRIDInActiveSession_RIDFA01_ProgrammingSession_0x61SecurityLevel_46662");
  testCaseComment("Actions");
 TestStep("1","Send request 10 03 to enter Extended Diagnostic Session");
	SendDiag_Request_Verify_Response(DiagAnchor3,"10 03","50 03 00 32 01 F4");
     TestStep("2,3","Send Security Seed Request 61 and Key 62 in DiagAnchor");     
       	Security_Seed_Key_Access(Anch3,Physical,Bosch);
  TestStep("4","Send request 10 02 to enter Programming Diagnostic Session");
	SendDiag_Request_Verify_Response(DiagAnchor3,"10 02","50 02 00 32 01 F4");
  TestStep("5","Send request 31 01 FA 01 80 EA CA 80 00 01 01 2C 00 01 to request routine control services");
        SendDiag_Request_Verify_Negative_Response(DiagAnchor3,"31 01 FA 01 80 EA CA 80 00 01 01 2C 00 01","7F 31 31");
  PostCondition_Anchor( );
  }
  
testcase TCS_PK_FCA_AnchorUDSServer_RoutineControl_NRC31_UnsupportedRIDInActiveSession_RIDFA02_ProgrammingSession_0x61SecurityLevel_46650()
///////TestCase needs to be executed only on Combi-Anchor
{
  PreCondition_Anchor("TCS_PK_FCA_AnchorUDSServer_RoutineControl_NRC31_UnsupportedRIDInActiveSession_RIDFA02_ProgrammingSession_0x61SecurityLevel_46650");
  testCaseComment("Actions");
TestStep("1","Send request 10 03 to enter Extended Diagnostic Session");
	SendDiag_Request_Verify_Response(DiagAnchor3,"10 03","50 03 00 32 01 F4");
    TestStep("2,3","Send Security Seed Request 61 and Key 62 in DiagAnchor");   
       	Security_Seed_Key_Access(Anch3,Physical,Bosch);
  TestStep("4","Send request 10 02 to enter Programming Diagnostic Session");
	SendDiag_Request_Verify_Response(DiagAnchor3,"10 02","50 02 00 32 01 F4");
  TestStep("5","Send request 31 01 FA 02 01 00 64 00 01 to request routine control services");
        SendDiag_Request_Verify_Negative_Response(DiagAnchor3,"31 01 FA 02 01 00 64 00 01","7F 31 31");
  PostCondition_Anchor( );
  }
 
testcase TCS_PK_FCA_AnchorUDSServer_RoutineControl_NRC31_UnsupportedRIDInActiveSession_RIDFA03_ProgrammingSession_0x61SecurityLevel_46687()
{
  PreCondition_Anchor("TCS_PK_FCA_AnchorUDSServer_RoutineControl_NRC31_UnsupportedRIDInActiveSession_RIDFA03_ProgrammingSession_0x61SecurityLevel_46687");
  testCaseComment("Actions");
TestStep("1","Send request 10 03 to enter Extended Diagnostic Session");
	SendDiag_Request_Verify_Response(DiagAnchor3,"10 03","50 03 00 32 01 F4");
     TestStep("2,3","Send Security Seed Request 61 and Key 62 in DiagAnchor"); 
       	Security_Seed_Key_Access(Anch3,Physical,Bosch);
  TestStep("4","Send request 10 02 to enter Programming Diagnostic Session");
	SendDiag_Request_Verify_Response(DiagAnchor3,"10 02","50 02 00 32 01 F4");
  TestStep("5","Send request 31 01 FA 03 00 10 10 to request routine control services");
        SendDiag_Request_Verify_Negative_Response(DiagAnchor3,"31 01 FA 03 00 10 10","7F 31 31");
  PostCondition_Anchor( );
  }

testcase TCS_PK_FCA_AnchorUDSServer_RoutineControl_NRC31_UnsupportedRIDInActiveSession_RIDFA04_ProgrammingSession_0x61SecurityLevel_46694()
///////TestCase needs to be executed only on Combi-Anchor
{
  PreCondition_Anchor("TCS_PK_FCA_AnchorUDSServer_RoutineControl_NRC31_UnsupportedRIDInActiveSession_RIDFA04_ProgrammingSession_0x61SecurityLevel_46694");
  testCaseComment("Actions");
TestStep("1","Send request 10 03 to enter Extended Diagnostic Session");
	SendDiag_Request_Verify_Response(DiagAnchor3,"10 03","50 03 00 32 01 F4");
      TestStep("2,3","Send Security Seed Request 61 and Key 62 in DiagAnchor"); 
       	Security_Seed_Key_Access(Anch3,Physical,Bosch);
  TestStep("4","Send request 10 02 to enter Programming Diagnostic Session");
	SendDiag_Request_Verify_Response(DiagAnchor3,"10 02","50 02 00 32 01 F4");
  TestStep("5","Send request 31 01 FA 04 01 0B B8 00 02 to request routine control services");
        SendDiag_Request_Verify_Negative_Response(DiagAnchor3,"31 01 FA 04 01 0B B8 00 02","7F 31 31");
  PostCondition_Anchor( );
  }
  
testcase TCS_PK_FCA_AnchorUDSServer_RoutineControl_NRC31_UnsupportedRIDInActiveSession_RIDFA05_ProgrammingSession_0x61SecurityLevel_46713()
{
  PreCondition_Anchor("TCS_PK_FCA_AnchorUDSServer_RoutineControl_NRC31_UnsupportedRIDInActiveSession_RIDFA05_ProgrammingSession_0x61SecurityLevel_46713");
  testCaseComment("Actions");
     TestStep("1","Send request 10 03 to enter Extended Diagnostic Session");
	SendDiag_Request_Verify_Response(DiagAnchor3,"10 03","50 03 00 32 01 F4");
    TestStep("2,3","Send Security Seed Request 61 and Key 62 in DiagAnchor");
       	Security_Seed_Key_Access(Anch3,Physical,Bosch);
  TestStep("4","Send request 10 02 to enter Programming Diagnostic Session");
	SendDiag_Request_Verify_Response(DiagAnchor3,"10 02","50 02 00 32 01 F4");
  TestStep("5","Send request 31 01 FA 05 00 to request routine control services");
        SendDiag_Request_Verify_Negative_Response(DiagAnchor3,"31 01 FA 05 00","7F 31 31");
  PostCondition_Anchor( );
  }
  
testcase TCS_PK_FCA_AnchorUDSServer_RoutineControl_NRC31_UnsupportedRIDInActiveSession_RIDFA08_ProgrammingSession_0x61SecurityLevel_46738()
{
  PreCondition_Anchor("TCS_PK_FCA_AnchorUDSServer_RoutineControl_NRC31_UnsupportedRIDInActiveSession_RIDFA08_ProgrammingSession_0x61SecurityLevel_46738");
  testCaseComment("Actions");
      TestStep("1","Send request 10 03 to enter Extended Diagnostic Session");
	SendDiag_Request_Verify_Response(DiagAnchor3,"10 03","50 03 00 32 01 F4");
     TestStep("2,3","Send Security Seed Request 61 and Key 62 in DiagAnchor");
       	Security_Seed_Key_Access(Anch3,Physical,Bosch);
  TestStep("4","Send request 10 02 to enter Programming Diagnostic Session");
	SendDiag_Request_Verify_Response(DiagAnchor3,"10 02","50 02 00 32 01 F4");
  TestStep("5","Send request 31 01 FA 08 05 11 22 33 44 00 64 0C 12 12 to request routine control services");
        SendDiag_Request_Verify_Negative_Response(DiagAnchor3,"31 01 FA 08 05 11 22 33 44 00 64 0C 12 12","7F 31 31");
  PostCondition_Anchor( );
  }

testcase TCS_PK_FCA_AnchorUDSServer_RoutineControl_NRC31_UnsupportedRIDInActiveSession_RIDFA09_ProgrammingSession_0x61SecurityLevel_46744()
{
  PreCondition_Anchor("TCS_PK_FCA_AnchorUDSServer_RoutineControl_NRC31_UnsupportedRIDInActiveSession_RIDFA09_ProgrammingSession_0x61SecurityLevel_46744");
  testCaseComment("Actions");
     TestStep("1","Send request 10 03 to enter Extended Diagnostic Session");
	SendDiag_Request_Verify_Response(DiagAnchor3,"10 03","50 03 00 32 01 F4");
   TestStep("2,3","Send Security Seed Request 61 and Key 62 in DiagAnchor");   
       	Security_Seed_Key_Access(Anch3,Physical,Bosch);
  TestStep("4","Send request 10 02 to enter Programming Diagnostic Session");
	SendDiag_Request_Verify_Response(DiagAnchor3,"10 02","50 02 00 32 01 F4");
  TestStep("5","Send request 31 01 FA 09 0B B8 05 00 64 0C 73 73 to request routine control services");
        SendDiag_Request_Verify_Negative_Response(DiagAnchor3,"31 01 FA 09 0B B8 05 00 64 0C 73 73","7F 31 31");
  PostCondition_Anchor( );
  }

testcase TCS_PK_FCA_AnchorUDSServer_RoutineControl_NRC31_UnsupportedRIDInActiveSession_RIDFA0A_ProgrammingSession_0x61SecurityLevel_46706()
{
  PreCondition_Anchor("TCS_PK_FCA_AnchorUDSServer_RoutineControl_NRC31_UnsupportedRIDInActiveSession_RIDFA0A_ProgrammingSession_0x61SecurityLevel_46706");
  testCaseComment("Actions");
   TestStep("1","Send request 10 03 to enter Extended Diagnostic Session");
	SendDiag_Request_Verify_Response(DiagAnchor3,"10 03","50 03 00 32 01 F4");
     TestStep("2,3","Send Security Seed Request 61 and Key 62 in DiagAnchor");   
       	Security_Seed_Key_Access(Anch3,Physical,Bosch);
  TestStep("4","Send request 10 02 to enter Programming Diagnostic Session");
	SendDiag_Request_Verify_Response(DiagAnchor3,"10 02","50 02 00 32 01 F4");
  TestStep("5","Send request 31 01 FA 0A 00 00 00 05 to request routine control services");
        SendDiag_Request_Verify_Negative_Response(DiagAnchor3,"31 01 FA 0A 00 00 00 05","7F 31 31");
  PostCondition_Anchor( );
  }

testcase TCS_PK_FCA_AnchorUDSServer_RoutineControl_NRC31_UnsupportedRIDInActiveSession_RIDFA0B_ProgrammingSession_0x61SecurityLevel_46762()
{
  PreCondition_Anchor("TCS_PK_FCA_AnchorUDSServer_RoutineControl_NRC31_UnsupportedRIDInActiveSession_RIDFA0B_ProgrammingSession_0x61SecurityLevel_46762");
  testCaseComment("Actions");
   TestStep("1","Send request 10 03 to enter Extended Diagnostic Session");
	SendDiag_Request_Verify_Response(DiagAnchor3,"10 03","50 03 00 32 01 F4");
   TestStep("2,3","Send Security Seed Request 61 and Key 62 in DiagAnchor");    
       	Security_Seed_Key_Access(Anch3,Physical,Bosch);
  TestStep("4","Send request 10 02 to enter Programming Diagnostic Session");
	SendDiag_Request_Verify_Response(DiagAnchor3,"10 02","50 02 00 32 01 F4");
  TestStep("5","Send request 31 01 FA 0B 05 00 01 to request routine control services");
        SendDiag_Request_Verify_Negative_Response(DiagAnchor3,"31 01 FA 0B 05 00 01","7F 31 31");
  PostCondition_Anchor( );
  }
  
testcase TCS_PK_FCA_AnchorUDSServer_RoutineControl_NRC31_UnsupportedRIDInActiveSession_RIDFA10_ProgrammingSession_0x61SecurityLevel_46768()
{
  PreCondition_Anchor("TCS_PK_FCA_AnchorUDSServer_RoutineControl_NRC31_UnsupportedRIDInActiveSession_RIDFA10_ProgrammingSession_0x61SecurityLevel_46768");
  testCaseComment("Actions");
   TestStep("1","Send request 10 03 to enter Extended Diagnostic Session");
	SendDiag_Request_Verify_Response(DiagAnchor3,"10 03","50 03 00 32 01 F4");
    TestStep("2,3","Send Security Seed Request 61 and Key 62 in DiagAnchor");   
       	Security_Seed_Key_Access(Anch3,Physical,Bosch);
  TestStep("4","Send request 10 02 to enter Programming Diagnostic Session");
	SendDiag_Request_Verify_Response(DiagAnchor3,"10 02","50 02 00 32 01 F4");
  TestStep("5","Send request 31 01 FA 10 05 00 FF 00 00 01 06 to request routine control services");
        SendDiag_Request_Verify_Negative_Response(DiagAnchor3,"31 01 FA 10 05 00 FF 00 00 01 06","7F 31 31");
  PostCondition_Anchor( );
  }

testcase TCS_PK_FCA_AnchorUDSServer_RoutineControl_NRC31_UnsupportedRIDInActiveSession_RIDFA11_ProgrammingSession_0x61SecurityLevel_46750()
{
  PreCondition_Anchor("TCS_PK_FCA_AnchorUDSServer_RoutineControl_NRC31_UnsupportedRIDInActiveSession_RIDFA11_ProgrammingSession_0x61SecurityLevel_46750");
  testCaseComment("Actions");
   TestStep("1","Send request 10 03 to enter Extended Diagnostic Session");
	SendDiag_Request_Verify_Response(DiagAnchor3,"10 03","50 03 00 32 01 F4");
  TestStep("2,3","Send Security Seed Request 61 and Key 62 in DiagAnchor");     
       	Security_Seed_Key_Access(Anch3,Physical,Bosch);
  TestStep("4","Send request 10 02 to enter Programming Diagnostic Session");
	SendDiag_Request_Verify_Response(DiagAnchor3,"10 02","50 02 00 32 01 F4");
  TestStep("5","Send request 31 01 FA 11 00 00 00 00 00 00 00 00 to request routine control services");
        SendDiag_Request_Verify_Negative_Response(DiagAnchor3,"31 01 FA 11 00 00 00 00 00 00 00 00","7F 31 31");
  PostCondition_Anchor( );
  }
  
testcase TCS_PK_FCA_AnchorUDSServer_RoutineControl_NRC31_UnsupportedRIDInActiveSession_RIDFA13_ProgrammingSession_0x61SecurityLevel_46788()
{
  PreCondition_Anchor("TCS_PK_FCA_AnchorUDSServer_RoutineControl_NRC31_UnsupportedRIDInActiveSession_RIDFA13_ProgrammingSession_0x61SecurityLevel_46788");
  testCaseComment("Actions");
   TestStep("1","Send request 10 03 to enter Extended Diagnostic Session");
	SendDiag_Request_Verify_Response(DiagAnchor3,"10 03","50 03 00 32 01 F4");
     TestStep("2,3","Send Security Seed Request 61 and Key 62 in DiagAnchor"); 
       	Security_Seed_Key_Access(Anch3,Physical,Bosch);
  TestStep("4","Send request 10 02 to enter Programming Diagnostic Session");
	SendDiag_Request_Verify_Response(DiagAnchor3,"10 02","50 02 00 32 01 F4");
  TestStep("5","Send request 31 01 FA 13 00 00 00 09 03 79 01 to request routine control services");
        SendDiag_Request_Verify_Negative_Response(DiagAnchor3,"31 01 FA 13 00 00 00 09 03 79 01","7F 31 31");
  PostCondition_Anchor( );
  }
  
testcase TCS_PK_FCA_AnchorUDSServer_RoutineControl_NRC31_UnsupportedRIDInActiveSession_RIDFA21_ProgrammingSession_0x61SecurityLevel_23446()
{
  PreCondition_Anchor("TCS_PK_FCA_AnchorUDSServer_RoutineControl_NRC31_UnsupportedRIDInActiveSession_RIDFA21_ProgrammingSession_0x61SecurityLevel_23446");
  testCaseComment("Actions");
     TestStep("1","Send request 10 03 to enter Extended Diagnostic Session");
	SendDiag_Request_Verify_Response(DiagAnchor3,"10 03","50 03 00 32 01 F4");
   TestStep("2,3","Send Security Seed Request 61 and Key 62 in DiagAnchor");   
       	Security_Seed_Key_Access(Anch3,Physical,Bosch);
  TestStep("4","Send request 10 02 to enter Programming Diagnostic Session");
	SendDiag_Request_Verify_Response(DiagAnchor3,"10 02","50 02 00 32 01 F4");
  TestStep("5","Send request 31 01 FA 21 01 00 00 00 00 00 00 00 00 00 00 00 00 00 00 00 00 00 00 00 00 00 00 00 00 00 00 00 00 00 00 00 00 00 00 00 00 00 00 00 00 00 00 00 00 00 00 00 00 00 00 00 00 00 00 00 00 00 00 00 00 00 00 00 00 to request routine control services");
        SendDiag_Request_Verify_Negative_Response(DiagAnchor3,"31 01 FA 21 01 00 00 00 00 00 00 00 00 00 00 00 00 00 00 00 00 00 00 00 00 00 00 00 00 00 00 00 00 00 00 00 00 00 00 00 00 00 00 00 00 00 00 00 00 00 00 00 00 00 00 00 00 00 00 00 00 00 00 00 00 00 00 00 00","7F 31 31");
  PostCondition_Anchor( );
  }
  
testcase TCS_PK_FCA_AnchorUDSServer_RoutineControl_NRC31_UnsupportedRIDInActiveSession_RIDFA22_ProgrammingSession_0x61SecurityLevel_40568()
{
  PreCondition_Anchor("TCS_PK_FCA_AnchorUDSServer_RoutineControl_NRC31_RIDFA22_0x61SecurityLevel_40568");
  testCaseComment("Actions");
  TestStep("1","Send request 10 03 to enter Extended Diagnostic Session");
	SendDiag_Request_Verify_Response(DiagAnchor3,"10 03","50 03 00 32 01 F4");
   TestStep("2,3","Send Security Seed Request 61 and Key 62 in DiagAnchor");   
       	Security_Seed_Key_Access(Anch3,Physical,Bosch);
  TestStep("4","Send request 10 02 to enter Programming Diagnostic Session");
	SendDiag_Request_Verify_Response(DiagAnchor3,"10 02","50 02 00 32 01 F4");
  TestStep("5","Send request 31 01 FA 22 to request routine control services");
        SendDiag_Request_Verify_Negative_Response(DiagAnchor3,"31 01 FA 22","7F 31 31");
  PostCondition_Anchor( );
  }

testcase TCS_PK_FCA_AnchorUDSServer_RoutineControl_NRC31_UnsupportedRIDInActiveSession_RIDFA23_ProgrammingSession_0x61SecurityLevel_43518()
{
  PreCondition_Anchor("TCS_PK_FCA_AnchorUDSServer_RoutineControl_NRC31_RIDFA23_0x61SecurityLevel_43518");
  testCaseComment("Actions");
  TestStep("1","Send request 10 03 to enter Extended Diagnostic Session");
	SendDiag_Request_Verify_Response(DiagAnchor3,"10 03","50 03 00 32 01 F4");
     TestStep("2,3","Send Security Seed Request 61 and Key 62 in DiagAnchor");   
       	Security_Seed_Key_Access(Anch3,Physical,Bosch);
  TestStep("4","Send request 10 02 to enter Programming Diagnostic Session");
	SendDiag_Request_Verify_Response(DiagAnchor3,"10 02","50 02 00 32 01 F4");
  TestStep("5","Send request 31 01 FA 23 to request routine control services");
        SendDiag_Request_Verify_Negative_Response(DiagAnchor3,"31 01 FA 23","7F 31 31");
  PostCondition_Anchor( );
  }

testcase TCS_PK_FCA_AnchorUDSServer_RoutineControl_NRC31_UnsupportedRIDInActiveSession_RIDFA24_ProgrammingSession_0x61SecurityLevel_46165()
{
  PreCondition_Anchor("TCS_PK_FCA_AnchorUDSServer_RoutineControl_NRC31_RIDFA24_0x61SecurityLevel_46165");
  testCaseComment("Actions");
  TestStep("1","Send request 10 03 to enter Extended Diagnostic Session");
	SendDiag_Request_Verify_Response(DiagAnchor3,"10 03","50 03 00 32 01 F4");
       TestStep("2,3","Send Security Seed Request 61 and Key 62 in DiagAnchor");   
       	Security_Seed_Key_Access(Anch3,Physical,Bosch);
 TestStep("4","Send request 10 02 to enter Programming Diagnostic Session");
	SendDiag_Request_Verify_Response(DiagAnchor3,"10 02","50 02 00 32 01 F4");
  TestStep("5","Send request 31 01 FA 24 00 00 00 00 00 00 00 00 00 00 00 00 00 00 00 00 to request routine control services");
        SendDiag_Request_Verify_Negative_Response(DiagAnchor3,"31 01 FA 24 00 00 00 00 00 00 00 00 00 00 00 00 00 00 00 00","7F 31 31");
  PostCondition_Anchor( );
  }
  
testcase TCS_PK_FCA_AnchorUDSServer_RoutineControl_NRC31_UnsupportedRIDInActiveSession_RIDFB32_ProgrammingSession_0x61SecurityLevel_46806()
{
  PreCondition_Anchor("TCS_PK_FCA_AnchorUDSServer_RoutineControl_NRC31_UnsupportedRIDInActiveSession_RIDFB32_ProgrammingSession_0x61SecurityLevel_46806");
  testCaseComment("Actions");
    TestStep("1","Send request 10 03 to enter Extended Diagnostic Session");
	SendDiag_Request_Verify_Response(DiagAnchor3,"10 03","50 03 00 32 01 F4"); 
  TestStep("2,3","Send Security Seed Request 61 and Key 62 in DiagAnchor");    
       	Security_Seed_Key_Access(Anch3,Physical,Bosch);
  TestStep("4","Send request 10 02 to enter Programming Diagnostic Session");
	SendDiag_Request_Verify_Response(DiagAnchor3,"10 02","50 02 00 32 01 F4");
  TestStep("5","Send request 31 01 FB 32 to request routine control services");
        SendDiag_Request_Verify_Negative_Response(DiagAnchor3,"31 01 FB 32","7F 31 31");
  PostCondition_Anchor( );
  }

testcase TCS_PK_FCA_AnchorUDSServer_RoutineControl_NRC31_UnsupportedRIDInActiveSession_RIDFB33_ProgrammingSession_0x61SecurityLevel_46775()
{
  PreCondition_Anchor("TCS_PK_FCA_AnchorUDSServer_RoutineControl_NRC31_UnsupportedRIDInActiveSession_RIDFB33_ProgrammingSession_0x61SecurityLevel_46775");
  testCaseComment("Actions");
   TestStep("1","Send request 10 03 to enter Extended Diagnostic Session");
	SendDiag_Request_Verify_Response(DiagAnchor3,"10 03","50 03 00 32 01 F4");
      TestStep("2,3","Send Security Seed Request 61 and Key 62 in DiagAnchor");   
       	Security_Seed_Key_Access(Anch3,Physical,Bosch);
  TestStep("4","Send request 10 02 to enter Programming Diagnostic Session");
	SendDiag_Request_Verify_Response(DiagAnchor3,"10 02","50 02 00 32 01 F4");
  TestStep("5","Send request 31 01 FB 33 00 00 00 00 00 00 00 00 00 00 00 00 00 00 00 00 00 00 00 00 00 00 00 00 00 00 00 00 00 00 00 00 to request routine control services");
        SendDiag_Request_Verify_Negative_Response(DiagAnchor3,"31 01 FB 33 00 00 00 00 00 00 00 00 00 00 00 00 00 00 00 00 00 00 00 00 00 00 00 00 00 00 00 00 00 00 00 00","7F 31 31");
  PostCondition_Anchor( );
  }
  
testcase TCS_PK_FCA_AnchorUDSServer_RoutineControl_NRC31_UnsupportedRIDInActiveSession_RIDFB35_ProgrammingSession_0x61SecurityLevel_46823()
{
  PreCondition_Anchor("TCS_PK_FCA_AnchorUDSServer_RoutineControl_NRC31_UnsupportedRIDInActiveSession_RIDFB35_ProgrammingSession_0x61SecurityLevel_46823");
  testCaseComment("Actions");
     TestStep("1","Send request 10 03 to enter Extended Diagnostic Session");
	SendDiag_Request_Verify_Response(DiagAnchor3,"10 03","50 03 00 32 01 F4");
      TestStep("2,3","Send Security Seed Request 61 and Key 62 in DiagAnchor");   
       	Security_Seed_Key_Access(Anch3,Physical,Bosch);
  TestStep("4","Send request 10 02 to enter Programming Diagnostic Session");
	SendDiag_Request_Verify_Response(DiagAnchor3,"10 02","50 02 00 32 01 F4");
  TestStep("5","Send request 31 01 FB 35 00 11 22 33 44 55 66 77 88 99 AA BB CC DD EE FF to request routine control services");
        SendDiag_Request_Verify_Negative_Response(DiagAnchor3,"31 01 FB 35 00 11 22 33 44 55 66 77 88 99 AA BB CC DD EE FF","7F 31 31");
  PostCondition_Anchor( );
  }

testcase TCS_PK_FCA_AnchorUDSServer_RoutineControl_NRC31_UnsupportedRIDInActiveSession_RIDFB36_ProgrammingSession_0x61SecurityLevel_46829()
{
  PreCondition_Anchor("TCS_PK_FCA_AnchorUDSServer_RoutineControl_NRC31_UnsupportedRIDInActiveSession_RIDFB36_ProgrammingSession_0x61SecurityLevel_46829");
  testCaseComment("Actions");
  TestStep("1","Send request 10 03 to enter Extended Diagnostic Session");
	SendDiag_Request_Verify_Response(DiagAnchor3,"10 03","50 03 00 32 01 F4");
      TestStep("2,3","Send Security Seed Request 61 and Key 62 in DiagAnchor");    
       	Security_Seed_Key_Access(Anch3,Physical,Bosch);
  TestStep("4","Send request 10 02 to enter Programming Diagnostic Session");
	SendDiag_Request_Verify_Response(DiagAnchor3,"10 02","50 02 00 32 01 F4");
  TestStep("5","Send request 31 01 FB 36 00 00 00 00 00 00 00 00 00 00 00 00 00 00 00 00 00 00 00 00 00 00 00 00 00 00 00 00 00 00 00 00 to request routine control services");
        SendDiag_Request_Verify_Negative_Response(DiagAnchor3,"31 01 FB 36 00 00 00 00 00 00 00 00 00 00 00 00 00 00 00 00 00 00 00 00 00 00 00 00 00 00 00 00 00 00 00 00","7F 31 31");
  PostCondition_Anchor( );
  }

testcase TCS_PK_FCA_AnchorUDSServer_RoutineControl_NRC31_UnsupportedRIDInActiveSession_RIDFB38_ProgrammingSession_0x61SecurityLevel_46836()
{
  PreCondition_Anchor("TCS_PK_FCA_AnchorUDSServer_RoutineControl_NRC31_UnsupportedRIDInActiveSession_RIDFB38_ProgrammingSession_0x61SecurityLevel_46836");
  testCaseComment("Actions");
     TestStep("1","Send request 10 03 to enter Extended Diagnostic Session");
	SendDiag_Request_Verify_Response(DiagAnchor3,"10 03","50 03 00 32 01 F4");
      TestStep("2,3","Send Security Seed Request 61 and Key 62 in DiagAnchor");  
       	Security_Seed_Key_Access(Anch3,Physical,Bosch);
  TestStep("4","Send request 10 02 to enter Programming Diagnostic Session");
	SendDiag_Request_Verify_Response(DiagAnchor3,"10 02","50 02 00 32 01 F4");
  TestStep("5","Send request 31 01 FB 38 00 00 00 00 00 00 00 00 00 00 00 00 00 00 00 00 00 00 00 00 00 00 00 00 00 00 00 00 00 00 00 00 00 00 00 00 00 00 00 00 00 00 00 00 00 00 00 00 00 00 00 00 00 00 00 00 00 00 00 00 00 00 00 00 00  to request routine control services");
        SendDiag_Request_Verify_Negative_Response(DiagAnchor3,"31 01 FB 38 00 00 00 00 00 00 00 00 00 00 00 00 00 00 00 00 00 00 00 00 00 00 00 00 00 00 00 00 00 00 00 00 00 00 00 00 00 00 00 00 00 00 00 00 00 00 00 00 00 00 00 00 00 00 00 00 00 00 00 00 00 00 00 00 00 ","7F 31 31");
  PostCondition_Anchor( );
  }

testcase TCS_PK_FCA_AnchorUDSServer_RoutineControl_NRC31_UnsupportedRIDInActiveSession_RIDFB40_ProgrammingSession_0x61SecurityLevel_46848()
{
  PreCondition_Anchor("TCS_PK_FCA_AnchorUDSServer_RoutineControl_NRC31_UnsupportedRIDInActiveSession_RIDFB40_ProgrammingSession_0x61SecurityLevel_46848");
  testCaseComment("Actions");
    TestStep("1","Send request 10 03 to enter Extended Diagnostic Session");
	SendDiag_Request_Verify_Response(DiagAnchor3,"10 03","50 03 00 32 01 F4");
      TestStep("2,3","Send Security Seed Request 61 and Key 62 in DiagAnchor");  
       	Security_Seed_Key_Access(Anch3,Physical,Bosch);
  TestStep("4","Send request 10 02 to enter Programming Diagnostic Session");
	SendDiag_Request_Verify_Response(DiagAnchor3,"10 02","50 02 00 32 01 F4");
  TestStep("5","Send request 31 01 FB 40 00 00 00 00 00 00 00 00 00 00 00 00 00 00 00 00 00 00 00 00 00 00 00 00 00 00 00 00 00 00 00 00 00 00 00 00 00 00 00 00 00 00 00 00 00 00 00 00 00 00 00 00 00 00 00 00 00 00 00 00 00 00 00 00 to request routine control services");
        SendDiag_Request_Verify_Negative_Response(DiagAnchor3,"31 01 FB 40 00 00 00 00 00 00 00 00 00 00 00 00 00 00 00 00 00 00 00 00 00 00 00 00 00 00 00 00 00 00 00 00 00 00 00 00 00 00 00 00 00 00 00 00 00 00 00 00 00 00 00 00 00 00 00 00 00 00 00 00 00 00 00 00","7F 31 31");
  PostCondition_Anchor( );
  }
  
testcase TCS_PK_FCA_AnchorUDSServer_RoutineControl_NRC31_UnsupportedRIDInActiveSession_RIDFB41_ProgrammingSession_0x61SecurityLevel_46854()
{
  PreCondition_Anchor("TCS_PK_FCA_AnchorUDSServer_RoutineControl_NRC31_UnsupportedRIDInActiveSession_RIDFB41_ProgrammingSession_0x61SecurityLevel_46854");
  testCaseComment("Actions");
  TestStep("1","Send request 10 03 to enter Extended Diagnostic Session");
	SendDiag_Request_Verify_Response(DiagAnchor3,"10 03","50 03 00 32 01 F4");
      TestStep("2,3","Send Security Seed Request 61 and Key 62 in DiagAnchor");     
       	Security_Seed_Key_Access(Anch3,Physical,Bosch);
  TestStep("4","Send request 10 02 to enter Programming Diagnostic Session");
	SendDiag_Request_Verify_Response(DiagAnchor3,"10 02","50 02 00 32 01 F4");
  TestStep("5","Send request 31 01 FB 41 00 00 00 00 00 00 00 00 00 00 00 00 00 00 00 00 00 00 00 00 00 00 00 00 00 00 00 00 00 00 00 00 00 00 00 00 00 00 00 00 00 00 00 00 00 00 00 00 to request routine control services");
        SendDiag_Request_Verify_Negative_Response(DiagAnchor3,"31 01 FB 41 00 00 00 00 00 00 00 00 00 00 00 00 00 00 00 00 00 00 00 00 00 00 00 00 00 00 00 00 00 00 00 00 00 00 00 00 00 00 00 00 00 00 00 00 00 00 00 00","7F 31 31");
  PostCondition_Anchor( );
  }

testcase TCS_PK_FCA_AnchorUDSServer_RoutineControl_NRC31_UnsupportedRIDInActiveSession_RIDFB42_ProgrammingSession_0x61SecurityLevel_46860()
{
  PreCondition_Anchor("TCS_PK_FCA_AnchorUDSServer_RoutineControl_NRC31_UnsupportedRIDInActiveSession_RIDFB42_ProgrammingSession_0x61SecurityLevel_46860");
  testCaseComment("Actions");
     TestStep("1","Send request 10 03 to enter Extended Diagnostic Session");
	SendDiag_Request_Verify_Response(DiagAnchor3,"10 03","50 03 00 32 01 F4");
      TestStep("2,3","Send Security Seed Request 61 and Key 62 in DiagAnchor");
       	Security_Seed_Key_Access(Anch3,Physical,Bosch);
  TestStep("4","Send request 10 02 to enter Programming Diagnostic Session");
	SendDiag_Request_Verify_Response(DiagAnchor3,"10 02","50 02 00 32 01 F4");
  TestStep("5","Send request 31 01 FB 42  FF FF to request routine control services");
        SendDiag_Request_Verify_Negative_Response(DiagAnchor3,"31 01 FB 42 FF FF","7F 31 31");
  PostCondition_Anchor( );
  }

testcase TCS_PK_FCA_AnchorUDSServer_RoutineControl_NRC31_UnsupportedRIDInActiveSession_RIDFB43_ProgrammingSession_0x61SecurityLevel_46842()
{
  PreCondition_Anchor("TCS_PK_FCA_AnchorUDSServer_RoutineControl_NRC31_UnsupportedRIDInActiveSession_RIDFB43_ProgrammingSession_0x61SecurityLevel_46842");
  testCaseComment("Actions");
     TestStep("1","Send request 10 03 to enter Extended Diagnostic Session");
	SendDiag_Request_Verify_Response(DiagAnchor3,"10 03","50 03 00 32 01 F4");
      TestStep("2,3","Send Security Seed Request 61 and Key 62 in DiagAnchor");
       	Security_Seed_Key_Access(Anch3,Physical,Bosch);
  TestStep("4","Send request 10 02 to enter Programming Diagnostic Session");
	SendDiag_Request_Verify_Response(DiagAnchor3,"10 02","50 02 00 32 01 F4");
  TestStep("5","Send request 31 01 FB 43 00 00 00 00 00 00 00 00 00 00 00 00 00 00 00 00 00 00 00 00 00 00 00 00 00 00 00 00 00 00 00 00 01 to request routine control services");
        SendDiag_Request_Verify_Negative_Response(DiagAnchor3,"31 01 FB 43 00 00 00 00 00 00 00 00 00 00 00 00 00 00 00 00 00 00 00 00 00 00 00 00 00 00 00 00 00 00 00 00 01","7F 31 31");
  PostCondition_Anchor( );
  }

testcase TCS_PK_FCA_AnchorUDSServer_RoutineControl_NRC31_UnsupportedRIDInActiveSession_RIDFC03_ExtendedSession_NoSecurityLevel_46875()
{
  PreCondition_Anchor("TCS_PK_FCA_AnchorUDSServer_RoutineControl_NRC31_UnsupportedRIDInActiveSession_RIDFC03_ExtendedSession_NoSecurityLevel_46875");
  testCaseComment("Actions");
  TestStep("1","Send request 10 03 to enter Extended Diagnostic Session");
	SendDiag_Request_Verify_Response(DiagAnchor3,"10 03","50 03 00 32 01 F4");
  TestStep("2","Send request 31 01 FC 03 (4XX) (64XX) to request routine control services");
        SendDiag_Request_Verify_Negative_Response(DiagAnchor3,"31 01 FC 03 (4XX) (64XX)","7F 31 31");
  PostCondition_Anchor( );
  }

testcase TCS_PK_FCA_AnchorUDSServer_RoutineControl_NRC31_UnsupportedRIDInActiveSession_RIDFC04_ExtendedSession_NoSecurityLevel_46881()
{
  PreCondition_Anchor("TCS_PK_FCA_AnchorUDSServer_RoutineControl_NRC31_UnsupportedRIDInActiveSession_RIDFC04_ExtendedSession_NoSecurityLevel_46881");
  testCaseComment("Actions");
  TestStep("1","Send request 10 03 to enter Extended Diagnostic Session");
	SendDiag_Request_Verify_Response(DiagAnchor3,"10 03","50 03 00 32 01 F4");
  TestStep("2","Send request 31 01 FC 04 (4XX) to request routine control services");
        SendDiag_Request_Verify_Negative_Response(DiagAnchor3,"31 01 FC 04 (4XX)","7F 31 31");
  PostCondition_Anchor( );
  }


testcase TCS_PK_FCA_AnchorUDSServer_RoutineControl_NRC31_UnsupportedRIDs_ExtendedSession_NoSecurityLevel_46868()
{
  PreCondition_Anchor("TCS_PK_FCA_AnchorUDSServer_RoutineControl_NRC31_UnsupportedRIDs_ExtendedSession_NoSecurityLevel_46868");
  testCaseComment("Actions");
  TestStep("1","Send request 10 03 to enter Extended Diagnostic Session");
	SendDiag_Request_Verify_Response(DiagAnchor3,"10 03","50 03 00 32 01 F4");
  TestStep("2","Send request 31 01 F0 00 to request routine control services");
        SendDiag_Request_Verify_Negative_Response(DiagAnchor3,"31 01 F0 00","7F 31 31");
  TestStep("3","Send request 31 01 FB BB to request routine control services");
        SendDiag_Request_Verify_Negative_Response(DiagAnchor3,"31 01 FB BB","7F 31 31");
  TestStep("4","Send request 31 01 FE FF to request routine control services");
        SendDiag_Request_Verify_Negative_Response(DiagAnchor3,"31 01 FE FF","7F 31 31");
  PostCondition_Anchor( );
  }

testcase TCS_PK_FCA_AnchorUDSServer_RoutineControl_NRC31_UnsupportedRIDs_ProgrammingSession_NoSecurityLevel_46893()
{
  PreCondition_Anchor("TCS_PK_FCA_AnchorUDSServer_RoutineControl_NRC31_UnsupportedRIDs_ProgrammingSession_NoSecurityLevel_46893");
  testCaseComment("Actions");
    TestStep("1","Send request 10 03 to enter Extended Diagnostic Session");
	SendDiag_Request_Verify_Response(DiagAnchor3,"10 03","50 03 00 32 01 F4");
    TestStep("2,3","Send Security Seed Request 61 and Key 62 in DiagAnchor");   
       	Security_Seed_Key_Access(Anch3,Physical,Bosch);
  TestStep("4","Send request 10 02 to enter Programming Diagnostic Session");
	SendDiag_Request_Verify_Response(DiagAnchor3,"10 02","50 02 00 32 01 F4");
  TestStep("5","Send request 31 01 F0 00 to request routine control services");
        SendDiag_Request_Verify_Negative_Response(DiagAnchor3,"31 01 F0 00","7F 31 31");
  TestStep("6","Send request 31 01 FB BB to request routine control services");
        SendDiag_Request_Verify_Negative_Response(DiagAnchor3,"31 01 FB BB","7F 31 31");
  TestStep("7","Send request 31 01 FE FF to request routine control services");
        SendDiag_Request_Verify_Negative_Response(DiagAnchor3,"31 01 FE FF","7F 31 31");
  PostCondition_Anchor( );
  }





////////////////////////////RoutineControl_NRC24//////////////////////////////

testcase TCS_PK_FCA_AnchorUDSServer_RoutineControl_NRC24_RIDFA01_BLERxSensitivityTest_ExtendedSession_0x61SecurityLevel_46556()
///////TestCase needs to be executed only on Combi-Anchor
{
     PreCondition_Anchor("testcase TCS_PK_FCA_AnchorUDSServer_RoutineControl_NRC24_RIDFA01_BLERxSensitivityTest_ExtendedSession_0x61SecurityLevel_46556");
     testCaseComment("Actions");
     TestStep("1","Send request 10 03 to enter Extended Diagnostic Session");
	 SendDiag_Request_Verify_Response(DiagAnchor3,"10 03","50 03 00 32 01 F4");
     TestStep("2,3","Send Security Seed Request 61 and Key 62 in DiagAnchor");   
     Security_Seed_Key_Access(Anch3,Physical,Bosch);
     TestStep("4","Send request 2E FE A4 01 to write RFTestMode");
     SendDiag_Request_Verify_Response(DiagAnchor3,"2E FE A4 01","6E FE A4");
     TestStep("5","Send request 31 02 FA 01 to request routine control services");
     SendDiag_Request_Verify_Negative_Response(DiagAnchor3,"31 02 FA 01","7F 31 24");
     TestStep("6","Send request 31 03 FA 01 to request routine control services");
     SendDiag_Request_Verify_Negative_Response(DiagAnchor3,"31 03 FA 01","7F 31 24");
     PostCondition_Anchor( );
}


testcase TCS_PK_FCA_AnchorUDSServer_RoutineControl_NRC24_RIDFA02_BLETxPowerTest_ExtendedSession_0x61SecurityLevel_46563()
///////TestCase needs to be executed only on Combi-Anchor
{
  PreCondition_Anchor("TCS_PK_FCA_AnchorUDSServer_RoutineControl_NRC24_RIDFA02_BLETxPowerTest_ExtendedSession_0x61SecurityLevel_46563");
  testCaseComment("Actions");
  TestStep("1","Send request 10 03 to enter Extended Diagnostic Session");
	SendDiag_Request_Verify_Response(DiagAnchor3,"10 03","50 03 00 32 01 F4");
  TestStep("2,3","Send Security Seed Request 61 and Key 62 in DiagAnchor");   
       	Security_Seed_Key_Access(Anch3,Physical,Bosch);
  TestStep("4","Send request 2E FE A4 01 to write RFTestMode");
        SendDiag_Request_Verify_Response(DiagAnchor3,"2E FE A4 01","6E FE A4");
  TestStep("5","Send request 31 02 FA 02 to request routine control services");
        SendDiag_Request_Verify_Negative_Response(DiagAnchor3,"31 02 FA 02","7F 31 24");
  PostCondition_Anchor( );
}

testcase TCS_PK_FCA_AnchorUDSServer_RoutineControl_NRC24_RIDFA03_AnchorImcRoundTripTest_ExtendedSession_0x61SecurityLevel_46569()
{
  PreCondition_Anchor("TCS_PK_FCA_AnchorUDSServer_RoutineControl_NRC24_RIDFA03_AnchorImcRoundTripTest_ExtendedSession_0x61SecurityLevel_46569");
  testCaseComment("Actions");
  TestStep("1","Send request 10 03 to enter Extended Diagnostic Session");
	SendDiag_Request_Verify_Response(DiagAnchor3,"10 03","50 03 00 32 01 F4");
 TestStep("2,3","Send Security Seed Request 61 and Key 62 in DiagAnchor");   
       	Security_Seed_Key_Access(Anch3,Physical,Bosch);
  TestStep("4","Send request 31 03 FA 03 to request routine control services");
        SendDiag_Request_Verify_Negative_Response(DiagAnchor3,"31 03 FA 03","7F 31 24");
  PostCondition_Anchor( );
}

testcase TCS_PK_FCA_AnchorUDSServer_RoutineControl_NRC24_RIDFA04_BLERSSMeasurement_ExtendedSession_0x61SecurityLevel_46581()
///////TestCase needs to be executed only on Combi-Anchor
{
  PreCondition_Anchor("TCS_PK_FCA_AnchorUDSServer_RoutineControl_NRC24_RIDFA04_BLERSSMeasurement_ExtendedSession_0x61SecurityLevel_46581");
  testCaseComment("Actions");
  TestStep("1","Send request 10 03 to enter Extended Diagnostic Session");
	SendDiag_Request_Verify_Response(DiagAnchor3,"10 03","50 03 00 32 01 F4");
    TestStep("2,3","Send Security Seed Request 61 and Key 62 in DiagAnchor"); 
       	Security_Seed_Key_Access(Anch3,Physical,Bosch);
  TestStep("4","Send request 2E FE A4 01 to write RFTestMode");
        SendDiag_Request_Verify_Response(DiagAnchor3,"2E FE A4 01","6E FE A4");
  TestStep("5","Send request 31 02 FA 04 to request routine control services");
        SendDiag_Request_Verify_Negative_Response(DiagAnchor3,"31 02 FA 04","7F 31 24");
  PostCondition_Anchor( );
}

testcase TCS_PK_FCA_AnchorUDSServer_RoutineControl_NRC24_RIDFA08_uwbFramesTx_ExtendedSession_0x61SecurityLevel_46588()
{
  PreCondition_Anchor("TCS_PK_FCA_AnchorUDSServer_RoutineControl_NRC24_RIDFA08_uwbFramesTx_ExtendedSession_0x61SecurityLevel_46588");
  testCaseComment("Actions");
  TestStep("1","Send request 10 03 to enter Extended Diagnostic Session");
	SendDiag_Request_Verify_Response(DiagAnchor3,"10 03","50 03 00 32 01 F4");
  TestStep("2,3","Send Security Seed Request 61 and Key 62 in DiagAnchor");   
       	Security_Seed_Key_Access(Anch3,Physical,Bosch);
  TestStep("4","Send request 2E FE A4 01 to write RFTestMode");
        SendDiag_Request_Verify_Response(DiagAnchor3,"2E FE A4 01","6E FE A4");
  TestStep("5","Send request 31 02 FA 08 to request routine control services");
        SendDiag_Request_Verify_Negative_Response(DiagAnchor3,"31 02 FA 08","7F 31 24");
  TestStep("6","Send request 31 03 FA 08 to request routine control services");
        SendDiag_Request_Verify_Negative_Response(DiagAnchor3,"31 03 FA 08","7F 31 24");
  PostCondition_Anchor( );
}


testcase TCS_PK_FCA_AnchorUDSServer_RoutineControl_NRC24_RIDFA09_uwbFramesRx_ExtendedSession_0x61SecurityLevel_46606()
{
  PreCondition_Anchor("TCS_PK_FCA_AnchorUDSServer_RoutineControl_NRC24_RIDFA09_uwbFramesRx_ExtendedSession_0x61SecurityLevel_46606");
  testCaseComment("Actions");
  TestStep("1","Send request 10 03 to enter Extended Diagnostic Session");
	SendDiag_Request_Verify_Response(DiagAnchor3,"10 03","50 03 00 32 01 F4");
  TestStep("2,3","Send Security Seed Request 61 and Key 62 in DiagAnchor");   
       	Security_Seed_Key_Access(Anch3,Physical,Bosch);
  TestStep("4","Send request 2E FE A4 01 to write RFTestMode");
        SendDiag_Request_Verify_Response(DiagAnchor3,"2E FE A4 01","6E FE A4");
  TestStep("5","Send request 31 02 FA 09 to request routine control services");
        SendDiag_Request_Verify_Negative_Response(DiagAnchor3,"31 02 FA 09","7F 31 24");
  TestStep("6","Send request 31 03 FA 09 to request routine control services");
        SendDiag_Request_Verify_Negative_Response(DiagAnchor3,"31 03 FA 09","7F 31 24");
  PostCondition_Anchor( );
}

testcase TCS_PK_FCA_AnchorUDSServer_RoutineControl_NRC24_RIDFA10_uwbCyclic_ExtendedSession_0x61SecurityLevel_46619()
{
  PreCondition_Anchor("TCS_PK_FCA_AnchorUDSServer_RoutineControl_NRC24_RIDFA10_uwbCyclic_ExtendedSession_0x61SecurityLevel_46619");
  testCaseComment("Actions");
  TestStep("1","Send request 10 03 to enter Extended Diagnostic Session");
	SendDiag_Request_Verify_Response(DiagAnchor3,"10 03","50 03 00 32 01 F4");
  TestStep("2,3","Send Security Seed Request 61 and Key 62 in DiagAnchor");   
       	Security_Seed_Key_Access(Anch3,Physical,Bosch);
  TestStep("4","Send request 2E FE A4 01 to write RFTestMode");
        SendDiag_Request_Verify_Response(DiagAnchor3,"2E FE A4 01","6E FE A4");
  TestStep("5","Send request 31 02 FA 10 to request routine control services");
        SendDiag_Request_Verify_Negative_Response(DiagAnchor3,"31 02 FA 10","7F 31 24");
  TestStep("6","Send request 31 03 FA 10 to request routine control services");
        SendDiag_Request_Verify_Negative_Response(DiagAnchor3,"31 03 FA 10","7F 31 24");
  PostCondition_Anchor( );
}

testcase TCS_PK_FCA_AnchorUDSServer_RoutineControl_NRC24_RIDFA11_Node2NodeRangingCCC_ExtendedSession_0x61SecurityLevel_46625()
{
  PreCondition_Anchor("TCS_PK_FCA_AnchorUDSServer_RoutineControl_NRC24_RIDFA11_Node2NodeRangingCCC_ExtendedSession_0x61SecurityLevel_46625");
  testCaseComment("Actions");
  TestStep("1","Send request 10 03 to enter Extended Diagnostic Session");
	SendDiag_Request_Verify_Response(DiagAnchor3,"10 03","50 03 00 32 01 F4");
  TestStep("2,3","Send Security Seed Request 61 and Key 62 in DiagAnchor");   
       	Security_Seed_Key_Access(Anch3,Physical,Bosch);
  TestStep("4","Send request 2E FE A4 01 to write RFTestMode");
        SendDiag_Request_Verify_Response(DiagAnchor3,"2E FE A4 01","6E FE A4");
  TestStep("5","Send request 31 02 FA 11 to request routine control services");
        SendDiag_Request_Verify_Negative_Response(DiagAnchor3,"31 02 FA 11","7F 31 24");
  PostCondition_Anchor( );
}


testcase TCS_PK_FCA_AnchorUDSServer_RoutineControl_NRC24_RIDFA12_EnduranceTesting_ExtendedSession_0x61SecurityLevel_46631()
{
  PreCondition_Anchor("TCS_PK_FCA_AnchorUDSServer_RoutineControl_NRC24_RIDFA12_EnduranceTesting_ExtendedSession_0x61SecurityLevel_46631");
  testCaseComment("Actions");
  TestStep("1","Send request 10 03 to enter Extended Diagnostic Session");
	SendDiag_Request_Verify_Response(DiagAnchor3,"10 03","50 03 00 32 01 F4");
  TestStep("2,3","Send Security Seed Request 61 and Key 62 in DiagAnchor");   
       	Security_Seed_Key_Access(Anch3,Physical,Bosch);
  TestStep("4","Send request 2E FE A4 02 to write RFTestMode");
        SendDiag_Request_Verify_Response(DiagAnchor3,"2E FE A4 01","6E FE A4");
  TestStep("5","Send request 31 02 FA 12 to request routine control services");
        SendDiag_Request_Verify_Negative_Response(DiagAnchor3,"31 02 FA 12","7F 31 24");
  PostCondition_Anchor( );
}

testcase TCS_PK_FCA_AnchorUDSServer_RoutineControl_NRC24_RIDFA13_UWBTxTest_ExtendedSession_0x61SecurityLevel_46643()
{
  PreCondition_Anchor("TCS_PK_FCA_AnchorUDSServer_RoutineControl_NRC24_RIDFA13_UWBTxTest_ExtendedSession_0x61SecurityLevel_46643");
  testCaseComment("Actions");
  TestStep("1","Send request 10 03 to enter Extended Diagnostic Session");
	SendDiag_Request_Verify_Response(DiagAnchor3,"10 03","50 03 00 32 01 F4");
     TestStep("2,3","Send Security Seed Request 61 and Key 62 in DiagAnchor"); 
       	Security_Seed_Key_Access(Anch3,Physical,Bosch);
  TestStep("4","Send request 2E FE A4 01 to write RFTestMode");
        SendDiag_Request_Verify_Response(DiagAnchor3,"2E FE A4 01","6E FE A4");
  TestStep("5","Send request 31 02 FA 13 to request routine control services");
        SendDiag_Request_Verify_Negative_Response(DiagAnchor3,"31 02 FA 13","7F 31 24");
  PostCondition_Anchor( );
}



////////////////////////RoutineControl_NRC22///////////////////////////////
testcase TCS_PK_FCA_AnchorUDSServer_RoutineControl_NRC22_RIDFA01_BLERxSensitivityTest_ExtendedSession_0x61SecurityLevel_46420()
///////TestCase needs to be executed only on Combi-Anchor
{
	PreCondition_Anchor("TCS_PK_FCA_AnchorUDSServer_RoutineControl_NRC22_RIDFA01_BLERxSensitivityTest_ExtendedSession_0x61SecurityLevel_46420");
	testCaseComment("Actions");
    TestStep("1","Send request 10 03 to enter Extended Diagnostic Session");
	SendDiag_Request_Verify_Response(DiagAnchor3,"10 03","50 03 00 32 01 F4");
    TestStep("2,3","Send Security Seed Request 61 and Key 62 in DiagAnchor");  
    Security_Seed_Key_Access(Anch3,Physical,Bosch);
    TestStep("4","Send request 31 01 FA 01 80 EA CA 80 00 01 01 2C 00 01 to request RoutineControl Service");
	SendDiag_Request_Verify_Negative_Response(DiagAnchor3,"31 01 FA 01 80 EA CA 80 00 01 01 2C 00 01","7F 31 22");
	PostCondition_Anchor( );
}


testcase TCS_PK_FCA_AnchorUDSServer_RoutineControl_NRC22_RIDFA02_BLETxPowerTest_ExtendedSession_0x61SecurityLevel_46457()
///////TestCase needs to be executed only on Combi-Anchor
{
	PreCondition_Anchor("TCS_PK_FCA_AnchorUDSServer_RoutineControl_NRC22_RIDFA02_BLETxPowerTest_ExtendedSession_0x61SecurityLevel_46457");
	testCaseComment("Actions");
    TestStep("1","Send request 10 03 to enter Extended Diagnostic Session");
	SendDiag_Request_Verify_Response(DiagAnchor3,"10 03","50 03 00 32 01 F4");
    TestStep("2,3","Send Security Seed Request 61 and Key 62 in DiagAnchor");  
    Security_Seed_Key_Access(Anch3,Physical,Bosch);
    TestStep("4","Send request 31 01 FA 02 01 00 64 00 01 to request RoutineControl Service");
	SendDiag_Request_Verify_Negative_Response(DiagAnchor3,"31 01 FA 02 01 00 64 00 01","7F 31 22");
	PostCondition_Anchor( );
}


testcase TCS_PK_FCA_AnchorUDSServer_RoutineControl_NRC22_RIDFA04_BLERSSMeasurement_ExtendedSession_0x61SecurityLevel_46463()
///////TestCase needs to be executed only on Combi-Anchor
{
	PreCondition_Anchor("TCS_PK_FCA_AnchorUDSServer_RoutineControl_NRC22_RIDFA04_BLERSSMeasurement_ExtendedSession_0x61SecurityLevel_46463");
	testCaseComment("Actions");
    TestStep("1","Send request 10 03 to enter Extended Diagnostic Session");
	SendDiag_Request_Verify_Response(DiagAnchor3,"10 03","50 03 00 32 01 F4");
    TestStep("2,3","Send Security Seed Request 61 and Key 62 in DiagAnchor");  
    Security_Seed_Key_Access(Anch3,Physical,Bosch);
    TestStep("4","Send request 31 01 FA 04 01 0B B8 00 02 to request RoutineControl Service");
	SendDiag_Request_Verify_Negative_Response(DiagAnchor3,"31 01 FA 04 01 0B B8 00 02","7F 31 22");
	PostCondition_Anchor( );
}


testcase TCS_PK_FCA_AnchorUDSServer_RoutineControl_NRC22_RIDFA08_uwbFramesTx_ExtendedSession_0x61SecurityLevel_46476()
{
	PreCondition_Anchor("TCS_PK_FCA_AnchorUDSServer_RoutineControl_NRC22_RIDFA08_uwbFramesTx_ExtendedSession_0x61SecurityLevel_46476");
	testCaseComment("Actions");
    TestStep("1","Send request 10 03 to enter Extended Diagnostic Session");
	SendDiag_Request_Verify_Response(DiagAnchor3,"10 03","50 03 00 32 01 F4");
    TestStep("2,3","Send Security Seed Request 61 and Key 62 in DiagAnchor");  
    Security_Seed_Key_Access(Anch3,Physical,Bosch);
    TestStep("4","Send request 31 01 FA 08 05 11 22 33 44 00 64 0C 12 12 to request RoutineControl Service");
	SendDiag_Request_Verify_Negative_Response(DiagAnchor3,"31 01 FA 08 05 11 22 33 44 00 64 0C 12 12","7F 31 22");
	PostCondition_Anchor( );
}


testcase TCS_PK_FCA_AnchorUDSServer_RoutineControl_NRC22_RIDFA09_uwbFramesRx_ExtendedSession_0x61SecurityLevel_46482()
{
	PreCondition_Anchor("TCS_PK_FCA_AnchorUDSServer_RoutineControl_NRC22_RIDFA09_uwbFramesRx_ExtendedSession_0x61SecurityLevel_46482");
	testCaseComment("Actions");
    TestStep("1","Send request 10 03 to enter Extended Diagnostic Session");
	SendDiag_Request_Verify_Response(DiagAnchor3,"10 03","50 03 00 32 01 F4");
    TestStep("2,3","Send Security Seed Request 61 and Key 62 in DiagAnchor");  
    Security_Seed_Key_Access(Anch3,Physical,Bosch);
    TestStep("4","Send request 31 01 FA 09 0B B8 05 00 64 0C 73 73 to request RoutineControl Service");
	SendDiag_Request_Verify_Negative_Response(DiagAnchor3,"31 01 FA 09 0B B8 05 00 64 0C 73 73","7F 31 22");
	PostCondition_Anchor( );
}


testcase TCS_PK_FCA_AnchorUDSServer_RoutineControl_NRC22_RIDFA0A_UWBTxLoopback_ExtendedSession_0x61SecurityLevel_46488()
{
	PreCondition_Anchor("TCS_PK_FCA_AnchorUDSServer_RoutineControl_NRC22_RIDFA0A_UWBTxLoopback_ExtendedSession_0x61SecurityLevel_46488");
	testCaseComment("Actions");
    TestStep("1","Send request 10 03 to enter Extended Diagnostic Session");
	SendDiag_Request_Verify_Response(DiagAnchor3,"10 03","50 03 00 32 01 F4");
    TestStep("2,3","Send Security Seed Request 61 and Key 62 in DiagAnchor");  
    Security_Seed_Key_Access(Anch3,Physical,Bosch);
    TestStep("4","Send request 31 01 FA 0A 00 00 00 05 to request RoutineControl Service");
	SendDiag_Request_Verify_Negative_Response(DiagAnchor3,"31 01 FA 0A 00 00 00 05","7F 31 22");
	PostCondition_Anchor( );
}


testcase TCS_PK_FCA_AnchorUDSServer_RoutineControl_NRC22_RIDFA0B_CarrierWaveMode_ExtendedSession_0x61SecurityLevel_46500()
{
	PreCondition_Anchor("TCS_PK_FCA_AnchorUDSServer_RoutineControl_NRC22_RIDFA0B_CarrierWaveMode_ExtendedSession_0x61SecurityLevel_46500");
	testCaseComment("Actions");
    TestStep("1","Send request 10 03 to enter Extended Diagnostic Session");
	SendDiag_Request_Verify_Response(DiagAnchor3,"10 03","50 03 00 32 01 F4");
    TestStep("2,3","Send Security Seed Request 61 and Key 62 in DiagAnchor");  
    Security_Seed_Key_Access(Anch3,Physical,Bosch);
    TestStep("4","Send request 31 01 FA 0B 05 00 01 to request RoutineControl Service");
	SendDiag_Request_Verify_Negative_Response(DiagAnchor3,"31 01 FA 0B 05 00 01","7F 31 22");
	PostCondition_Anchor( );
}


testcase TCS_PK_FCA_AnchorUDSServer_RoutineControl_NRC22_RIDFA10_uwbCyclic_ExtendedSession_0x61SecurityLevel_46506()
{
	PreCondition_Anchor("TCS_PK_FCA_AnchorUDSServer_RoutineControl_NRC22_RIDFA10_uwbCyclic_ExtendedSession_0x61SecurityLevel_46506");
	testCaseComment("Actions");
    TestStep("1","Send request 10 03 to enter Extended Diagnostic Session");
	SendDiag_Request_Verify_Response(DiagAnchor3,"10 03","50 03 00 32 01 F4");
    TestStep("2,3","Send Security Seed Request 61 and Key 62 in DiagAnchor");  
    Security_Seed_Key_Access(Anch3,Physical,Bosch);
    TestStep("4","Send request 31 01 FA 10 05 00 FF 00 00 01 06 to request RoutineControl Service");
	SendDiag_Request_Verify_Negative_Response(DiagAnchor3,"31 01 FA 10 05 00 FF 00 00 01 06","7F 31 22");
	PostCondition_Anchor( );
}


testcase TCS_PK_FCA_AnchorUDSServer_RoutineControl_NRC22_RIDFA11_Node2NodeRangingCCC_ExtendedSession_0x61SecurityLevel_46519()
{
	PreCondition_Anchor("TCS_PK_FCA_AnchorUDSServer_RoutineControl_NRC22_RIDFA11_Node2NodeRangingCCC_ExtendedSession_0x61SecurityLevel_46519");
	testCaseComment("Actions");
    TestStep("1","Send request 10 03 to enter Extended Diagnostic Session");
	SendDiag_Request_Verify_Response(DiagAnchor3,"10 03","50 03 00 32 01 F4");
    TestStep("2,3","Send Security Seed Request 61 and Key 62 in DiagAnchor");  
    Security_Seed_Key_Access(Anch3,Physical,Bosch);
    TestStep("4","Send request 31 01 FA 11 00 00 00 00 06 05 09 01 06 to request RoutineControl Service");
	SendDiag_Request_Verify_Negative_Response(DiagAnchor3,"31 01 FA 11 00 00 00 00 06 05 09 01 06","7F 31 22");
	PostCondition_Anchor( );
}


testcase TCS_PK_FCA_AnchorUDSServer_RoutineControl_NRC22_RIDFA13_UWBTxTest_ExtendedSession_0x61SecurityLevel_46531()
{
	PreCondition_Anchor("TCS_PK_FCA_AnchorUDSServer_RoutineControl_NRC22_RIDFA13_UWBTxTest_ExtendedSession_0x61SecurityLevel_46531");
	testCaseComment("Actions");
    TestStep("1","Send request 10 03 to enter Extended Diagnostic Session");
	SendDiag_Request_Verify_Response(DiagAnchor3,"10 03","50 03 00 32 01 F4");
    TestStep("2,3","Send Security Seed Request 61 and Key 62 in DiagAnchor");  
    Security_Seed_Key_Access(Anch3,Physical,Bosch);
    TestStep("4","Send request 31 01 FA 13 00 00 00 09 03 79 01 to request RoutineControl Service");
	SendDiag_Request_Verify_Negative_Response(DiagAnchor3,"31 01 FA 13 00 00 00 09 03 79 01","7F 31 22");
	PostCondition_Anchor( );
}


testcase TCS_PK_FCA_AnchorUDSServer_RoutineControl_NRC22_RIDFB40_MasterAnchorPairing1_ExtendedSession_0x61SecurityLevel_46544()
{
	PreCondition_Anchor("TCS_PK_FCA_AnchorUDSServer_RoutineControl_NRC22_RIDFB40_MasterAnchorPairing1_ExtendedSession_0x61SecurityLevel_46544");
	testCaseComment("Actions");
    TestStep("1","Send request 10 03 to enter Extended Diagnostic Session");
	SendDiag_Request_Verify_Response(DiagAnchor3,"10 03","50 03 00 32 01 F4");
    TestStep("2,3","Send Security Seed Request 61 and Key 62 in DiagAnchor");  
    Security_Seed_Key_Access(Anch3,Physical,Bosch);
    TestStep("4","Send request 31 01 FB 40 00 00 00 00 00 00 00 00 00 00 00 00 00 00 00 00 00 00 00 00 00 00 00 00 00 00 00 00 00 00 00 00 00 00 00 00 00 00 00 00 00 00 00 00 00 00 00 00 00 00 00 00 00 00 00 00 00 00 00 00 00 00 00 00 to request RoutineControl Service");
	SendDiag_Request_Verify_Negative_Response(DiagAnchor3,"31 01 FB 40 00 00 00 00 00 00 00 00 00 00 00 00 00 00 00 00 00 00 00 00 00 00 00 00 00 00 00 00 00 00 00 00 00 00 00 00 00 00 00 00 00 00 00 00 00 00 00 00 00 00 00 00 00 00 00 00 00 00 00 00 00 00 00 00","7F 31 22");
	PostCondition_Anchor( );
}


testcase TCS_PK_FCA_AnchorUDSServer_RoutineControl_NRC22_RIDFB32_ExtendedSession_0x61SecurityLevel_46513()
{
	PreCondition_Anchor("TCS_PK_FCA_AnchorUDSServer_RoutineControl_NRC22_RIDFB32_GenerateSecureCANInitialisationKeyPair_ExtendedSession_0x61SecurityLevel_46513");
	testCaseComment("Actions");
    TestStep("1","Send request 10 03 to enter Extended Diagnostic Session");
	SendDiag_Request_Verify_Response(DiagAnchor3,"10 03","50 03 00 32 01 F4");
    TestStep("2,3","Send Security Seed Request 61 and Key 62 in DiagAnchor");  
    Security_Seed_Key_Access(Anch3,Physical,Bosch);
    TestStep("4","Send request 31 01 FB 32 to request RoutineControl Service");
	SendDiag_Request_Verify_Negative_Response(DiagAnchor3,"31 01 FB 32","7F 31 22");
	PostCondition_Anchor( );
}




/////////////////////////////RoutineControl_NRC13/////////////////////////////////////////////////////
testcase TCS_PK_FCA_AnchorUDSServer_RoutineControl_NRC13_RIDFA01_BLERxSensitivityTest_ExtendedSession_0x61SecurityLevel_45805()
///////TestCase needs to be executed only on Combi-Anchor
{
  PreCondition_Anchor("TCS_PK_FCA_AnchorUDSServer_RoutineControl_NRC13_RIDFA01_BLERxSensitivityTest_ExtendedSession_0x61SecurityLevel_45805");
  testCaseComment("Actions");
  TestStep("1","Send request 10 03 to enter Extended Diagnostic Session");
	SendDiag_Request_Verify_Response(DiagAnchor3,"10 03","50 03 00 32 01 F4");
  TestStep("2,3","Send Security Seed Request 61 and Key 62 in DiagAnchor");  
    Security_Seed_Key_Access(Anch3,Physical,Bosch);
  TestStep("4","Send request 31 01 FA 01 80 EA CA 80 00 01 01 2C 00 to request routine control services");
        SendDiag_Request_Verify_Negative_Response(DiagAnchor3,"31 01 FA 01 80 EA CA 80 00 01 01 2C 00","7F 31 13");
  TestStep("5","Send request 31 01 FA 01 80 EA CA 80 00 01 01 2C 00 01 00 to request routine control services");
        SendDiag_Request_Verify_Negative_Response(DiagAnchor3,"31 01 FA 01 80 EA CA 80 00 01 01 2C 00 01 00","7F 31 13");
  TestStep("6","Send request 31 02 FA 01 00 to request routine control services");
        SendDiag_Request_Verify_Negative_Response(DiagAnchor3,"31 02 FA 01 00","7F 31 13");
  TestStep("7","Send request 31 03 FA 01 00 to request routine control services");
        SendDiag_Request_Verify_Negative_Response(DiagAnchor3,"31 03 FA 01 00","7F 31 13");
  PostCondition_Anchor( );
}


testcase TCS_PK_FCA_AnchorUDSServer_RoutineControl_NRC13_RIDFA02_BLETxPowerTest_ExtendedSession_0x61SecurityLevel_45812()
///////TestCase needs to be executed only on Combi-Anchor
{
  PreCondition_Anchor("TCS_PK_FCA_AnchorUDSServer_RoutineControl_NRC13_RIDFA02_BLETxPowerTest_ExtendedSession_0x61SecurityLevel_45812");
  testCaseComment("Actions");
  TestStep("1","Send request 10 03 to enter Extended Diagnostic Session");
	SendDiag_Request_Verify_Response(DiagAnchor3,"10 03","50 03 00 32 01 F4");
		TestStep("2,3","Send Security Seed Request 61 and Key 62 in DiagAnchor");  
    Security_Seed_Key_Access(Anch3,Physical,Bosch);
  TestStep("4","Send request 31 01 FA 02 01 01 2C 00 to request routine control services");
        SendDiag_Request_Verify_Negative_Response(DiagAnchor3,"31 01 FA 02 01 01 2C 00","7F 31 13");
  TestStep("5","Send request 31 01 FA 02 01 01 2C 00 01 00 to request routine control services");
        SendDiag_Request_Verify_Negative_Response(DiagAnchor3,"31 01 FA 02 01 01 2C 00 01 00","7F 31 13");
  TestStep("6","Send request 31 02 FA 02 00 to request routine control services");
        SendDiag_Request_Verify_Negative_Response(DiagAnchor3,"31 02 FA 02 00","7F 31 13");
  TestStep("7","Send request 31 02 FA 02 00 to request routine control services");
        SendDiag_Request_Verify_Negative_Response(DiagAnchor3,"31 02 FA 02 00","7F 31 13");
  PostCondition_Anchor( );
}


testcase TCS_PK_FCA_AnchorUDSServer_RoutineControl_NRC13_RIDFA03_AnchorImcRoundTripTest_ExtendedSession_0x61SecurityLevel_45824()
{
  PreCondition_Anchor("TCS_PK_FCA_AnchorUDSServer_RoutineControl_NRC13_RIDFA03_AnchorImcRoundTripTest_ExtendedSession_0x61SecurityLevel_45824");
  testCaseComment("Actions");
  TestStep("1","Send request 10 03 to enter Extended Diagnostic Session");
	SendDiag_Request_Verify_Response(DiagAnchor3,"10 03","50 03 00 32 01 F4");
		TestStep("2,3","Send Security Seed Request 61 and Key 62 in DiagAnchor");  
    Security_Seed_Key_Access(Anch3,Physical,Bosch);
  TestStep("4","Send request 31 01 FA 03 00 10 to request routine control services");
        SendDiag_Request_Verify_Negative_Response(DiagAnchor3,"31 01 FA 03 00 10","7F 31 13");
  TestStep("5","Send request 31 01 FA 03 00 10 10 00 to request routine control services");
        SendDiag_Request_Verify_Negative_Response(DiagAnchor3,"31 01 FA 03 00 10 10 00","7F 31 13");
  TestStep("6","Send request 31 03 FA 03 00 to request routine control services");
        SendDiag_Request_Verify_Negative_Response(DiagAnchor3,"31 03 FA 03 00","7F 31 13");
  PostCondition_Anchor( );
}


testcase TCS_PK_FCA_AnchorUDSServer_RoutineControl_NRC13_RIDFA04_BLERSSMeasurement_ExtendedSession_0x61SecurityLevel_45830()
///////TestCase needs to be executed only on Combi-Anchor
{
  PreCondition_Anchor("TCS_PK_FCA_AnchorUDSServer_RoutineControl_NRC13_RIDFA04_BLERSSMeasurement_ExtendedSession_0x61SecurityLevel_45830");
  testCaseComment("Actions");
  TestStep("1","Send request 10 03 to enter Extended Diagnostic Session");
	SendDiag_Request_Verify_Response(DiagAnchor3,"10 03","50 03 00 32 01 F4");
		TestStep("2,3","Send Security Seed Request 61 and Key 62 in DiagAnchor");  
    Security_Seed_Key_Access(Anch3,Physical,Bosch);
  TestStep("4","Send request 31 01 FA 04 01 0B B8 00 to request routine control services");
        SendDiag_Request_Verify_Negative_Response(DiagAnchor3,"31 01 FA 04 01 0B B8 00","7F 31 13");
  TestStep("5","Send request 31 01 FA 04 01 0B B8 00 02 00 to request routine control services");
        SendDiag_Request_Verify_Negative_Response(DiagAnchor3,"31 01 FA 04 01 0B B8 00 02 00","7F 31 13");
  TestStep("6","Send request 31 02 FA 03 00 to request routine control services");
        SendDiag_Request_Verify_Negative_Response(DiagAnchor3,"31 02 FA 03 00","7F 31 13");
  PostCondition_Anchor( );
}


testcase TCS_PK_FCA_AnchorUDSServer_RoutineControl_NRC13_RIDFA05_FastSleep_ExtendedSession_0x61SecurityLevel_45818()
{
  PreCondition_Anchor("TCS_PK_FCA_AnchorUDSServer_RoutineControl_NRC13_RIDFA05_FastSleep_ExtendedSession_0x61SecurityLevel_45818");
  testCaseComment("Actions");
  TestStep("1","Send request 10 03 to enter Extended Diagnostic Session");
	SendDiag_Request_Verify_Response(DiagAnchor3,"10 03","50 03 00 32 01 F4");
		TestStep("2,3","Send Security Seed Request 61 and Key 62 in DiagAnchor");  
    Security_Seed_Key_Access(Anch3,Physical,Bosch);
  TestStep("4","Send request 31 01 FA 05 to request routine control services");
        SendDiag_Request_Verify_Negative_Response(DiagAnchor3,"31 01 FA 05","7F 31 13");
  TestStep("5","Send request 31 01 FA 05 00 00 to request routine control services");
        SendDiag_Request_Verify_Negative_Response(DiagAnchor3,"31 01 FA 05 00 00","7F 31 13");
  PostCondition_Anchor( );
}


testcase TCS_PK_FCA_AnchorUDSServer_RoutineControl_NRC13_RIDFA08_uwbFramesTx_ExtendedSession_0x61SecurityLevel_45836()
{
  PreCondition_Anchor("TCS_PK_FCA_AnchorUDSServer_RoutineControl_NRC13_RIDFA08_uwbFramesTx_ExtendedSession_0x61SecurityLevel_45836");
  testCaseComment("Actions");
  TestStep("1","Send request 10 03 to enter Extended Diagnostic Session");
	SendDiag_Request_Verify_Response(DiagAnchor3,"10 03","50 03 00 32 01 F4");
		TestStep("2,3","Send Security Seed Request 61 and Key 62 in DiagAnchor");  
    Security_Seed_Key_Access(Anch3,Physical,Bosch);
  TestStep("4","Send request 31 01 FA 08 05 00 00 00 00 00 64 0C 12 to request routine control services");
        SendDiag_Request_Verify_Negative_Response(DiagAnchor3,"31 01 FA 08 05 00 00 00 00 00 64 0C 12","7F 31 13");
  TestStep("5","Send request 31 01 FA 08 05 00 00 00 00 00 64 0C 12 12 00 to request routine control services");
        SendDiag_Request_Verify_Negative_Response(DiagAnchor3,"31 01 FA 08 05 00 00 00 00 00 64 0C 12 12 00","7F 31 13");
  TestStep("6","Send request 31 02 FA 08 00 to request routine control services");
        SendDiag_Request_Verify_Negative_Response(DiagAnchor3,"31 02 FA 08 00","7F 31 13");
  TestStep("7","Send request 31 03 FA 08 00 to request routine control services");
        SendDiag_Request_Verify_Negative_Response(DiagAnchor3,"31 03 FA 08 00","7F 31 13");
  PostCondition_Anchor( );
}


testcase TCS_PK_FCA_AnchorUDSServer_RoutineControl_NRC13_RIDFA09_uwbFramesRx_ExtendedSession_0x61SecurityLevel_45853()
{
  PreCondition_Anchor("TCS_PK_FCA_AnchorUDSServer_RoutineControl_NRC13_RIDFA09_uwbFramesRx_ExtendedSession_0x61SecurityLevel_45853");
  testCaseComment("Actions");
  TestStep("1","Send request 10 03 to enter Extended Diagnostic Session");
	SendDiag_Request_Verify_Response(DiagAnchor3,"10 03","50 03 00 32 01 F4");
		TestStep("2,3","Send Security Seed Request 61 and Key 62 in DiagAnchor");  
    Security_Seed_Key_Access(Anch3,Physical,Bosch);
  TestStep("4","Send request 31 01 FA 09 05 00 00 00 64 0C 73 to request routine control services");
        SendDiag_Request_Verify_Negative_Response(DiagAnchor3,"31 01 FA 09 05 00 00 00 64 0C 73","7F 31 13");
  TestStep("5","Send request 31 01 FA 09 05 00 00 00 64 0C 73 73 00 to request routine control services");
        SendDiag_Request_Verify_Negative_Response(DiagAnchor3,"31 01 FA 09 05 00 00 00 64 0C 73 73 00","7F 31 13");
  TestStep("6","Send request 31 02 FA 09 00 to request routine control services");
        SendDiag_Request_Verify_Negative_Response(DiagAnchor3,"31 02 FA 09 00","7F 31 13");
  TestStep("7","Send request 31 03 FA 09 00 to request routine control services");
        SendDiag_Request_Verify_Negative_Response(DiagAnchor3,"31 03 FA 09 00","7F 31 13");
  PostCondition_Anchor( );
}


testcase TCS_PK_FCA_AnchorUDSServer_RoutineControl_NRC13_RIDFA0A_UWBTxLoopback_ExtendedSession_0x61SecurityLevel_45859()
{
  PreCondition_Anchor("TCS_PK_FCA_AnchorUDSServer_RoutineControl_NRC13_RIDFA0A_UWBTxLoopback_ExtendedSession_0x61SecurityLevel_45859");
  testCaseComment("Actions");
  TestStep("1","Send request 10 03 to enter Extended Diagnostic Session");
	SendDiag_Request_Verify_Response(DiagAnchor3,"10 03","50 03 00 32 01 F4");
		TestStep("2,3","Send Security Seed Request 61 and Key 62 in DiagAnchor");  
    Security_Seed_Key_Access(Anch3,Physical,Bosch);
  TestStep("4","Send request 31 01 FA 0A 00 00 00 to request routine control services");
        SendDiag_Request_Verify_Negative_Response(DiagAnchor3,"31 01 FA 0A 00 00 00","7F 31 13");
  TestStep("5","Send request 31 01 FA 0A 00 00 00 05 00 to request routine control services");
        SendDiag_Request_Verify_Negative_Response(DiagAnchor3,"31 01 FA 0A 00 00 00 05 00","7F 31 13");
  PostCondition_Anchor( );
}


testcase TCS_PK_FCA_AnchorUDSServer_RoutineControl_NRC13_RIDFA0B_CarrierWaveMode_ExtendedSession_0x61SecurityLevel_45842()
{
  PreCondition_Anchor("TCS_PK_FCA_AnchorUDSServer_RoutineControl_NRC13_RIDFA0B_CarrierWaveMode_ExtendedSession_0x61SecurityLevel_45842");
  testCaseComment("Actions");
  TestStep("1","Send request 10 03 to enter Extended Diagnostic Session");
	SendDiag_Request_Verify_Response(DiagAnchor3,"10 03","50 03 00 32 01 F4");
		TestStep("2,3","Send Security Seed Request 61 and Key 62 in DiagAnchor");  
    Security_Seed_Key_Access(Anch3,Physical,Bosch);
  TestStep("4","Send request 31 01 FA 0B 05 00 to request routine control services");
        SendDiag_Request_Verify_Negative_Response(DiagAnchor3,"31 01 FA 0B 05 00","7F 31 13");
  TestStep("5","Send request 31 01 FA 0B 05 00 01 00 to request routine control services");
        SendDiag_Request_Verify_Negative_Response(DiagAnchor3,"31 01 FA 0B 05 00 01 00","7F 31 13");
  PostCondition_Anchor( );
}


testcase TCS_PK_FCA_AnchorUDSServer_RoutineControl_NRC13_RIDFA10_uwbCyclic_ExtendedSession_0x61SecurityLevel_45884()
{
  PreCondition_Anchor("TCS_PK_FCA_AnchorUDSServer_RoutineControl_NRC13_RIDFA10_uwbCyclic_ExtendedSession_0x61SecurityLevel_45884");
  testCaseComment("Actions");
  TestStep("1","Send request 10 03 to enter Extended Diagnostic Session");
	SendDiag_Request_Verify_Response(DiagAnchor3,"10 03","50 03 00 32 01 F4");
		TestStep("2,3","Send Security Seed Request 61 and Key 62 in DiagAnchor");  
    Security_Seed_Key_Access(Anch3,Physical,Bosch);
  TestStep("4","Send request 31 01 FA 10 01 01 01 00 01 01 to request routine control services");
        SendDiag_Request_Verify_Negative_Response(DiagAnchor3,"31 01 FA 10 01 01 01 00 01 01","7F 31 13");
  TestStep("5","Send request 31 01 FA 10 01 01 01 00 01 01 01 00 to request routine control services");
        SendDiag_Request_Verify_Negative_Response(DiagAnchor3,"31 01 FA 10 01 01 01 00 01 01 01 00","7F 31 13");
  TestStep("6","Send request 31 02 FA 10 00 to request routine control services");
        SendDiag_Request_Verify_Negative_Response(DiagAnchor3,"31 02 FA 10 00","7F 31 13");
  TestStep("7","Send request 31 03 FA 10 00 to request routine control services");
        SendDiag_Request_Verify_Negative_Response(DiagAnchor3,"31 03 FA 10 00","7F 31 13");
  PostCondition_Anchor( );
}


testcase TCS_PK_FCA_AnchorUDSServer_RoutineControl_NRC13_RIDFA11_Node2NodeRangingCCC_ExtendedSession_0x61SecurityLevel_45895()
{
  PreCondition_Anchor("TCS_PK_FCA_AnchorUDSServer_RoutineControl_NRC13_RIDFA11_Node2NodeRangingCCC_ExtendedSession_0x61SecurityLevel_45895");
  testCaseComment("Actions");
  TestStep("1","Send request 10 03 to enter Extended Diagnostic Session");
	SendDiag_Request_Verify_Response(DiagAnchor3,"10 03","50 03 00 32 01 F4");
		TestStep("2,3","Send Security Seed Request 61 and Key 62 in DiagAnchor");  
    Security_Seed_Key_Access(Anch3,Physical,Bosch);
  TestStep("4","Send request 31 01 FA 11 00 00 00 00 05 09 01 to request routine control services");
        SendDiag_Request_Verify_Negative_Response(DiagAnchor3,"31 01 FA 11 00 00 00 00 05 09 01","7F 31 13");
  TestStep("5","Send request 31 01 FA 11 00 00 00 00 05 09 01 03 00 to request routine control services");
        SendDiag_Request_Verify_Negative_Response(DiagAnchor3,"31 01 FA 11 00 00 00 00 05 09 01 03 00","7F 31 13");
  TestStep("6","Send request 31 02 FA 11 00 to request routine control services");
        SendDiag_Request_Verify_Negative_Response(DiagAnchor3,"31 02 FA 11 00","7F 31 13");
  PostCondition_Anchor( );
}


testcase TCS_PK_FCA_AnchorUDSServer_RoutineControl_NRC13_RIDFA13_UWBTxTest_ExtendedSession_0x61SecurityLevel_45872()
{
  PreCondition_Anchor("TCS_PK_FCA_AnchorUDSServer_RoutineControl_NRC13_RIDFA13_UWBTxTest_ExtendedSession_0x61SecurityLevel_45872");
  testCaseComment("Actions");
  TestStep("1","Send request 10 03 to enter Extended Diagnostic Session");
	SendDiag_Request_Verify_Response(DiagAnchor3,"10 03","50 03 00 32 01 F4");
		TestStep("2,3","Send Security Seed Request 61 and Key 62 in DiagAnchor");  
    Security_Seed_Key_Access(Anch3,Physical,Bosch);
  TestStep("4","Send request 31 01 FA 13 00 00 00 09 03 79 to request routine control services");
        SendDiag_Request_Verify_Negative_Response(DiagAnchor3,"31 01 FA 13 00 00 00 09 03 79","7F 31 13");
  TestStep("5","Send request 31 01 FA 13 00 00 00 09 03 79 01 00 to request routine control services");
        SendDiag_Request_Verify_Negative_Response(DiagAnchor3,"31 01 FA 13 00 00 00 09 03 79 01 00","7F 31 13");
  TestStep("6","Send request 31 02 FA 13 00 to request routine control services");
        SendDiag_Request_Verify_Negative_Response(DiagAnchor3,"31 02 FA 13 00","7F 31 13");
  PostCondition_Anchor( );
}


testcase TCS_PK_FCA_AnchorUDSServer_RoutineControl_NRC13_RIDFA21_StoreSHEKey_ExtendedSession_0x61SecurityLevel_42654()
{
  PreCondition_Anchor("TCS_PK_FCA_AnchorUDSServer_RoutineControl_NRC13_RIDFA21_StoreSHEKey_ExtendedSession_0x61SecurityLevel_42654");
  testCaseComment("Actions");
  TestStep("1","Send request 10 03 to enter Extended Diagnostic Session");
	SendDiag_Request_Verify_Response(DiagAnchor3,"10 03","50 03 00 32 01 F4");
		TestStep("2,3","Send Security Seed Request 61 and Key 62 in DiagAnchor");  
    Security_Seed_Key_Access(Anch3,Physical,Bosch);
  TestStep("4","Send request 31 01 FA 21 00 00 00 00 00 00 00 00 00 00 00 00 00 00 00 00 00 00 00 00 00 00 00 00 00 00 00 00 00 00 00 00 00 00 00 00 00 00 00 00 00 00 00 00 00 00 00 00 00 00 00 00 00 00 00 00 00 00 00 00 00 00 00 00 00 to request routine control services");
        SendDiag_Request_Verify_Negative_Response(DiagAnchor3,"31 01 FA 21 00 00 00 00 00 00 00 00 00 00 00 00 00 00 00 00 00 00 00 00 00 00 00 00 00 00 00 00 00 00 00 00 00 00 00 00 00 00 00 00 00 00 00 00 00 00 00 00 00 00 00 00 00 00 00 00 00 00 00 00 00 00 00 00 00 ","7F 31 13");
  TestStep("5","Send request 31 01 FA 21 00 00 00 00 00 00 00 00 00 00 00 00 00 00 00 00 00 00 00 00 00 00 00 00 00 00 00 00 00 00 00 00 00 00 00 00 00 00 00 00 00 00 00 00 00 00 00 00 00 00 00 00 00 00 00 00 00 00 00 00 00 00 00 00 00 00 to request routine control services");
        SendDiag_Request_Verify_Negative_Response(DiagAnchor3,"00 00 00 00 00 00 00 00 00 00 00 00 00 00 00 00 00 00 00 00 00 00 00 00 00 00 00 00 00 00 00 00 00 00 00 00 00 00 00 00 00 00 00 00 00 00 00 00 00 00 00 00 00 00 00 00 00 00 00 00 00 00 00 00 00 00","7F 31 13");
  TestStep("6","Send request 31 03 FA 21 00 to request routine control services");
        SendDiag_Request_Verify_Negative_Response(DiagAnchor3,"31 03 FA 21 00","7F 31 13");
  PostCondition_Anchor( );
}


testcase TCS_PK_FCA_AnchorUDSServer_RoutineControl_NRC13_RIDFA21_StoreSHEKey_InvalidKeyNumber_ExtendedSession_0x61SecurityLevel_37760()
{
  PreCondition_Anchor("TCS_PK_FCA_AnchorUDSServer_RoutineControl_NRC13_RIDFA21_StoreSHEKey_InvalidKeyNumber_ExtendedSession_0x61SecurityLevel_37760");
  testCaseComment("Actions");
  TestStep("1","Send request 10 03 to enter Extended Diagnostic Session");
	SendDiag_Request_Verify_Response(DiagAnchor3,"10 03","50 03 00 32 01 F4");
		TestStep("2,3","Send Security Seed Request 61 and Key 62 in DiagAnchor");  
    Security_Seed_Key_Access(Anch3,Physical,Bosch);
  TestStep("4","Send request 31 01 FA 21 00 00 00 00 00 00 00 00 00 00 00 00 00 00 00 00 00 00 00 00 00 00 00 00 00 00 00 00 00 00 00 00 00 00 00 00 00 00 00 00 00 00 00 00 00 00 00 00 00 00 00 00 00 00 00 00 00 00 00 00 00 00 00 00 00 to request routine control services");
        SendDiag_Request_Verify_Negative_Response(DiagAnchor3,"31 01 FA 21 00 00 00 00 00 00 00 00 00 00 00 00 00 00 00 00 00 00 00 00 00 00 00 00 00 00 00 00 00 00 00 00 00 00 00 00 00 00 00 00 00 00 00 00 00 00 00 00 00 00 00 00 00 00 00 00 00 00 00 00 00 00 00 00 00 ","7F 31 13");
      PostCondition_Anchor( );
}



testcase TCS_PK_FCA_AnchorUDSServer_RoutineControl_NRC13_RIDFA22_ActivateSecureBoot_ExtendedSession_0x61SecurityLevel_22552()
{
  PreCondition_Anchor("TCS_PK_FCA_AnchorUDSServer_RoutineControl_NRC13_RIDFA22_ActivateSecureBoot_ExtendedSession_0x61SecurityLevel_22552");
  testCaseComment("Actions");
  TestStep("1","Send request 10 03 to enter Extended Diagnostic Session");
	SendDiag_Request_Verify_Response(DiagAnchor3,"10 03","50 03 00 32 01 F4");
		TestStep("2,3","Send Security Seed Request 61 and Key 62 in DiagAnchor");  
    Security_Seed_Key_Access(Anch3,Physical,Bosch);
  TestStep("4","Send request 31 01 FA 22 00 to request routine control services");
        SendDiag_Request_Verify_Negative_Response(DiagAnchor3,"31 01 FA 22 00","7F 31 13");
  PostCondition_Anchor( );
}


testcase TCS_PK_FCA_AnchorUDSServer_RoutineControl_NRC13_RIDFA23_GetSHEEraseChallenge_ExtendedSession_0x61SecurityLevel_26049()
{
  PreCondition_Anchor("TCS_PK_FCA_AnchorUDSServer_RoutineControl_NRC13_RIDFA23_GetSHEEraseChallenge_ExtendedSession_0x61SecurityLevel_26049");
  testCaseComment("Actions");
  TestStep("1","Send request 10 03 to enter Extended Diagnostic Session");
	SendDiag_Request_Verify_Response(DiagAnchor3,"10 03","50 03 00 32 01 F4");
		TestStep("2,3","Send Security Seed Request 61 and Key 62 in DiagAnchor");  
    Security_Seed_Key_Access(Anch3,Physical,Bosch);
  TestStep("4","Send request 31 01 FA 23 00 to request routine control services");
        SendDiag_Request_Verify_Negative_Response(DiagAnchor3,"31 01 FA 23 00","7F 31 13");
  PostCondition_Anchor( );
}


testcase TCS_PK_FCA_AnchorUDSServer_RoutineControl_NRC13_RIDFA24_StoreSHEKey_ExtendedSession_0x61SecurityLevel_31586()
{
  PreCondition_Anchor("TCS_PK_FCA_AnchorUDSServer_RoutineControl_NRC13_RIDFA24_StoreSHEKey_ExtendedSession_0x61SecurityLevel_31586");
  testCaseComment("Actions");
  TestStep("1","Send request 10 03 to enter Extended Diagnostic Session");
	SendDiag_Request_Verify_Response(DiagAnchor3,"10 03","50 03 00 32 01 F4");
		TestStep("2,3","Send Security Seed Request 61 and Key 62 in DiagAnchor");  
    Security_Seed_Key_Access(Anch3,Physical,Bosch);
  TestStep("4","Send request 31 01 FA 24 00 00 00 00 00 00 00 00 00 00 00 00 00 00 00 to request routine control services");
        SendDiag_Request_Verify_Negative_Response(DiagAnchor3,"31 01 FA 24 00 00 00 00 00 00 00 00 00 00 00 00 00 00 00","7F 31 13");
  TestStep("5","Send request 31 01 FA 24 00 00 00 00 00 00 00 00 00 00 00 00 00 00 00 00 00 to request routine control services");
        SendDiag_Request_Verify_Negative_Response(DiagAnchor3,"31 01 FA 24 00 00 00 00 00 00 00 00 00 00 00 00 00 00 00 00 00","7F 31 13");
  PostCondition_Anchor( );
}



testcase TCS_PK_FCA_AnchorUDSServer_RoutineControl_NRC13_RIDFB32_ExtendedSession_0x61SecurityLevel_45614()
{
  PreCondition_Anchor("TCS_PK_FCA_AnchorUDSServer_RoutineControl_NRC13_RIDFB32_GenerateSecureCANInitialisationKeyPair_ExtendedSession_0x61SecurityLevel_45614");
  testCaseComment("Actions");
  TestStep("1","Send request 10 03 to enter Extended Diagnostic Session");
	SendDiag_Request_Verify_Response(DiagAnchor3,"10 03","50 03 00 32 01 F4");
		TestStep("2,3","Send Security Seed Request 61 and Key 62 in DiagAnchor");  
    Security_Seed_Key_Access(Anch3,Physical,Bosch);
  TestStep("4","Send request 31 01 FB 32 00 to request routine control services");
        SendDiag_Request_Verify_Negative_Response(DiagAnchor3,"31 01 FB 32 00","7F 31 13");
  PostCondition_Anchor( );
}


testcase TCS_PK_FCA_AnchorUDSServer_RoutineControl_NRC13_RIDFB33_SetECULifeCycleToInfield_ExtendedSession_0x61SecurityLevel_45620()
{
  PreCondition_Anchor("TCS_PK_FCA_AnchorUDSServer_RoutineControl_NRC13_RIDFB33_SetECULifeCycleToInfield_ExtendedSession_0x61SecurityLevel_45620");
  testCaseComment("Actions");
  TestStep("1","Send request 10 03 to enter Extended Diagnostic Session");
	SendDiag_Request_Verify_Response(DiagAnchor3,"10 03","50 03 00 32 01 F4");
		TestStep("2,3","Send Security Seed Request 61 and Key 62 in DiagAnchor");  
    Security_Seed_Key_Access(Anch3,Physical,Bosch);
  TestStep("4","Send request 31 01 FB 33 00 00 00 00 00 00 00 00 00 00 00 00 00 00 00 00 00 00 00 00 00 00 00 00 00 00 00 00 00 00 00 to request routine control services");
        SendDiag_Request_Verify_Negative_Response(DiagAnchor3,"31 01 FB 33 00 00 00 00 00 00 00 00 00 00 00 00 00 00 00 00 00 00 00 00 00 00 00 00 00 00 00 00 00 00 00","7F 31 13");
  TestStep("5","Send request 31 01 FB 33 00 00 00 00 00 00 00 00 00 00 00 00 00 00 00 00 00 00 00 00 00 00 00 00 00 00 00 00 00 00 00 00 00 to request routine control services");
        SendDiag_Request_Verify_Negative_Response(DiagAnchor3,"31 01 FB 33 00 00 00 00 00 00 00 00 00 00 00 00 00 00 00 00 00 00 00 00 00 00 00 00 00 00 00 00 00 00 00 00 00","7F 31 13");
  PostCondition_Anchor( );
}


testcase TCS_PK_FCA_AnchorUDSServer_RoutineControl_NRC13_RIDFB35_WriteR4CEKCust_ExtendedSession_0x61SecurityLevel_46080()
{
  PreCondition_Anchor("TCS_PK_FCA_AnchorUDSServer_RoutineControl_NRC13_RIDFB35_WriteR4CEKCust_ExtendedSession_0x61SecurityLevel_46080");
  testCaseComment("Actions");
  TestStep("1","Send request 10 03 to enter Extended Diagnostic Session");
	SendDiag_Request_Verify_Response(DiagAnchor3,"10 03","50 03 00 32 01 F4");
		TestStep("2,3","Send Security Seed Request 61 and Key 62 in DiagAnchor");  
    Security_Seed_Key_Access(Anch3,Physical,Bosch);
  TestStep("4","Send request 31 01 FB 35 00 11 22 33 44 55 66 77 88 99 AA BB CC DD EE to request routine control services");
        SendDiag_Request_Verify_Negative_Response(DiagAnchor3,"31 01 FB 35 00 11 22 33 44 55 66 77 88 99 AA BB CC DD EE","7F 31 13");
		 TestStep("5","Send request 31 01 FB 35 00 11 22 33 44 55 66 77 88 99 AA BB CC DD EE FF 00 to request routine control services");
        SendDiag_Request_Verify_Negative_Response(DiagAnchor3,"31 01 FB 35 00 11 22 33 44 55 66 77 88 99 AA BB CC DD EE FF 00","7F 31 13");
  PostCondition_Anchor( );
}


testcase TCS_PK_FCA_AnchorUDSServer_RoutineControl_NRC13_RIDFB36_SetECULifecycleToAnalysis_ExtendedSession_0x61SecurityLevel_46086()
{
  PreCondition_Anchor("TCS_PK_FCA_AnchorUDSServer_RoutineControl_NRC13_RIDFB36_SetECULifecycleToAnalysis_ExtendedSession_0x61SecurityLevel_46086");
  testCaseComment("Actions");
  TestStep("1","Send request 10 03 to enter Extended Diagnostic Session");
	SendDiag_Request_Verify_Response(DiagAnchor3,"10 03","50 03 00 32 01 F4");
		TestStep("2,3","Send Security Seed Request 61 and Key 62 in DiagAnchor");  
    Security_Seed_Key_Access(Anch3,Physical,Bosch);
  TestStep("4","Send request 31 01 FB 36 00 00 00 00 00 00 00 00 00 00 00 00 00 00 00 00 00 00 00 00 00 00 00 00 00 00 00 00 00 00 00 to request routine control services");
        SendDiag_Request_Verify_Negative_Response(DiagAnchor3,"31 01 FB 36 00 00 00 00 00 00 00 00 00 00 00 00 00 00 00 00 00 00 00 00 00 00 00 00 00 00 00 00 00 00 00","7F 31 13");
		 TestStep("5","Send request 31 01 FB 36 00 00 00 00 00 00 00 00 00 00 00 00 00 00 00 00 00 00 00 00 00 00 00 00 00 00 00 00 00 00 00 00 00 to request routine control services");
        SendDiag_Request_Verify_Negative_Response(DiagAnchor3,"31 01 FB 36 00 00 00 00 00 00 00 00 00 00 00 00 00 00 00 00 00 00 00 00 00 00 00 00 00 00 00 00 00 00 00 00 00","7F 31 13");
  PostCondition_Anchor( );
}


testcase TCS_PK_FCA_AnchorUDSServer_RoutineControl_NRC13_RIDFB38_WriteUwbReflashPubKey_ExtendedSession_0x61SecurityLevel_46074()
{
  PreCondition_Anchor("TCS_PK_FCA_AnchorUDSServer_RoutineControl_NRC13_RIDFB38_WriteUwbReflashPubKey_ExtendedSession_0x61SecurityLevel_46074");
  testCaseComment("Actions");
  TestStep("1","Send request 10 03 to enter Extended Diagnostic Session");
	SendDiag_Request_Verify_Response(DiagAnchor3,"10 03","50 03 00 32 01 F4");
		TestStep("2,3","Send Security Seed Request 61 and Key 62 in DiagAnchor");  
    Security_Seed_Key_Access(Anch3,Physical,Bosch);
  TestStep("4","Send request 31 01 FB 38 00 00 00 00 00 00 00 00 00 00 00 00 00 00 00 00 00 00 00 00 00 00 00 00 00 00 00 00 00 00 00 00 00 00 00 00 00 00 00 00 00 00 00 00 00 00 00 00 00 00 00 00 00 00 00 00 00 00 00 00 00 00 00 00 to request routine control services");
        SendDiag_Request_Verify_Negative_Response(DiagAnchor3,"31 01 FB 38 00 00 00 00 00 00 00 00 00 00 00 00 00 00 00 00 00 00 00 00 00 00 00 00 00 00 00 00 00 00 00 00 00 00 00 00 00 00 00 00 00 00 00 00 00 00 00 00 00 00 00 00 00 00 00 00 00 00 00 00 00 00 00 00","7F 31 13");
		 TestStep("5","Send request 31 01 FB 38 00 00 00 00 00 00 00 00 00 00 00 00 00 00 00 00 00 00 00 00 00 00 00 00 00 00 00 00 00 00 00 00 00 00 00 00 00 00 00 00 00 00 00 00 00 00 00 00 00 00 00 00 00 00 00 00 00 00 00 00 00 00 00 00 00 00 to request routine control services");
        SendDiag_Request_Verify_Negative_Response(DiagAnchor3,"31 01 FB 38 00 00 00 00 00 00 00 00 00 00 00 00 00 00 00 00 00 00 00 00 00 00 00 00 00 00 00 00 00 00 00 00 00 00 00 00 00 00 00 00 00 00 00 00 00 00 00 00 00 00 00 00 00 00 00 00 00 00 00 00 00 00 00 00 00 00","7F 31 13");
  PostCondition_Anchor( );
}


testcase TCS_PK_FCA_AnchorUDSServer_RoutineControl_NRC13_RIDFB40_MasterAnchorPairing1_ExtendedSession_0x65SecurityLevel_46397()
{
  PreCondition_Anchor("TCS_PK_FCA_AnchorUDSServer_RoutineControl_NRC13_RIDFB40_MasterAnchorPairing1_ExtendedSession_0x65SecurityLevel_46397");
  testCaseComment("Actions");
  TestStep("1","Send request 10 03 to enter Extended Diagnostic Session");
	SendDiag_Request_Verify_Response(DiagAnchor3,"10 03","50 03 00 32 01 F4");
		TestStep("2,3","Send Security Seed Request 65 and Key 66 in DiagAnchor");  
     Security_Seed_Key_Access(Anch3,Physical,Incar_1);
  TestStep("4","Send request 31 01 FB 40 00 00 00 00 00 00 00 00 00 00 00 00 00 00 00 00 00 00 00 00 00 00 00 00 00 00 00 00 00 00 00 00 00 00 00 00 00 00 00 00 00 00 00 00 00 00 00 00 00 00 00 00 00 00 00 00 00 00 00 00 00 00 00 to request routine control services");
        SendDiag_Request_Verify_Negative_Response(DiagAnchor3,"31 01 FB 40 00 00 00 00 00 00 00 00 00 00 00 00 00 00 00 00 00 00 00 00 00 00 00 00 00 00 00 00 00 00 00 00 00 00 00 00 00 00 00 00 00 00 00 00 00 00 00 00 00 00 00 00 00 00 00 00 00 00 00 00 00 00 00","7F 31 13");
		 TestStep("5","Send request 31 01 FB 40 00 00 00 00 00 00 00 00 00 00 00 00 00 00 00 00 00 00 00 00 00 00 00 00 00 00 00 00 00 00 00 00 00 00 00 00 00 00 00 00 00 00 00 00 00 00 00 00 00 00 00 00 00 00 00 00 00 00 00 00 00 00 00 00 00 to request routine control services");
        SendDiag_Request_Verify_Negative_Response(DiagAnchor3,"31 01 FB 40 00 00 00 00 00 00 00 00 00 00 00 00 00 00 00 00 00 00 00 00 00 00 00 00 00 00 00 00 00 00 00 00 00 00 00 00 00 00 00 00 00 00 00 00 00 00 00 00 00 00 00 00 00 00 00 00 00 00 00 00 00 00 00 00 00","7F 31 13");
  PostCondition_Anchor( );
}


testcase TCS_PK_FCA_AnchorUDSServer_RoutineControl_NRC13_RIDFB41_MasterAnchorPairing2_ExtendedSession_0x65SecurityLevel_46404()
{
  PreCondition_Anchor("TCS_PK_FCA_AnchorUDSServer_RoutineControl_NRC13_RIDFB41_MasterAnchorPairing2_ExtendedSession_0x65SecurityLevel_46404");
  testCaseComment("Actions");
  TestStep("1","Send request 10 03 to enter Extended Diagnostic Session");
	SendDiag_Request_Verify_Response(DiagAnchor3,"10 03","50 03 00 32 01 F4");
		TestStep("2,3","Send Security Seed Request 65 and Key 66 in DiagAnchor");  
    Security_Seed_Key_Access(Anch3,Physical,Incar_1);
  TestStep("4","Send request 31 01 FB 41 00 00 00 00 00 00 00 00 00 00 00 00 00 00 00 00 00 00 00 00 00 00 00 00 00 00 00 00 00 00 00 00 00 00 00 00 00 00 00 00 00 00 00 00 00 00 00 to request routine control services");
        SendDiag_Request_Verify_Negative_Response(DiagAnchor3,"31 01 FB 41 00 00 00 00 00 00 00 00 00 00 00 00 00 00 00 00 00 00 00 00 00 00 00 00 00 00 00 00 00 00 00 00 00 00 00 00 00 00 00 00 00 00 00 00 00 00 00","7F 31 13");
		 TestStep("5","Send request 31 01 FB 41 00 00 00 00 00 00 00 00 00 00 00 00 00 00 00 00 00 00 00 00 00 00 00 00 00 00 00 00 00 00 00 00 00 00 00 00 00 00 00 00 00 00 00 00 00 00 00 00 00 to request routine control services");
        SendDiag_Request_Verify_Negative_Response(DiagAnchor3,"31 01 FB 41 00 00 00 00 00 00 00 00 00 00 00 00 00 00 00 00 00 00 00 00 00 00 00 00 00 00 00 00 00 00 00 00 00 00 00 00 00 00 00 00 00 00 00 00 00 00 00 00 00","7F 31 13");
  PostCondition_Anchor( );
}


testcase TCS_PK_FCA_AnchorUDSServer_RoutineControl_NRC13_RIDFB42_SerialNumberBroadcast_ExtendedSession_0x61SecurityLevel_46410()
{
  PreCondition_Anchor("TCS_PK_FCA_AnchorUDSServer_RoutineControl_NRC13_RIDFB42_SerialNumberBroadcast_ExtendedSession_0x61SecurityLevel_46410");
  testCaseComment("Actions");
  TestStep("1","Send request 10 03 to enter Extended Diagnostic Session");
	SendDiag_Request_Verify_Response(DiagAnchor3,"10 03","50 03 00 32 01 F4");
		TestStep("2,3","Send Security Seed Request 61 and Key 62 in DiagAnchor");  
    Security_Seed_Key_Access(Anch3,Physical,Bosch);
  TestStep("4","Send request 31 01 FB 42 FF to request routine control services");
        SendDiag_Request_Verify_Negative_Response(DiagAnchor3,"31 01 FB 42 FF","7F 31 13");
		 TestStep("5","Send request 31 01 FB 42 FF FF 00 to request routine control services");
        SendDiag_Request_Verify_Negative_Response(DiagAnchor3,"31 01 FB 42 FF FF 00","7F 31 13");
  PostCondition_Anchor( );
}


testcase TCS_PK_FCA_AnchorUDSServer_RoutineControl_NRC13_RIDFB43_SerialNumberCANIDStore_ExtendedSession_0x61SecurityLevel_46432()
{
  PreCondition_Anchor("TCS_PK_FCA_AnchorUDSServer_RoutineControl_NRC13_RIDFB43_SerialNumberCANIDStore_ExtendedSession_0x61SecurityLevel_46432");
  testCaseComment("Actions");
  TestStep("1","Send request 10 03 to enter Extended Diagnostic Session");
	SendDiag_Request_Verify_Response(DiagAnchor3,"10 03","50 03 00 32 01 F4");
		TestStep("2,3","Send Security Seed Request 61 and Key 62 in DiagAnchor");  
    Security_Seed_Key_Access(Anch3,Physical,Bosch);
  TestStep("4","Send request 31 01 FB 43 00 00 00 00 00 00 00 00 00 00 00 00 00 00 00 00 00 00 00 00 00 00 00 00 00 00 00 00 00 00 00 00 to request routine control services");
        SendDiag_Request_Verify_Negative_Response(DiagAnchor3,"31 01 FB 43 00 00 00 00 00 00 00 00 00 00 00 00 00 00 00 00 00 00 00 00 00 00 00 00 00 00 00 00 00 00 00 00","7F 31 13");
		 TestStep("5","Send request 31 01 FB 43 00 00 00 00 00 00 00 00 00 00 00 00 00 00 00 00 00 00 00 00 00 00 00 00 00 00 00 00 00 00 00 00 01 00 to request routine control services");
        SendDiag_Request_Verify_Negative_Response(DiagAnchor3,"31 01 FB 43 00 00 00 00 00 00 00 00 00 00 00 00 00 00 00 00 00 00 00 00 00 00 00 00 00 00 00 00 00 00 00 00 01 00","7F 31 13");
  PostCondition_Anchor( );
}

testcase TCS_PK_FCA_AnchorUDSServer_RoutineControl_NRC13_RIDFC03_CompareSWSignatures_ProgrammingSession_0x61SecurityLevel_46445()
{
  PreCondition_Anchor("TCS_PK_FCA_AnchorUDSServer_RoutineControl_NRC13_RIDFC03_CompareSWSignatures_ProgrammingSession_0x61SecurityLevel_46445");
  testCaseComment("Actions");
  TestStep("1","Send request 10 03 to enter Extended Diagnostic Session");
	SendDiag_Request_Verify_Response(DiagAnchor3,"10 03","50 03 00 32 01 F4");
   TestStep("2,3","Send Security Seed Request 61 and Key 62 in DiagAnchor");  
    Security_Seed_Key_Access(Anch3,Physical,Bosch);
	 TestStep("4","Send request 10 02 to enter Programming Diagnostic Session");
	SendDiag_Request_Verify_Response(DiagAnchor3,"10 02","50 02 00 32 01 F4");
  TestStep("5","Send request 31 01 FC 03 00 00 00 00 00 00 00 00 00 00 00 00 00 00 00 00 00 00 00 00 00 00 00 00 00 00 00 00 00 00 00 00 00 00 00 00 00 00 00 00 00 00 00 00 00 00 00 00 00 00 00 00 00 00 00 00 00 00 00 00 00 00 00 00 00 00 00 to request routine control services");
        SendDiag_Request_Verify_Negative_Response(DiagAnchor3,"31 01 FC 03 00 00 00 00 00 00 00 00 00 00 00 00 00 00 00 00 00 00 00 00 00 00 00 00 00 00 00 00 00 00 00 00 00 00 00 00 00 00 00 00 00 00 00 00 00 00 00 00 00 00 00 00 00 00 00 00 00 00 00 00 00 00 00 00 00 00 00","7F 31 13");
		 TestStep("6","Send request 31 01 FC 03 00 00 00 00 00 00 00 00 00 00 00 00 00 00 00 00 00 00 00 00 00 00 00 00 00 00 00 00 00 00 00 00 00 00 00 00 00 00 00 00 00 00 00 00 00 00 00 00 00 00 00 00 00 00 00 00 00 00 00 00 00 00 00 00 00 00 00 00 00 to request routine control services");
        SendDiag_Request_Verify_Negative_Response(DiagAnchor3,"31 01 FC 03 00 00 00 00 00 00 00 00 00 00 00 00 00 00 00 00 00 00 00 00 00 00 00 00 00 00 00 00 00 00 00 00 00 00 00 00 00 00 00 00 00 00 00 00 00 00 00 00 00 00 00 00 00 00 00 00 00 00 00 00 00 00 00 00 00 00 00 00 00","7F 31 13");
  PostCondition_Anchor( );
}

testcase TCS_PK_FCA_AnchorUDSServer_RoutineControl_NRC13_RIDFC04_VerifySignature_ProgrammingSession_0x61SecurityLevel_46451()
{
  PreCondition_Anchor("TCS_PK_FCA_AnchorUDSServer_RoutineControl_NRC13_RIDFC04_VerifySignature_ProgrammingSession_0x61SecurityLevel_46451");
  testCaseComment("Actions");
  TestStep("1","Send request 10 03 to enter Extended Diagnostic Session");
	SendDiag_Request_Verify_Response(DiagAnchor3,"10 03","50 03 00 32 01 F4");
		TestStep("2,3","Send Security Seed Request 61 and Key 62 in DiagAnchor");  
    Security_Seed_Key_Access(Anch3,Physical,Bosch);
	TestStep("4","Send request 10 02 to enter Programming Diagnostic Session");
	SendDiag_Request_Verify_Response(DiagAnchor3,"10 02","50 02 00 32 01 F4");
  TestStep("5","Send request 31 01 FC 04 00 00 00 to request routine control services");
        SendDiag_Request_Verify_Negative_Response(DiagAnchor3,"31 01 FC 04 00 00 00","7F 31 13");
		 TestStep("6","Send request 31 01 FC 04 00 00 00 00 00 to request routine control services");
        SendDiag_Request_Verify_Negative_Response(DiagAnchor3,"31 01 FC 04 00 00 00 00 00","7F 31 13");
  PostCondition_Anchor( );
}


     
/////////////////////////////DiagnosticSessionControl/////////////////////////////////////////////////////

testcase TCS_PK_FCA_AnchorUDSServer_DiagnosticSessionControl_DefaultSessionToDefaultSession_54250()
{
  PreCondition_Anchor("TCS_PK_FCA_AnchorUDSServer_DiagnosticSessionControl_DefaultSessionToDefaultSession_54250");
  testCaseComment("Actions");
  TestStep("1","Send request 10 01 to enter Default Diagnostic Session");
	SendDiag_Request_Verify_Response(DiagAnchor3,"10 01","50 01 00 32 01 F4");
	PostCondition_Anchor( );
}


testcase TCS_PK_FCA_AnchorUDSServer_DiagnosticSessionControl_DefaultSessionToExtendedSession_54253()
{
  PreCondition_Anchor("TCS_PK_FCA_AnchorUDSServer_DiagnosticSessionControl_DefaultSessionToExtendedSession_54253");
  testCaseComment("Actions");
  TestStep("1","Send request 10 03 to enter Extended Diagnostic Session");
	SendDiag_Request_Verify_Response(DiagAnchor3,"10 03","50 03 00 32 01 F4");
	PostCondition_Anchor( );
}


testcase TCS_PK_FCA_AnchorUDSServer_DiagnosticSessionControl_ExtendedSessionToDefaultSession_0x61SecurityLevel_54256()
{
  PreCondition_Anchor("TCS_PK_FCA_AnchorUDSServer_DiagnosticSessionControl_ExtendedSessionToDefaultSession_0x61SecurityLevel_54256");
  testCaseComment("Actions");
  TestStep("1","Send request 10 03 to enter Extended Diagnostic Session");
	SendDiag_Request_Verify_Response(DiagAnchor3,"10 03","50 03 00 32 01 F4");
	TestStep("2,3","Send Security Seed Request 61 and Key 62 in DiagAnchor");   
       	Security_Seed_Key_Access(Anch3,Physical,Bosch);
		TestStep("4","Send request 10 01 to enter Default Diagnostic Session");
	SendDiag_Request_Verify_Response(DiagAnchor3,"10 01","50 01 00 32 01 F4");
	PostCondition_Anchor( );
}


testcase TCS_PK_FCA_AnchorUDSServer_DiagnosticSessionControl_ExtendedSessionToDefaultSession_0x65SecurityLevel_54259()
{
  PreCondition_Anchor("TCS_PK_FCA_AnchorUDSServer_DiagnosticSessionControl_ExtendedSessionToDefaultSession_0x65SecurityLevel_54259");
  testCaseComment("Actions");
  TestStep("1","Send request 10 03 to enter Extended Diagnostic Session");
	SendDiag_Request_Verify_Response(DiagAnchor3,"10 03","50 03 00 32 01 F4");
	TestStep("2,3","Send Security Seed Request 65 and Key 66 in DiagAnchor");   
       	Security_Seed_Key_Access(Anch3,Physical,Incar_1);
		TestStep("4","Send request 10 01 to enter Default Diagnostic Session");
	SendDiag_Request_Verify_Response(DiagAnchor3,"10 01","50 01 00 32 01 F4");
	PostCondition_Anchor( );
}


testcase TCS_PK_FCA_AnchorUDSServer_DiagnosticSessionControl_ExtendedSessionToDefaultSession_NoSecurityLevel_54263()
{
  PreCondition_Anchor("TCS_PK_FCA_AnchorUDSServer_DiagnosticSessionControl_ExtendedSessionToDefaultSession_NoSecurityLevel_54263");
  testCaseComment("Actions");
  TestStep("1","Send request 10 03 to enter Extended Diagnostic Session");
	SendDiag_Request_Verify_Response(DiagAnchor3,"10 03","50 03 00 32 01 F4");
	 TestStep("2","Send request 10 01 to enter Default Diagnostic Session");
	SendDiag_Request_Verify_Response(DiagAnchor3,"10 01","50 01 00 32 01 F4");
	PostCondition_Anchor( );
}


testcase TCS_PK_FCA_AnchorUDSServer_DiagnosticSessionControl_ExtendedSessionToExtendedSession_0x61SecurityLevel_54265()
{
  PreCondition_Anchor("TCS_PK_FCA_AnchorUDSServer_DiagnosticSessionControl_ExtendedSessionToExtendedSession_0x61SecurityLevel_54265");
  testCaseComment("Actions");
  TestStep("1","Send request 10 03 to enter Extended Diagnostic Session");
	SendDiag_Request_Verify_Response(DiagAnchor3,"10 03","50 03 00 32 01 F4");
	TestStep("2,3","Send Security Seed Request 61 and Key 62 in DiagAnchor");   
       	Security_Seed_Key_Access(Anch3,Physical,Bosch);
		TestStep("4","Send request 10 03 to enter Extended Diagnostic Session");
	SendDiag_Request_Verify_Response(DiagAnchor3,"10 03","50 03 00 32 01 F4");
		PostCondition_Anchor( );
}


testcase TCS_PK_FCA_AnchorUDSServer_DiagnosticSessionControl_ExtendedSessionToExtendedSession_0x65SecurityLevel_54260()
{
  PreCondition_Anchor("TCS_PK_FCA_AnchorUDSServer_DiagnosticSessionControl_ExtendedSessionToExtendedSession_0x65SecurityLevel_54260");
  testCaseComment("Actions");
  TestStep("1","Send request 10 03 to enter Extended Diagnostic Session");
	SendDiag_Request_Verify_Response(DiagAnchor3,"10 03","50 03 00 32 01 F4");
	TestStep("2,3","Send Security Seed Request 65 and Key 66 in DiagAnchor");   
       	Security_Seed_Key_Access(Anch3,Physical,Incar_1);
		TestStep("4","Send request 10 03 to enter Extended Diagnostic Session");
	SendDiag_Request_Verify_Response(DiagAnchor3,"10 03","50 03 00 32 01 F4");
		PostCondition_Anchor( );
}


testcase TCS_PK_FCA_AnchorUDSServer_DiagnosticSessionControl_ExtendedSessionToExtendedSession_NoSecurityLevel_54266()
{
  PreCondition_Anchor("TCS_PK_FCA_AnchorUDSServer_DiagnosticSessionControl_ExtendedSessionToExtendedSession_NoSecurityLevel_54266");
  testCaseComment("Actions");
  TestStep("1","Send request 10 03 to enter Extended Diagnostic Session");
	SendDiag_Request_Verify_Response(DiagAnchor3,"10 03","50 03 00 32 01 F4");
	TestStep("2","Send request 10 03 to enter Extended Diagnostic Session");
	SendDiag_Request_Verify_Response(DiagAnchor3,"10 03","50 03 00 32 01 F4");
	PostCondition_Anchor( );
}


testcase TCS_PK_FCA_AnchorUDSServer_DiagnosticSessionControl_ExtendedSessionToProgrammingSession_0x61SecurityLevel_54267()
{
  PreCondition_Anchor("TCS_PK_FCA_AnchorUDSServer_DiagnosticSessionControl_ExtendedSessionToProgrammingSession_0x61SecurityLevel_54267");
  testCaseComment("Actions");
  TestStep("1","Send request 10 03 to enter Extended Diagnostic Session");
	SendDiag_Request_Verify_Response(DiagAnchor3,"10 03","50 03 00 32 01 F4");
	TestStep("2,3","Send Security Seed Request 61 and Key 62 in DiagAnchor");   
       	Security_Seed_Key_Access(Anch3,Physical,Bosch);
		TestStep("4","Send request 10 02 to enter Programming Diagnostic Session");
	SendDiag_Request_Verify_Response(DiagAnchor3,"10 02","50 02 00 32 01 F4");
		PostCondition_Anchor( );
}


testcase TCS_PK_FCA_AnchorUDSServer_DiagnosticSessionControl_ExtendedSessionToProgrammingSession_0x65SecurityLevel_54271()
{
  PreCondition_Anchor("TCS_PK_FCA_AnchorUDSServer_DiagnosticSessionControl_ExtendedSessionToProgrammingSession_0x65SecurityLevel_54271");
  testCaseComment("Actions");
  TestStep("1","Send request 10 03 to enter Extended Diagnostic Session");
	SendDiag_Request_Verify_Response(DiagAnchor3,"10 03","50 03 00 32 01 F4");
	TestStep("2,3","Send Security Seed Request 65 and Key 66 in DiagAnchor");   
       	Security_Seed_Key_Access(Anch3,Physical,Incar_1);
		TestStep("4","Send request 10 02 to enter Programming Diagnostic Session");
	SendDiag_Request_Verify_Response(DiagAnchor3,"10 02","50 02 00 32 01 F4");
		PostCondition_Anchor( );
}


testcase TCS_PK_FCA_AnchorUDSServer_DiagnosticSessionControl_NRC12_DefaultSessionToInvalidSession_54274()
{
  PreCondition_Anchor("TCS_PK_FCA_AnchorUDSServer_DiagnosticSessionControl_NRC12_DefaultSessionToInvalidSession_54274");
  testCaseComment("Actions");
  TestStep("1","Send request 10 00 to enter Invalid Diagnostic Session");
	SendDiag_Request_Verify_Negative_Response(DiagAnchor3,"10 00","7F 10 12");
	TestStep("2","Send request 10 04 to enter Invalid Diagnostic Session");
	SendDiag_Request_Verify_Negative_Response(DiagAnchor3,"10 04","7F 10 12");
	TestStep("3","Send request 10 AA to enter Invalid Diagnostic Session");
	SendDiag_Request_Verify_Negative_Response(DiagAnchor3,"10 AA","7F 10 12");
	TestStep("4","Send request 10 FF to enter Invalid Diagnostic Session");
	SendDiag_Request_Verify_Negative_Response(DiagAnchor3,"10 FF","7F 10 12");
	PostCondition_Anchor( );
}


testcase TCS_PK_FCA_AnchorUDSServer_DiagnosticSessionControl_NRC12_ExtendedSessionToInvalidSession_NoSecurityLevel_54276()
{
  PreCondition_Anchor("TCS_PK_FCA_AnchorUDSServer_DiagnosticSessionControl_NRC12_ExtendedSessionToInvalidSession_NoSecurityLevel_54276");
  testCaseComment("Actions");
  TestStep("1","Send request 10 03 to enter Extended Diagnostic Session");
	SendDiag_Request_Verify_Response(DiagAnchor3,"10 03","50 03 00 32 01 F4");
  TestStep("2","Send request 10 00 to enter Invalid Diagnostic Session");
	SendDiag_Request_Verify_Negative_Response(DiagAnchor3,"10 00","7F 10 12");
	TestStep("3","Send request 10 04 to enter Invalid Diagnostic Session");
	SendDiag_Request_Verify_Negative_Response(DiagAnchor3,"10 04","7F 10 12");
	TestStep("4","Send request 10 AA to enter Invalid Diagnostic Session");
	SendDiag_Request_Verify_Negative_Response(DiagAnchor3,"10 AA","7F 10 12");
	TestStep("5","Send request 10 FF to enter Invalid Diagnostic Session");
	SendDiag_Request_Verify_Negative_Response(DiagAnchor3,"10 FF","7F 10 12");
	PostCondition_Anchor( );
}


testcase TCS_PK_FCA_AnchorUDSServer_DiagnosticSessionControl_NRC12_ProgrammingSessionToInvalidSession_NoSecurityLevel_54277()
{
  PreCondition_Anchor("TCS_PK_FCA_AnchorUDSServer_DiagnosticSessionControl_NRC12_ProgrammingSessionToInvalidSession_NoSecurityLevel_54277");
  testCaseComment("Actions");
  TestStep("1","Send request 10 03 to enter Extended Diagnostic Session");
	SendDiag_Request_Verify_Response(DiagAnchor3,"10 03","50 03 00 32 01 F4");
	TestStep("2,3","Send Security Seed Request 61 and Key 62 in DiagAnchor");   
       	Security_Seed_Key_Access(Anch3,Physical,Bosch);
		TestStep("4","Send request 10 02 to enter Programming Diagnostic Session");
	SendDiag_Request_Verify_Response(DiagAnchor3,"10 02","50 02 00 32 01 F4");
  TestStep("5","Send request 10 00 to enter Invalid Diagnostic Session");
	SendDiag_Request_Verify_Negative_Response(DiagAnchor3,"10 00","7F 10 12");
	TestStep("6","Send request 10 04 to enter Invalid Diagnostic Session");
	SendDiag_Request_Verify_Negative_Response(DiagAnchor3,"10 04","7F 10 12");
	TestStep("7","Send request 10 AA to enter Invalid Diagnostic Session");
	SendDiag_Request_Verify_Negative_Response(DiagAnchor3,"10 AA","7F 10 12");
	TestStep("8","Send request 10 FF to enter Invalid Diagnostic Session");
	SendDiag_Request_Verify_Negative_Response(DiagAnchor3,"10 FF","7F 10 12");
	PostCondition_Anchor( );
}


testcase TCS_PK_FCA_AnchorUDSServer_DiagnosticSessionControl_NRC13_DefaultSession_54272()
{
  PreCondition_Anchor("TCS_PK_FCA_AnchorUDSServer_DiagnosticSessionControl_NRC13_DefaultSession_54272");
  testCaseComment("Actions");
  TestStep("1","Send request 10 01 00 to enter Invalid Diagnostic Session");
	SendDiag_Request_Verify_Negative_Response(DiagAnchor3,"10 01 00","7F 10 13");
	TestStep("2","Send request 10 to enter Invalid Diagnostic Session");
	SendDiag_Request_Verify_Negative_Response(DiagAnchor3,"10","7F 10 13");
	PostCondition_Anchor( );
}


testcase TCS_PK_FCA_AnchorUDSServer_DiagnosticSessionControl_NRC13_ExtendedSession_NoSecurityLevel_54280()
{
  PreCondition_Anchor("TCS_PK_FCA_AnchorUDSServer_DiagnosticSessionControl_NRC13_ExtendedSession_NoSecurityLevel_54280");
  testCaseComment("Actions");
   TestStep("1","Send request 10 03 to enter Extended Diagnostic Session");
	SendDiag_Request_Verify_Response(DiagAnchor3,"10 03","50 03 00 32 01 F4");
  TestStep("2","Send request 10 01 00 to enter Invalid Diagnostic Session");
	SendDiag_Request_Verify_Negative_Response(DiagAnchor3,"10 01 00","7F 10 13");
	TestStep("3","Send request 10 to enter Invalid Diagnostic Session");
	SendDiag_Request_Verify_Negative_Response(DiagAnchor3,"10","7F 10 13");
	PostCondition_Anchor( );
}


testcase TCS_PK_FCA_AnchorUDSServer_DiagnosticSessionControl_NRC13_ProgrammingSession_NoSecurityLevel_54282()
{
  PreCondition_Anchor("TCS_PK_FCA_AnchorUDSServer_DiagnosticSessionControl_NRC13_ProgrammingSession_NoSecurityLevel_54282");
  testCaseComment("Actions");
   TestStep("1","Send request 10 03 to enter Extended Diagnostic Session");
	SendDiag_Request_Verify_Response(DiagAnchor3,"10 03","50 03 00 32 01 F4");
	TestStep("2,3","Send Security Seed Request 61 and Key 62 in DiagAnchor");   
       	Security_Seed_Key_Access(Anch3,Physical,Bosch);
		TestStep("4","Send request 10 02 to enter Programming Diagnostic Session");
	SendDiag_Request_Verify_Response(DiagAnchor3,"10 02","50 02 00 32 01 F4");
  TestStep("5","Send request 10 01 00 to enter Invalid Diagnostic Session");
	SendDiag_Request_Verify_Negative_Response(DiagAnchor3,"10 01 00","7F 10 13");
	TestStep("6","Send request 10 to enter Invalid Diagnostic Session");
	SendDiag_Request_Verify_Negative_Response(DiagAnchor3,"10","7F 10 13");
	PostCondition_Anchor( );
}


testcase TCS_PK_FCA_AnchorUDSServer_DiagnosticSessionControl_NRC33_ExtendedSessionToProgrammingSession_NoSecurityLevel_54284()
{
  PreCondition_Anchor("TCS_PK_FCA_AnchorUDSServer_DiagnosticSessionControl_NRC33_ExtendedSessionToProgrammingSession_NoSecurityLevel_54284");
  testCaseComment("Actions");
   TestStep("1","Send request 10 03 to enter Extended Diagnostic Session");
	SendDiag_Request_Verify_Response(DiagAnchor3,"10 03","50 03 00 32 01 F4");
	TestStep("2","Send request 10 02 to enter Programming Diagnostic Session");
	SendDiag_Request_Verify_Negative_Response(DiagAnchor3,"10 02","7F 10 33");
	PostCondition_Anchor( );
}


testcase TCS_PK_FCA_AnchorUDSServer_DiagnosticSessionControl_NRC7E_DefaultSessionToProgrammingSession_54279()
{
  PreCondition_Anchor("TCS_PK_FCA_AnchorUDSServer_DiagnosticSessionControl_NRC7E_DefaultSessionToProgrammingSession_54279");
  testCaseComment("Actions");
	TestStep("1","Send request 10 02 to enter Programming Diagnostic Session");
	SendDiag_Request_Verify_Negative_Response(DiagAnchor3,"10 02","7F 10 7E");
	PostCondition_Anchor( );
}


testcase TCS_PK_FCA_AnchorUDSServer_DiagnosticSessionControl_ProgrammingSessionToDefaultSession_NoSecurityLevel_54288()
{
  PreCondition_Anchor("TCS_PK_FCA_AnchorUDSServer_DiagnosticSessionControl_ProgrammingSessionToDefaultSession_NoSecurityLevel_54288");
  testCaseComment("Actions");
   TestStep("1","Send request 10 03 to enter Extended Diagnostic Session");
	SendDiag_Request_Verify_Response(DiagAnchor3,"10 03","50 03 00 32 01 F4");
	TestStep("2,3","Send Security Seed Request 61 and Key 62 in DiagAnchor");   
       	Security_Seed_Key_Access(Anch3,Physical,Bosch);
		TestStep("4","Send request 10 02 to enter Programming Diagnostic Session");
	SendDiag_Request_Verify_Response(DiagAnchor3,"10 02","50 02 00 32 01 F4");
	PostCondition_Anchor( );
}


testcase TCS_PK_FCA_AnchorUDSServer_DiagnosticSessionControl_ProgrammingSessionToDefaultSession_0x65SecurityLevel_54290()
{
  PreCondition_Anchor("TCS_PK_FCA_AnchorUDSServer_DiagnosticSessionControl_ProgrammingSessionToDefaultSession_0x65SecurityLevel_54290");
  testCaseComment("Actions");
   TestStep("1","Send request 10 03 to enter Extended Diagnostic Session");
	SendDiag_Request_Verify_Response(DiagAnchor3,"10 03","50 03 00 32 01 F4");
	TestStep("2,3","Send Security Seed Request 61 and Key 62 in DiagAnchor");   
       	Security_Seed_Key_Access(Anch3,Physical,Bosch);
		TestStep("4","Send request 10 02 to enter Programming Diagnostic Session");
	SendDiag_Request_Verify_Response(DiagAnchor3,"10 02","50 02 00 32 01 F4");
	TestStep("5,6","Send Security Seed Request 65 and Key 66 in DiagAnchor");   
       	Security_Seed_Key_Access(Anch3,Physical,Incar_1);
	PostCondition_Anchor( );
}


testcase TCS_PK_FCA_AnchorUDSServer_DiagnosticSessionControl_ProgrammingSessionToDefaultSession_NoSecurityLevel_54286()
{
  PreCondition_Anchor("TCS_PK_FCA_AnchorUDSServer_DiagnosticSessionControl_ProgrammingSessionToDefaultSession_NoSecurityLevel_54286");
  testCaseComment("Actions");
   TestStep("1","Send request 10 03 to enter Extended Diagnostic Session");
	SendDiag_Request_Verify_Response(DiagAnchor3,"10 03","50 03 00 32 01 F4");
	TestStep("2,3","Send Security Seed Request 61 and Key 62 in DiagAnchor");   
       	Security_Seed_Key_Access(Anch3,Physical,Bosch);
		TestStep("4","Send request 10 02 to enter Programming Diagnostic Session");
	SendDiag_Request_Verify_Response(DiagAnchor3,"10 02","50 02 00 32 01 F4");
	 TestStep("5","Send request 10 01 to enter Default Diagnostic Session");
	SendDiag_Request_Verify_Response(DiagAnchor3,"10 01","50 01 00 32 01 F4");
     PostCondition_Anchor( );
}


testcase TCS_PK_FCA_AnchorUDSServer_DiagnosticSessionControl_ProgrammingSessionToProgrammingSession_NoSecurityLevel_54292()
{
  PreCondition_Anchor("TCS_PK_FCA_AnchorUDSServer_DiagnosticSessionControl_ProgrammingSessionToProgrammingSession_NoSecurityLevel_54292");
  testCaseComment("Actions");
   TestStep("1","Send request 10 03 to enter Extended Diagnostic Session");
	SendDiag_Request_Verify_Response(DiagAnchor3,"10 03","50 03 00 32 01 F4");
	TestStep("2,3","Send Security Seed Request 61 and Key 62 in DiagAnchor");   
       	Security_Seed_Key_Access(Anch3,Physical,Bosch);
		TestStep("4","Send request 10 02 to enter Programming Diagnostic Session");
	SendDiag_Request_Verify_Response(DiagAnchor3,"10 02","50 02 00 32 01 F4");
	 TestStep("5","Send request 10 02 to enter Programming Diagnostic Session");
	SendDiag_Request_Verify_Response(DiagAnchor3,"10 02","50 02 00 32 01 F4");
     PostCondition_Anchor( );
}


testcase TCS_PK_FCA_AnchorUDSServer_DiagnosticSessionControl_ProgrammingSessionToProgrammingSession_0x65SecurityLevel_54294()
{
  PreCondition_Anchor("TCS_PK_FCA_AnchorUDSServer_DiagnosticSessionControl_ProgrammingSessionToProgrammingSession_0x65SecurityLevel_54294");
  testCaseComment("Actions");
   TestStep("1","Send request 10 03 to enter Extended Diagnostic Session");
	SendDiag_Request_Verify_Response(DiagAnchor3,"10 03","50 03 00 32 01 F4");
	TestStep("2,3","Send Security Seed Request 61 and Key 62 in DiagAnchor");   
       	Security_Seed_Key_Access(Anch3,Physical,Bosch);
		TestStep("4","Send request 10 02 to enter Programming Diagnostic Session");
	SendDiag_Request_Verify_Response(DiagAnchor3,"10 02","50 02 00 32 01 F4");
	TestStep("5,6","Send Security Seed Request 65 and Key 66 in DiagAnchor");   
       	Security_Seed_Key_Access(Anch3,Physical,Incar_1);
	 TestStep("7","Send request 10 02 to enter Programming Diagnostic Session");
	SendDiag_Request_Verify_Response(DiagAnchor3,"10 02","50 02 00 32 01 F4");
     PostCondition_Anchor( );
}


testcase TCS_PK_FCA_AnchorUDSServer_DiagnosticSessionControl_ProgrammingSessionToProgrammingSession_NoSecurityLevel_54295()
{
  PreCondition_Anchor("TCS_PK_FCA_AnchorUDSServer_DiagnosticSessionControl_ProgrammingSessionToProgrammingSession_NoSecurityLevel_54295");
  testCaseComment("Actions");
   TestStep("1","Send request 10 03 to enter Extended Diagnostic Session");
	SendDiag_Request_Verify_Response(DiagAnchor3,"10 03","50 03 00 32 01 F4");
	TestStep("2,3","Send Security Seed Request 61 and Key 62 in DiagAnchor");   
       	Security_Seed_Key_Access(Anch3,Physical,Bosch);
		TestStep("4","Send request 10 02 to enter Programming Diagnostic Session");
	SendDiag_Request_Verify_Response(DiagAnchor3,"10 02","50 02 00 32 01 F4");
	 TestStep("5","Send request 10 02 to enter Programming Diagnostic Session");
	SendDiag_Request_Verify_Response(DiagAnchor3,"10 02","50 02 00 32 01 F4");
     PostCondition_Anchor( );
}


/////////////////////////RequestTransferExit_NRCs////////////////////////

testcase TCS_PK_FCA_AnchorUDSServer_RequestTransferExit_NRC11_DefaultSession_37343()
{
  PreCondition_Anchor("TCS_PK_FCA_AnchorUDSServer_RequestTransferExit_NRC11_DefaultSession_37343");
  testCaseComment("Actions");
  testWaitForTimeout(1000);
   TestStep("1","Send request 36 01 00 00 00 00 00 00 00 00 00 00 00 00 00 00 00 00 00 00 00 00 00 00 00 00 00 00 00 00 00 00 00 00 00 00 00 00 00 00 00 00 00 00 00 00 00 00 00 00 00 00 00 00 00 00 00 00 00 00 00 00 00 00 00 00 00 00 00 00 00 00 00 00 00 00 00 00 00 00 00 00 00 00 00 00 00 00 00 00 00 00 00 00 00 00 00 00 00 00 00 00 00 00 00 00 00 00 00 00 00 00 00 00 00 00 00 00 00 00 00 00 00 00 00 00 00 00 00 00 00 00 00 00 00 00 00 00 00 00 00 00 00 00 00 00 00 00 00 00 00 00 00 00 00 00 00 00 00 00 00 00 00 00 00 00 00 00 00 00 00 00 00 00 00 00 00 00 00 00 00 00 00 00 00 00 00 00 00 00 00 00 00 00 00 00 00 00 00 00 00 00 00 00 00 00 00 00 00 00 00 00 00 00 00 00 00 00 00 00 00 00 00 00 00 00 00 00 00 00 00 00 00 00 00 00 00 00 00 00 to request Transfer Data service");
        SendDiag_Request_Verify_Negative_Response(DiagAnchor3,"36 01 00 00 00 00 00 00 00 00 00 00 00 00 00 00 00 00 00 00 00 00 00 00 00 00 00 00 00 00 00 00 00 00 00 00 00 00 00 00 00 00 00 00 00 00 00 00 00 00 00 00 00 00 00 00 00 00 00 00 00 00 00 00 00 00 00 00 00 00 00 00 00 00 00 00 00 00 00 00 00 00 00 00 00 00 00 00 00 00 00 00 00 00 00 00 00 00 00 00 00 00 00 00 00 00 00 00 00 00 00 00 00 00 00 00 00 00 00 00 00 00 00 00 00 00 00 00 00 00 00 00 00 00 00 00 00 00 00 00 00 00 00 00 00 00 00 00 00 00 00 00 00 00 00 00 00 00 00 00 00 00 00 00 00 00 00 00 00 00 00 00 00 00 00 00 00 00 00 00 00 00 00 00 00 00 00 00 00 00 00 00 00 00 00 00 00 00 00 00 00 00 00 00 00 00 00 00 00 00 00 00 00 00 00 00 00 00 00 00 00 00 00 00 00 00 00 00 00 00 00 00 00 00 00 00 00 00 00 00","7F 36 11");
	testWaitForTimeout(1000);	
  PostCondition_Anchor( );
}


testcase TCS_PK_FCA_AnchorUDSServer_RequestTransferExit_NRC11_ExtendedSession_NoSecurityLevel_37312()
{
  PreCondition_Anchor("TCS_PK_FCA_AnchorUDSServer_RequestTransferExit_NRC11_ExtendedSession_NoSecurityLevel_37312");
  testCaseComment("Actions");
  testWaitForTimeout(1000);
  TestStep("1","Send request 10 03 to enter Extended Diagnostic Session");
	SendDiag_Request_Verify_Response(DiagAnchor3,"10 03","50 03 00 32 01 F4");
  testWaitForTimeout(1000);
   TestStep("2","Send request 36 01 00 00 00 00 00 00 00 00 00 00 00 00 00 00 00 00 00 00 00 00 00 00 00 00 00 00 00 00 00 00 00 00 00 00 00 00 00 00 00 00 00 00 00 00 00 00 00 00 00 00 00 00 00 00 00 00 00 00 00 00 00 00 00 00 00 00 00 00 00 00 00 00 00 00 00 00 00 00 00 00 00 00 00 00 00 00 00 00 00 00 00 00 00 00 00 00 00 00 00 00 00 00 00 00 00 00 00 00 00 00 00 00 00 00 00 00 00 00 00 00 00 00 00 00 00 00 00 00 00 00 00 00 00 00 00 00 00 00 00 00 00 00 00 00 00 00 00 00 00 00 00 00 00 00 00 00 00 00 00 00 00 00 00 00 00 00 00 00 00 00 00 00 00 00 00 00 00 00 00 00 00 00 00 00 00 00 00 00 00 00 00 00 00 00 00 00 00 00 00 00 00 00 00 00 00 00 00 00 00 00 00 00 00 00 00 00 00 00 00 00 00 00 00 00 00 00 00 00 00 00 00 00 00 00 00 00 00 00 to request Transfer Data service");
        SendDiag_Request_Verify_Negative_Response(DiagAnchor3,"36 01 00 00 00 00 00 00 00 00 00 00 00 00 00 00 00 00 00 00 00 00 00 00 00 00 00 00 00 00 00 00 00 00 00 00 00 00 00 00 00 00 00 00 00 00 00 00 00 00 00 00 00 00 00 00 00 00 00 00 00 00 00 00 00 00 00 00 00 00 00 00 00 00 00 00 00 00 00 00 00 00 00 00 00 00 00 00 00 00 00 00 00 00 00 00 00 00 00 00 00 00 00 00 00 00 00 00 00 00 00 00 00 00 00 00 00 00 00 00 00 00 00 00 00 00 00 00 00 00 00 00 00 00 00 00 00 00 00 00 00 00 00 00 00 00 00 00 00 00 00 00 00 00 00 00 00 00 00 00 00 00 00 00 00 00 00 00 00 00 00 00 00 00 00 00 00 00 00 00 00 00 00 00 00 00 00 00 00 00 00 00 00 00 00 00 00 00 00 00 00 00 00 00 00 00 00 00 00 00 00 00 00 00 00 00 00 00 00 00 00 00 00 00 00 00 00 00 00 00 00 00 00 00 00 00 00 00 00 00","7F 36 11");
	testWaitForTimeout(1000);	
  PostCondition_Anchor( );
}


testcase TCS_PK_FCA_AnchorUDSServer_RequestTransferExit_NRC13_ProgrammingSession_0x61SecurityLevel_37355()
{
  PreCondition_Anchor("TCS_PK_FCA_AnchorUDSServer_RequestTransferExit_NRC13_ProgrammingSession_0x61SecurityLevel_37355");
  testCaseComment("Actions");
  testWaitForTimeout(1000);
    TestStep("1","Send request 10 03 to enter Extended Diagnostic Session");
	SendDiag_Request_Verify_Response(DiagAnchor3,"10 03","50 03 00 32 01 F4");
  testWaitForTimeout(1000);
	TestStep("2,3","Send Security Seed Request 61 and Key 62 in DiagAnchor");   
       	Security_Seed_Key_Access(Anch3,Physical,Bosch);
		TestStep("4","Send request 10 02 to enter Programming Diagnostic Session");
	SendDiag_Request_Verify_Response(DiagAnchor3,"10 02","50 02 00 32 01 F4");
	TestStep("5,6","Send Security Seed Request 61 and Key 62 in DiagAnchor");   
       	Security_Seed_Key_Access(Anch3,Physical,Bosch);
  testWaitForTimeout(1000);
  TestStep("7","Send request 34 00 14 00 00 00 00 EE to request Request Download service");
        SendDiag_Request_Verify_Response(DiagAnchor3,"34 00 14 00 00 00 00 EE","74 20 00 F2");
		 TestStep("8","Send request 36 01 11 11 11 11 11 11 11 11 11 11 11 11 11 11 11 11 11 11 11 11 11 11 11 11 11 11 11 11 11 11 11 11 11 11 11 11 11 11 11 11 11 11 11 11 11 11 11 11 11 11 11 11 11 11 11 11 11 11 11 11 11 11 11 11 11 11 11 11 11 11 11 11 11 11 11 11 11 11 11 11 11 11 11 11 11 11 11 11 11 11 11 11 11 11 11 11 11 11 11 11 11 11 11 11 11 11 11 11 11 11 11 11 11 11 11 11 11 11 11 11 11 11 11 11 11 11 11 11 11 11 11 11 11 11 11 11 11 11 11 11 11 11 11 11 11 11 11 11 11 11 11 11 11 11 11 11 11 11 11 11 11 11 11 11 11 11 11 11 11 11 11 11 11 11 11 11 11 11 11 11 11 11 11 11 11 11 11 11 11 11 11 11 11 11 11 11 11 11 11 11 11 11 11 11 11 11 11 11 11 11 11 11 11 11 11 11 11 11 11 11 11 11 11 11 11 11 11 11 11 11 11 11 11 11 11 11 11 11 to request Request Download service");
        SendDiag_Request_Verify_Response(DiagAnchor3,"36 01 11 11 11 11 11 11 11 11 11 11 11 11 11 11 11 11 11 11 11 11 11 11 11 11 11 11 11 11 11 11 11 11 11 11 11 11 11 11 11 11 11 11 11 11 11 11 11 11 11 11 11 11 11 11 11 11 11 11 11 11 11 11 11 11 11 11 11 11 11 11 11 11 11 11 11 11 11 11 11 11 11 11 11 11 11 11 11 11 11 11 11 11 11 11 11 11 11 11 11 11 11 11 11 11 11 11 11 11 11 11 11 11 11 11 11 11 11 11 11 11 11 11 11 11 11 11 11 11 11 11 11 11 11 11 11 11 11 11 11 11 11 11 11 11 11 11 11 11 11 11 11 11 11 11 11 11 11 11 11 11 11 11 11 11 11 11 11 11 11 11 11 11 11 11 11 11 11 11 11 11 11 11 11 11 11 11 11 11 11 11 11 11 11 11 11 11 11 11 11 11 11 11 11 11 11 11 11 11 11 11 11 11 11 11 11 11 11 11 11 11 11 11 11 11 11 11 11 11 11 11 11 11 11 11 11 11 11 11","76 01");
		TestStep("9","Send request 37 00 to request Transfer Exit service");
        SendDiag_Request_Verify_Negative_Response(DiagAnchor3,"37 00","7F 37 13");
  testWaitForTimeout(1000);
		PostCondition_Anchor( );
}


testcase TCS_PK_FCA_AnchorUDSServer_RequestTransferExit_NRC24_ProgrammingSession_0x61SecurityLevel_37233()
{
  PreCondition_Anchor("TCS_PK_FCA_AnchorUDSServer_RequestTransferExit_NRC24_ProgrammingSession_0x61SecurityLevel_37233");
  testCaseComment("Actions");
  testWaitForTimeout(1000);
  TestStep("1","Send request 10 03 to enter Extended Diagnostic Session");
	SendDiag_Request_Verify_Response(DiagAnchor3,"10 03","50 03 00 32 01 F4");
  testWaitForTimeout(1000);
	TestStep("2,3","Send Security Seed Request 61 and Key 62 in DiagAnchor");   
     	Security_Seed_Key_Access(Anch3,Physical,Bosch);
		TestStep("4","Send request 10 02 to enter Programming Diagnostic Session");
	SendDiag_Request_Verify_Response(DiagAnchor3,"10 02","50 02 00 32 01 F4");
	TestStep("5,6","Send Security Seed Request 61 and Key 62 in DiagAnchor");   
      	Security_Seed_Key_Access(Anch3,Physical,Bosch);
  testWaitForTimeout(1000);
		TestStep("7","Send request 37 to request Transfer Exit service");
		SendDiag_Request_Verify_Negative_Response(DiagAnchor3,"37","7F 37 24");
		 TestStep("8","Send request 34 00 24 00 00 00 00 01 DE to request Request Download service");
      SendDiag_Request_Verify_Response(DiagAnchor3,"34 00 24 00 00 00 00 01 DE","74 20 00 F2");
        TestStep("9","Send request 37 to request Transfer Exit service");
  testWaitForTimeout(1000);
		SendDiag_Request_Verify_Negative_Response(DiagAnchor3,"37","7F 37 24");
		 TestStep("10","Send request 10 01 to enter Default Diagnostic Session");
	SendDiag_Request_Verify_Response(DiagAnchor3,"10 01","50 01 00 32 01 F4");
  testWaitForTimeout(1000);
		 TestStep("11","Send request 10 03 to enter Extended Diagnostic Session");
	SendDiag_Request_Verify_Response(DiagAnchor3,"10 03","50 03 00 32 01 F4");
  testWaitForTimeout(1000);
	TestStep("12,13","Send Security Seed Request 61 and Key 62 in DiagAnchor");   
       	Security_Seed_Key_Access(Anch3,Physical,Bosch);
		TestStep("14","Send request 10 02 to enter Programming Diagnostic Session");
	SendDiag_Request_Verify_Response(DiagAnchor3,"10 02","50 02 00 32 01 F4");
	TestStep("15,16","Send Security Seed Request 61 and Key 62 in DiagAnchor");   
       	Security_Seed_Key_Access(Anch3,Physical,Bosch);
		TestStep("17","Send request 34 00 24 00 00 00 00 01 DE to request Request Download service");
        SendDiag_Request_Verify_Response(DiagAnchor3,"34 00 24 00 00 00 00 01 DE","74 20 00 F2");
		 TestStep("18","Send request 36 01 11 11 11 11 11 11 11 11 11 11 11 11 11 11 11 11 11 11 11 11 11 11 11 11 11 11 11 11 11 11 11 11 11 11 11 11 11 11 11 11 11 11 11 11 11 11 11 11 11 11 11 11 11 11 11 11 11 11 11 11 11 11 11 11 11 11 11 11 11 11 11 11 11 11 11 11 11 11 11 11 11 11 11 11 11 11 11 11 11 11 11 11 11 11 11 11 11 11 11 11 11 11 11 11 11 11 11 11 11 11 11 11 11 11 11 11 11 11 11 11 11 11 11 11 11 11 11 11 11 11 11 11 11 11 11 11 11 11 11 11 11 11 11 11 11 11 11 11 11 11 11 11 11 11 11 11 11 11 11 11 11 11 11 11 11 11 11 11 11 11 11 11 11 11 11 11 11 11 11 11 11 11 11 11 11 11 11 11 11 11 11 11 11 11 11 11 11 11 11 11 11 11 11 11 11 11 11 11 11 11 11 11 11 11 11 11 11 11 11 11 11 11 11 11 11 11 11 11 11 11 11 11 11 11 11 11 11 11 to request Request Download service");
        SendDiag_Request_Verify_Response(DiagAnchor3,"36 01 11 11 11 11 11 11 11 11 11 11 11 11 11 11 11 11 11 11 11 11 11 11 11 11 11 11 11 11 11 11 11 11 11 11 11 11 11 11 11 11 11 11 11 11 11 11 11 11 11 11 11 11 11 11 11 11 11 11 11 11 11 11 11 11 11 11 11 11 11 11 11 11 11 11 11 11 11 11 11 11 11 11 11 11 11 11 11 11 11 11 11 11 11 11 11 11 11 11 11 11 11 11 11 11 11 11 11 11 11 11 11 11 11 11 11 11 11 11 11 11 11 11 11 11 11 11 11 11 11 11 11 11 11 11 11 11 11 11 11 11 11 11 11 11 11 11 11 11 11 11 11 11 11 11 11 11 11 11 11 11 11 11 11 11 11 11 11 11 11 11 11 11 11 11 11 11 11 11 11 11 11 11 11 11 11 11 11 11 11 11 11 11 11 11 11 11 11 11 11 11 11 11 11 11 11 11 11 11 11 11 11 11 11 11 11 11 11 11 11 11 11 11 11 11 11 11 11 11 11 11 11 11 11 11 11 11 11 11","76 01");
		TestStep("19","Send request 37 to request Transfer Exit service");
        SendDiag_Request_Verify_Negative_Response(DiagAnchor3,"37","7F 37 24");
	testWaitForTimeout(1000);	
  PostCondition_Anchor( );
     }



testcase TCS_PK_FCA_AnchorUDSServer_RequestTransferExit_NRC7F_DefaultSession_37252()
{
  PreCondition_Anchor("TCS_PK_FCA_AnchorUDSServer_RequestTransferExit_NRC7F_DefaultSession_37252");
  testCaseComment("Actions");
  testWaitForTimeout(1000);
    TestStep("1","Send request 10 03 to enter Extended Diagnostic Session");
	SendDiag_Request_Verify_Response(DiagAnchor3,"10 03","50 03 00 32 01 F4");
  testWaitForTimeout(1000);
	TestStep("2,3","Send Security Seed Request 61 and Key 62 in DiagAnchor");   
       	Security_Seed_Key_Access(Anch3,Physical,Bosch);
		TestStep("4","Send request 10 02 to enter Programming Diagnostic Session");
	SendDiag_Request_Verify_Response(DiagAnchor3,"10 02","50 02 00 32 01 F4");
  testWaitForTimeout(1000);
     TestStep("5","Send request 34 00 14 00 00 00 00 EE to request Request Download service");
        SendDiag_Request_Verify_Response(DiagAnchor3,"34 00 14 00 00 00 00 EE","74 20 00 F2");
		TestStep("6","Send request 10 01 to enter Default Diagnostic Session");
	SendDiag_Request_Verify_Response(DiagAnchor3,"10 01","50 01 00 32 01 F4");
  testWaitForTimeout(1000);
    TestStep("7","Send request 37 to request Transfer Exit service");
		SendDiag_Request_Verify_Negative_Response(DiagAnchor3,"37","7F 37 7F");
  testWaitForTimeout(1000);
		PostCondition_Anchor( );
}



testcase TCS_PK_FCA_AnchorUDSServer_RequestTransferExit_NRC7F_ExtendedSession_NoSecurityLevel_37361()
{
  PreCondition_Anchor("TCS_PK_FCA_AnchorUDSServer_RequestTransferExit_NRC7F_ExtendedSession_NoSecurityLevel_37361");
  testCaseComment("Actions");
  testWaitForTimeout(1000);
    TestStep("1","Send request 10 03 to enter Extended Diagnostic Session");
	SendDiag_Request_Verify_Response(DiagAnchor3,"10 03","50 03 00 32 01 F4");
  testWaitForTimeout(1000);
	TestStep("2,3","Send Security Seed Request 61 and Key 62 in DiagAnchor");   
       	Security_Seed_Key_Access(Anch3,Physical,Bosch);
		TestStep("4","Send request 10 02 to enter Programming Diagnostic Session");
	SendDiag_Request_Verify_Response(DiagAnchor3,"10 02","50 02 00 32 01 F4");
     TestStep("5","Send request 34 00 14 00 00 00 00 EE to request Request Download service");
        SendDiag_Request_Verify_Response(DiagAnchor3,"34 00 14 00 00 00 00 EE","74 20 00 F2");
		TestStep("6","Send request 10 01 to enter Default Diagnostic Session");
  testWaitForTimeout(1000);
	SendDiag_Request_Verify_Response(DiagAnchor3,"10 01","50 01 00 32 01 F4");
	TestStep("7","Send request 10 03 to enter Extended Diagnostic Session");
  testWaitForTimeout(1000);
	SendDiag_Request_Verify_Response(DiagAnchor3,"10 03","50 03 00 32 01 F4");
    TestStep("8","Send request 37 to request Transfer Exit service");
  testWaitForTimeout(1000);
		SendDiag_Request_Verify_Negative_Response(DiagAnchor3,"37","7F 37 7F");
  testWaitForTimeout(1000);
		PostCondition_Anchor( );
}



////////////////////////ReadDTCInformation/////////////////

testcase TCS_PK_FCA_AnchorUDSServer_ReadDTCInformation_NRC11_ProgrammingSession_NoSecurityLevel_20676()
{
  PreCondition_Anchor("TCS_PK_FCA_AnchorUDSServer_ReadDTCInformation_NRC11_ProgrammingSession_NoSecurityLevel_20676");
  testCaseComment("Actions");
  TestStep("1","Send request 10 03 to enter Extended Diagnostic Session");
	SendDiag_Request_Verify_Response(DiagAnchor3,"10 03","50 03 00 32 01 F4");
		TestStep("2,3","Send Security Seed Request 61 and Key 62 in DiagAnchor");  
    Security_Seed_Key_Access(Anch3,Physical,Bosch);
	 TestStep("4","Send request 10 02 to enter Programming Diagnostic Session");
	SendDiag_Request_Verify_Response(DiagAnchor3,"10 02","50 02 00 32 01 F4");
  TestStep("5","Send request 19 02 FF to request ReadDTCInformation SID");
        SendDiag_Request_Verify_Negative_Response(DiagAnchor3,"19 02 FF","7F 19 11");
  PostCondition_Anchor( );
}


testcase TCS_PK_FCA_AnchorUDSServer_ReadDTCInformation_NRC12_DefaultSession_20688()
{
  PreCondition_Anchor("TCS_PK_FCA_AnchorUDSServer_ReadDTCInformation_NRC12_DefaultSession_20688");
  testCaseComment("Actions");
  TestStep("1","Send request 19 00 to request ReadDTCInformation SID");
        SendDiag_Request_Verify_Negative_Response(DiagAnchor3,"19 00","7F 19 12");
		TestStep("2","Send request 19 01 to request ReadDTCInformation SID");
        SendDiag_Request_Verify_Negative_Response(DiagAnchor3,"19 05","7F 19 12");
		TestStep("3","Send request 19 07 to request ReadDTCInformation SID");
        SendDiag_Request_Verify_Negative_Response(DiagAnchor3,"19 07","7F 19 12");
		TestStep("4","Send request 19 09 to request ReadDTCInformation SID");
        SendDiag_Request_Verify_Negative_Response(DiagAnchor3,"19 09","7F 19 12");
		TestStep("5","Send request 19 0B to request ReadDTCInformation SID");
        SendDiag_Request_Verify_Negative_Response(DiagAnchor3,"19 0B","7F 19 12");
		TestStep("6","Send request 19 FF to request ReadDTCInformation SID");
        SendDiag_Request_Verify_Negative_Response(DiagAnchor3,"19 FF","7F 19 12");
  PostCondition_Anchor( );
}


testcase TCS_PK_FCA_AnchorUDSServer_ReadDTCInformation_NRC12_ExtendedSession_NoSecurityLevel_20705()
{
  PreCondition_Anchor("TCS_PK_FCA_AnchorUDSServer_ReadDTCInformation_NRC12_ExtendedSession_NoSecurityLevel_20705");
  testCaseComment("Actions");
  TestStep("1","Send request 10 03 to enter Extended Diagnostic Session");
	SendDiag_Request_Verify_Response(DiagAnchor3,"10 03","50 03 00 32 01 F4");
  TestStep("2","Send request 19 00 to request ReadDTCInformation SID");
        SendDiag_Request_Verify_Negative_Response(DiagAnchor3,"19 00","7F 19 12");
		TestStep("3","Send request 19 01 to request ReadDTCInformation SID");
        SendDiag_Request_Verify_Negative_Response(DiagAnchor3,"19 05","7F 19 12");
		TestStep("4","Send request 19 07 to request ReadDTCInformation SID");
        SendDiag_Request_Verify_Negative_Response(DiagAnchor3,"19 07","7F 19 12");
		TestStep("5","Send request 19 09 to request ReadDTCInformation SID");
        SendDiag_Request_Verify_Negative_Response(DiagAnchor3,"19 09","7F 19 12");
		TestStep("6","Send request 19 0B to request ReadDTCInformation SID");
        SendDiag_Request_Verify_Negative_Response(DiagAnchor3,"19 0B","7F 19 12");
		TestStep("7","Send request 19 FF to request ReadDTCInformation SID");
        SendDiag_Request_Verify_Negative_Response(DiagAnchor3,"19 FF","7F 19 12");
  PostCondition_Anchor( );
}


testcase TCS_PK_FCA_AnchorUDSServer_ReadDTCInformation_NRC13_MessageFormatOfSFID0x02Check_DefaultSession_20718()
{
  PreCondition_Anchor("TCS_PK_FCA_AnchorUDSServer_ReadDTCInformation_NRC13_MessageFormatOfSFID0x02Check_DefaultSession_20718");
  testCaseComment("Actions");
  TestStep("1","Send request 19 02 to request ReadDTCInformation SID");
        SendDiag_Request_Verify_Negative_Response(DiagAnchor3,"19 02","7F 19 13");
		TestStep("2","Send request 19 02 FF 00 to request ReadDTCInformation SID");
        SendDiag_Request_Verify_Negative_Response(DiagAnchor3,"19 02 FF 00","7F 19 13");
		PostCondition_Anchor( );
}


testcase TCS_PK_FCA_AnchorUDSServer_ReadDTCInformation_NRC13_MessageFormatOfSFID0x02Check_ExtendedSession_NoSecurityLevel_20722()
{
  PreCondition_Anchor("TCS_PK_FCA_AnchorUDSServer_ReadDTCInformation_NRC13_MessageFormatOfSFID0x02Check_ExtendedSession_NoSecurityLevel_20722");
  testCaseComment("Actions");
  TestStep("1","Send request 10 03 to enter Extended Diagnostic Session");
	SendDiag_Request_Verify_Response(DiagAnchor3,"10 03","50 03 00 32 01 F4");
  TestStep("2","Send request 19 02 to request ReadDTCInformation SID");
        SendDiag_Request_Verify_Negative_Response(DiagAnchor3,"19 02","7F 19 13");
		TestStep("3","Send request 19 02 FF 00 to request ReadDTCInformation SID");
        SendDiag_Request_Verify_Negative_Response(DiagAnchor3,"19 02 FF 00","7F 19 13");
		PostCondition_Anchor( );
}


testcase TCS_PK_FCA_AnchorUDSServer_ReadDTCInformation_NRC13_MessageFormatOfSFID0x06Check_DefaultSession_20735()
{
  PreCondition_Anchor("TCS_PK_FCA_AnchorUDSServer_ReadDTCInformation_NRC13_MessageFormatOfSFID0x06Check_DefaultSession_20735");
  testCaseComment("Actions");
  TestStep("1","Send request 19 06 90 00 49 to request ReadDTCInformation SID");
        SendDiag_Request_Verify_Negative_Response(DiagAnchor3,"19 06 90 00 49","7F 19 13");
		TestStep("2","Send request 19 06 90 00 49 FF 00 to request ReadDTCInformation SID");
        SendDiag_Request_Verify_Negative_Response(DiagAnchor3,"19 06 90 00 49 FF 00","7F 19 13");
		PostCondition_Anchor( );
}


testcase TCS_PK_FCA_AnchorUDSServer_ReadDTCInformation_NRC13_MessageFormatOfSFID0x06Check_ExtendedSession_NoSecurityLevel_20747()
{
  PreCondition_Anchor("TCS_PK_FCA_AnchorUDSServer_ReadDTCInformation_NRC13_MessageFormatOfSFID0x06Check_ExtendedSession_NoSecurityLevel_20747");
  testCaseComment("Actions");
  TestStep("1","Send request 10 03 to enter Extended Diagnostic Session");
	SendDiag_Request_Verify_Response(DiagAnchor3,"10 03","50 03 00 32 01 F4");
  TestStep("2","Send request 19 06 90 00 49 to request ReadDTCInformation SID");
        SendDiag_Request_Verify_Negative_Response(DiagAnchor3,"19 06 90 00 49","7F 19 13");
		TestStep("3","Send request 19 06 90 00 49 FF 00 to request ReadDTCInformation SID");
        SendDiag_Request_Verify_Negative_Response(DiagAnchor3,"19 06 90 00 49 FF 00","7F 19 13");
		PostCondition_Anchor( );
}


testcase TCS_PK_FCA_AnchorUDSServer_ReadDTCInformation_NRC13_MessageFormatOfSFID0x0ACheck_DefaultSession_20759()
{
  PreCondition_Anchor("TCS_PK_FCA_AnchorUDSServer_ReadDTCInformation_NRC13_MessageFormatOfSFID0x0ACheck_DefaultSession_20759");
  testCaseComment("Actions");
  TestStep("1","Send request 19 0A 00 to request ReadDTCInformation SID");
        SendDiag_Request_Verify_Negative_Response(DiagAnchor3,"19 0A 00","7F 19 13");
		PostCondition_Anchor( );
}


testcase TCS_PK_FCA_AnchorUDSServer_ReadDTCInformation_NRC13_MessageFormatOfSFID0x0ACheck_ExtendedSession_NoSecurityLevel_20777()
{
  PreCondition_Anchor("TCS_PK_FCA_AnchorUDSServer_ReadDTCInformation_NRC13_MessageFormatOfSFID0x0ACheck_ExtendedSession_NoSecurityLevel_20777");
  testCaseComment("Actions");
  TestStep("1","Send request 10 03 to enter Extended Diagnostic Session");
	SendDiag_Request_Verify_Response(DiagAnchor3,"10 03","50 03 00 32 01 F4");
  TestStep("2","Send request 19 0A 00 to request ReadDTCInformation SID");
        SendDiag_Request_Verify_Negative_Response(DiagAnchor3,"19 0A 00","7F 19 13");
    PostCondition_Anchor( );
}


testcase TCS_PK_FCA_AnchorUDSServer_ReadDTCInformation_NRC13_ServiceCheck_DefaultSession_20789()
{
  PreCondition_Anchor("TCS_PK_FCA_AnchorUDSServer_ReadDTCInformation_NRC13_ServiceCheck_DefaultSession_20789");
  testCaseComment("Actions");
  TestStep("1","Send request 19 to request ReadDTCInformation SID");
        SendDiag_Request_Verify_Negative_Response(DiagAnchor3,"19","7F 19 13");
		PostCondition_Anchor( );
}


testcase TCS_PK_FCA_AnchorUDSServer_ReadDTCInformation_NRC13_ServiceCheck_ExtendedSession_NoSecurityLevel_20771()
{
  PreCondition_Anchor("TCS_PK_FCA_AnchorUDSServer_ReadDTCInformation_NRC13_ServiceCheck_ExtendedSession_NoSecurityLevel_20771");
  testCaseComment("Actions");
    TestStep("1","Send request 10 03 to enter Extended Diagnostic Session");
	SendDiag_Request_Verify_Response(DiagAnchor3,"10 03","50 03 00 32 01 F4");
  TestStep("2","Send request 19 to request ReadDTCInformation SID");
        SendDiag_Request_Verify_Negative_Response(DiagAnchor3,"19","7F 19 13");
		PostCondition_Anchor( );
}


testcase TCS_PK_FCA_AnchorUDSServer_ReadDTCInformation_NRC31_SFID0x06_DefaultSession_20814()
{
  PreCondition_Anchor("TCS_PK_FCA_AnchorUDSServer_ReadDTCInformation_NRC31_SFID0x06_DefaultSession_20814");
  testCaseComment("Actions");
  TestStep("1","Send request 19 06 00 00 00 FF to request ReadDTCInformation SID");
        SendDiag_Request_Verify_Negative_Response(DiagAnchor3,"19 06 00 00 00 FF","7F 19 31");
		PostCondition_Anchor( );
}


testcase TCS_PK_FCA_AnchorUDSServer_ReadDTCInformation_NRC31_SFID0x06_ExtendedSession_NoSecurityLevel_20808()
{
  PreCondition_Anchor("TCS_PK_FCA_AnchorUDSServer_ReadDTCInformation_NRC31_SFID0x06_ExtendedSession_NoSecurityLevel_20808");
  testCaseComment("Actions");
    TestStep("1","Send request 10 03 to enter Extended Diagnostic Session");
	SendDiag_Request_Verify_Response(DiagAnchor3,"10 03","50 03 00 32 01 F4");
  TestStep("2","Send request 19 06 00 00 00 FF to request ReadDTCInformation SID");
        SendDiag_Request_Verify_Negative_Response(DiagAnchor3,"19 06 00 00 00 FF","7F 19 31");
		PostCondition_Anchor( );
}


testcase TCS_PK_FCA_AnchorUDSServer_ReadDTCInformation_SFID0x02_DefaultSession_20819()
{
  PreCondition_Anchor("TCS_PK_FCA_AnchorUDSServer_ReadDTCInformation_SFID0x02_DefaultSession_20819");
  testCaseComment("Actions");
  TestStep("1","Send request 19 02 FF to request ReadDTCInformation SID");
        SendDiag_Request_Verify_Response(DiagAnchor3,"19 02 FF","59 02 31 90 00 49 00");
		PostCondition_Anchor( );
}


testcase TCS_PK_FCA_AnchorUDSServer_ReadDTCInformation_SFID0x02_ExtendedSession_0x61SecurityLevel_20833()
{
  PreCondition_Anchor("TCS_PK_FCA_AnchorUDSServer_ReadDTCInformation_SFID0x02_ExtendedSession_0x61SecurityLevel_20833");
  testCaseComment("Actions");
    TestStep("1","Send request 10 03 to enter Extended Diagnostic Session");
	SendDiag_Request_Verify_Response(DiagAnchor3,"10 03","50 03 00 32 01 F4");
	TestStep("2,3","Send Security Seed Request 61 and Key 62 in DiagAnchor");   
       	Security_Seed_Key_Access(Anch3,Physical,Bosch);
  TestStep("4","Send request 19 02 FF to request ReadDTCInformation SID");
        SendDiag_Request_Verify_Response(DiagAnchor3,"19 02 FF","59 02 31 90 00 49 00");
		PostCondition_Anchor( );
}


testcase TCS_PK_FCA_AnchorUDSServer_ReadDTCInformation_SFID0x02_ExtendedSession_0x65SecurityLevel_20840()
{
  PreCondition_Anchor("TCS_PK_FCA_AnchorUDSServer_ReadDTCInformation_SFID0x02_ExtendedSession_0x65SecurityLevel_20840");
  testCaseComment("Actions");
    TestStep("1","Send request 10 03 to enter Extended Diagnostic Session");
	SendDiag_Request_Verify_Response(DiagAnchor3,"10 03","50 03 00 32 01 F4");
	TestStep("2,3","Send Security Seed Request 65 and Key 66 in DiagAnchor");   
       	Security_Seed_Key_Access(Anch3,Physical,Incar_1);
  TestStep("4","Send request 19 02 FF to request ReadDTCInformation SID");
        SendDiag_Request_Verify_Response(DiagAnchor3,"19 02 FF","59 02 31 90 00 49 00");
		PostCondition_Anchor( );
}


testcase TCS_PK_FCA_AnchorUDSServer_ReadDTCInformation_SFID0x02_ExtendedSession_NoSecurityLevel_20851()
{
  PreCondition_Anchor("TCS_PK_FCA_AnchorUDSServer_ReadDTCInformation_SFID0x02_ExtendedSession_NoSecurityLevel_20851");
  testCaseComment("Actions");
    TestStep("1","Send request 10 03 to enter Extended Diagnostic Session");
	SendDiag_Request_Verify_Response(DiagAnchor3,"10 03","50 03 00 32 01 F4");
  TestStep("2","Send request 19 02 FF to request ReadDTCInformation SID");
        SendDiag_Request_Verify_Response(DiagAnchor3,"19 02 FF","59 02 31 90 00 49 00");
		PostCondition_Anchor( );
}


testcase TCS_PK_FCA_AnchorUDSServer_ReadDTCInformation_SFID0x06_DTC0x900049_DefaultSession_20858()
{
  PreCondition_Anchor("TCS_PK_FCA_AnchorUDSServer_ReadDTCInformation_SFID0x06_DTC0x900049_DefaultSession_20858");
  testCaseComment("Actions");
  TestStep("1","Send request 19 06 90 00 49 FF to request ReadDTCInformation SID");
        SendDiag_Request_Verify_Response(DiagAnchor3,"19 06 90 00 49 FF","59 06 90 00 49 00");
		PostCondition_Anchor( );
}


testcase TCS_PK_FCA_AnchorUDSServer_ReadDTCInformation_SFID0x06_DTC0x900049_ExtendedSession_0x61SecurityLevel_20865()
{
  PreCondition_Anchor("TCS_PK_FCA_AnchorUDSServer_ReadDTCInformation_SFID0x06_DTC0x900049_ExtendedSession_0x61SecurityLevel_20865");
  testCaseComment("Actions");
    TestStep("1","Send request 10 03 to enter Extended Diagnostic Session");
	SendDiag_Request_Verify_Response(DiagAnchor3,"10 03","50 03 00 32 01 F4");
	TestStep("2,3","Send Security Seed Request 61 and Key 62 in DiagAnchor");   
       	Security_Seed_Key_Access(Anch3,Physical,Bosch);
  TestStep("4","Send request 19 06 90 00 49 FF to request ReadDTCInformation SID");
        SendDiag_Request_Verify_Response(DiagAnchor3,"19 06 90 00 49 FF","59 06 90 00 49 00");
		PostCondition_Anchor( );
}


testcase TCS_PK_FCA_AnchorUDSServer_ReadDTCInformation_SFID0x06_DTC0x900049_ExtendedSession_0x65SecurityLevel_20846()
{
  PreCondition_Anchor("TCS_PK_FCA_AnchorUDSServer_ReadDTCInformation_SFID0x06_DTC0x900049_ExtendedSession_0x65SecurityLevel_20846");
  testCaseComment("Actions");
    TestStep("1","Send request 10 03 to enter Extended Diagnostic Session");
	SendDiag_Request_Verify_Response(DiagAnchor3,"10 03","50 03 00 32 01 F4");
	TestStep("2,3","Send Security Seed Request 65 and Key 66 in DiagAnchor");   
       	Security_Seed_Key_Access(Anch3,Physical,Incar_1);
  TestStep("4","Send request 19 06 90 00 49 FF to request ReadDTCInformation SID");
        SendDiag_Request_Verify_Response(DiagAnchor3,"19 06 90 00 49 FF","59 06 90 00 49 00");
		PostCondition_Anchor( );
}


testcase TCS_PK_FCA_AnchorUDSServer_ReadDTCInformation_SFID0x06_DTC0x900049_ExtendedSession_NoSecurityLevel_20877()
{
  PreCondition_Anchor("TCS_PK_FCA_AnchorUDSServer_ReadDTCInformation_SFID0x06_DTC0x900049_ExtendedSession_NoSecurityLevel_20877");
  testCaseComment("Actions");
    TestStep("1","Send request 10 03 to enter Extended Diagnostic Session");
	SendDiag_Request_Verify_Response(DiagAnchor3,"10 03","50 03 00 32 01 F4");
  TestStep("2","Send request 19 06 90 00 49 FF to request ReadDTCInformation SID");
        SendDiag_Request_Verify_Response(DiagAnchor3,"19 06 90 00 49 FF","59 06 90 00 49 00");
		PostCondition_Anchor( );
}


testcase TCS_PK_FCA_AnchorUDSServer_ReadDTCInformation_SFID0x0A_DefaultSession_20883()
{
  PreCondition_Anchor("TCS_PK_FCA_AnchorUDSServer_ReadDTCInformation_SFID0x0A_DefaultSession_20883");
  testCaseComment("Actions");
    TestStep("1","Send request 10 01 to enter Default Diagnostic Session");
	SendDiag_Request_Verify_Response(DiagAnchor3,"10 01","50 01 00 32 01 F4");
  TestStep("2","Send request 19 0A to request ReadDTCInformation SID");
        SendDiag_Request_Verify_Response(DiagAnchor3,"19 0A","59 0A 31 90 00 49 00");
		PostCondition_Anchor( );
}


testcase TCS_PK_FCA_AnchorUDSServer_ReadDTCInformation_SFID0x0A_ExtendedSession_0x61SecurityLevel_20889()
{
  PreCondition_Anchor("TCS_PK_FCA_AnchorUDSServer_ReadDTCInformation_SFID0x0A_ExtendedSession_0x61SecurityLevel_20889");
  testCaseComment("Actions");
    TestStep("1","Send request 10 03 to enter Extended Diagnostic Session");
	SendDiag_Request_Verify_Response(DiagAnchor3,"10 03","50 03 00 32 01 F4");
	TestStep("2,3","Send Security Seed Request 61 and Key 62 in DiagAnchor");   
       	Security_Seed_Key_Access(Anch3,Physical,Bosch);
  TestStep("4","Send request 19 0A to request ReadDTCInformation SID");
        SendDiag_Request_Verify_Response(DiagAnchor3,"19 0A","59 0A 31 90 00 49 00");
		PostCondition_Anchor( );
}


testcase TCS_PK_FCA_AnchorUDSServer_ReadDTCInformation_SFID0x0A_ExtendedSession_0x65SecurityLevel_20901()
{
  PreCondition_Anchor("TCS_PK_FCA_AnchorUDSServer_ReadDTCInformation_SFID0x0A_ExtendedSession_0x65SecurityLevel_20901");
  testCaseComment("Actions");
    TestStep("1","Send request 10 03 to enter Extended Diagnostic Session");
	SendDiag_Request_Verify_Response(DiagAnchor3,"10 03","50 03 00 32 01 F4");
	TestStep("2,3","Send Security Seed Request 65 and Key 66 in DiagAnchor");   
       	Security_Seed_Key_Access(Anch3,Physical,Incar_1);
  TestStep("4","Send request 19 0A to request ReadDTCInformation SID");
        SendDiag_Request_Verify_Response(DiagAnchor3,"19 0A","59 0A 31 90 00 49 00");
		PostCondition_Anchor( );
}


testcase TCS_PK_FCA_AnchorUDSServer_ReadDTCInformation_SFID0x0A_ExtendedSession_NoSecurityLevel_20907()
{
  PreCondition_Anchor("TCS_PK_FCA_AnchorUDSServer_ReadDTCInformation_SFID0x0A_ExtendedSession_NoSecurityLevel_20907");
  testCaseComment("Actions");
    TestStep("1","Send request 10 03 to enter Extended Diagnostic Session");
	SendDiag_Request_Verify_Response(DiagAnchor3,"10 03","50 03 00 32 01 F4");
  TestStep("2","Send request 19 0A to request ReadDTCInformation SID");
        SendDiag_Request_Verify_Response(DiagAnchor3,"19 0A","59 0A 31 90 00 49 00");
		PostCondition_Anchor( );
}




//////////////////////RequestDownload_NRCs/////////////////////////////

testcase TCS_PK_FCA_AnchorUDSServer_RequestDownload_NRC11_DefaultSession_48653()
{
  PreCondition_Anchor("TCS_PK_FCA_AnchorUDSServer_RequestDownload_NRC11_DefaultSession_48653");
  testCaseComment("Actions");
  TestStep("1","Send request 10 01 to enter Default Diagnostic Session");
	SendDiag_Request_Verify_Response(DiagAnchor3,"10 01","50 01 00 32 01 F4");
  TestStep("2","Send request 34 00 14 00 00 00 00 EE to Request Download services");
	SendDiag_Request_Verify_Negative_Response(DiagAnchor3,"34 00 14 00 00 00 00 EE","7F 34 11");
  PostCondition_Anchor( );
  }
  
testcase TCS_PK_FCA_AnchorUDSServer_RequestDownload_NRC11_ExtendedSession_NoSecurityLevel_37245()
{
  PreCondition_Anchor("TCS_PK_FCA_AnchorUDSServer_RequestDownload_NRC11_ExtendedSession_NoSecurityLevel_37245");
  testCaseComment("Actions");
  TestStep("1","Send request 10 03 to enter Extended Diagnostic Session");
	SendDiag_Request_Verify_Response(DiagAnchor3,"10 03","50 03 00 32 01 F4");
  TestStep("2","Send request 34 00 14 00 00 00 00 EE to Request Download services");
	SendDiag_Request_Verify_Negative_Response(DiagAnchor3,"34 00 14 00 00 00 00 EE","7F 34 11");
  PostCondition_Anchor( );
  }

testcase TCS_PK_FCA_AnchorUDSServer_RequestDownload_NRC13_ProgrammingSession_0x61SecurityLevel_37390()
 {
   PreCondition_Anchor("TCS_PK_FCA_AnchorUDSServer_RequestDownload_NRC13_ProgrammingSession_0x61SecurityLevel_37390");
   testCaseComment("Actions");
  testWaitForTimeout(1000);
   TestStep("1","Send request 10 03 to enter Extended Diagnostic Session");
	SendDiag_Request_Verify_Response(DiagAnchor3,"10 03","50 03 00 32 01 F4");
  testWaitForTimeout(1000);
   TestStep("2,3","Send security unlock request 61 and 62");   
       	Security_Seed_Key_Access(Anch3,Physical,Bosch);
   TestStep("4","Send request 10 02 to enter Programming Diagnostic Session");
	SendDiag_Request_Verify_Response(DiagAnchor3,"10 02","50 02 00 32 01 F4");	
   TestStep("5","Send request 34 00 14 00 00 00 00 EE to Request Download services");
	SendDiag_Request_Verify_Negative_Response(DiagAnchor3,"34","7F 34 13");
   TestStep("6","Send request 11 01 to ECU Reset");
	SendDiag_Request_Verify_Response(DiagAnchor3,"11 01","51 01");
  testWaitForTimeout(1000);
  PostCondition_Anchor( );
  }	

testcase TCS_PK_FCA_AnchorUDSServer_RequestDownload_NRC22_ProgrammingSession_0x61SecurityLevel_37220()
{
  PreCondition_Anchor("TCS_PK_FCA_AnchorUDSServer_RequestDownload_NRC22_ProgrammingSession_0x61SecurityLevel_37220");
  testCaseComment("Actions");
  testWaitForTimeout(1000);
  TestStep("1","Send request 10 03 to enter Extended Diagnostic Session");
	SendDiag_Request_Verify_Response(DiagAnchor3,"10 03","50 03 00 32 01 F4");
  testWaitForTimeout(1000);
  TestStep("2,3","Send security unlock request 61 and 62");   
       	Security_Seed_Key_Access(Anch3,Physical,Bosch);
  TestStep("4","Send request 10 02 to enter Programming Diagnostic Session");
	SendDiag_Request_Verify_Response(DiagAnchor3,"10 02","50 02 00 32 01 F4");	
  TestStep("5","Send request 34 00 14 00 00 00 00 EE to Request Download services");
	SendDiag_Request_Verify_Response(DiagAnchor3,"34 00 14 00 00 00 00 EE","74 20 00 F2");
  TestStep("6","Send request 36 01 11 11 11 11 11 11 11 11 11 11 11 11 11 11 11 11 11 11 11 11 11 11 11 11 11 11 11 11 11 11 11 11 11 11 11 11 11 11 11 11 11 11 11 11 11 11 11 11 11 11 11 11 11 11 11 11 11 11 11 11 11 11 11 11 11 11 11 11 11 11 11 11 11 11 11 11 11 11 11 11 11 11 11 11 11 11 11 11 11 11 11 11 11 11 11 11 11 11 11 11 11 11 11 11 11 11 11 11 11 11 11 11 11 11 11 11 11 11 11 11 11 11 11 11 11 11 11 11 11 11 11 11 11 11 11 11 11 11 11 11 11 11 11 11 11 11 11 11 11 11 11 11 11 11 11 11 11 11 11 11 11 11 11 11 11 11 11 11 11 11 11 11 11 11 11 11 11 11 11 11 11 11 11 11 11 11 11 11 11 11 11 11 11 11 11 11 11 11 11 11 11 11 11 11 11 11 11 11 11 11 11 11 11 11 11 11 11 11 11 11 11 11 11 11 11 11 11 11 11 11 11 11 11 11 11 11 11 11 to enter Transfer Data services");
SendDiag_Request_Verify_Response(DiagAnchor3,"36 01 11 11 11 11 11 11 11 11 11 11 11 11 11 11 11 11 11 11 11 11 11 11 11 11 11 11 11 11 11 11 11 11 11 11 11 11 11 11 11 11 11 11 11 11 11 11 11 11 11 11 11 11 11 11 11 11 11 11 11 11 11 11 11 11 11 11 11 11 11 11 11 11 11 11 11 11 11 11 11 11 11 11 11 11 11 11 11 11 11 11 11 11 11 11 11 11 11 11 11 11 11 11 11 11 11 11 11 11 11 11 11 11 11 11 11 11 11 11 11 11 11 11 11 11 11 11 11 11 11 11 11 11 11 11 11 11 11 11 11 11 11 11 11 11 11 11 11 11 11 11 11 11 11 11 11 11 11 11 11 11 11 11 11 11 11 11 11 11 11 11 11 11 11 11 11 11 11 11 11 11 11 11 11 11 11 11 11 11 11 11 11 11 11 11 11 11 11 11 11 11 11 11 11 11 11 11 11 11 11 11 11 11 11 11 11 11 11 11 11 11 11 11 11 11 11 11 11 11 11 11 11 11 11 11 11 11 11 11","76 01");	
  TestStep("7","Send request 34 00 14 00 00 00 00 EE to Request Download services");
	SendDiag_Request_Verify_Negative_Response(DiagAnchor3,"34 00 14 00 00 00 00 EE","7F 34 22");	
  TestStep("8","Send request 11 01 to ECU Reset");
	SendDiag_Request_Verify_Response(DiagAnchor3,"11 01","51 01");
  testWaitForTimeout(1000);
  PostCondition_Anchor( );
  }	
  
testcase TCS_PK_FCA_AnchorUDSServer_RequestDownload_NRC31_ProgrammingSession_0x61SecurityLevel_37226()
{
  PreCondition_Anchor("TCS_PK_FCA_AnchorUDSServer_RequestDownload_NRC31_ProgrammingSession_0x61SecurityLevel_37226");
  testCaseComment("Actions"); 
  testWaitForTimeout(1000);
  TestStep("1","Send request 10 03 to enter Extended Diagnostic Session");
	SendDiag_Request_Verify_Response(DiagAnchor3,"10 03","50 03 00 32 01 F4");
  testWaitForTimeout(1000);
  TestStep("2,3","Send security unlock request 61 and 62");   
       	Security_Seed_Key_Access(Anch3,Physical,Bosch);
  TestStep("4","Send request 10 02 to enter Programming Diagnostic Session");
	SendDiag_Request_Verify_Response(DiagAnchor3,"10 02","50 02 00 32 01 F4");	
  TestStep("5","Send request 34 00 14 00 00 00 00 EE to Request Download services");
	SendDiag_Request_Verify_Negative_Response(DiagAnchor3,"34 00 14 00 00 00 00 EE","7F 34 31");
  TestStep("6","Send request 11 01 to ECU Reset");
	SendDiag_Request_Verify_Response(DiagAnchor3,"11 01","51 01");
  testWaitForTimeout(1000);
  PostCondition_Anchor( );
  }

testcase TCS_PK_FCA_AnchorUDSServer_RequestDownload_NRC33_ProgrammingSession_NoSecurityLevel_37196()
{
  PreCondition_Anchor("TCS_PK_FCA_AnchorUDSServer_RequestDownload_NRC33_ProgrammingSession_NoSecurityLevel_37196");
  testCaseComment("Actions");
  testWaitForTimeout(1000);
  TestStep("1","Send request 10 03 to enter Extended Diagnostic Session");
	SendDiag_Request_Verify_Response(DiagAnchor3,"10 03","50 03 00 32 01 F4");
  testWaitForTimeout(1000);
  TestStep("2,3","Send security unlock request 61 and 62");   
       	Security_Seed_Key_Access(Anch3,Physical,Bosch);
  TestStep("4","Send request 10 02 to enter Programming Diagnostic Session");
	SendDiag_Request_Verify_Response(DiagAnchor3,"10 02","50 02 00 32 01 F4");
  TestStep("5","Send request 10 02 to enter Programming Diagnostic Session");
	SendDiag_Request_Verify_Response(DiagAnchor3,"10 02","50 02 00 32 01 F4");
  TestStep("6","Send request 34 00 14 00 00 00 00 EE to Request Download services");
	SendDiag_Request_Verify_Negative_Response(DiagAnchor3,"34 00 14 00 00 00 00 EE","7F 34 33");
  TestStep("7","Send request 11 01 to ECU Reset");
	SendDiag_Request_Verify_Response(DiagAnchor3,"11 01","51 01");
  testWaitForTimeout(1000);
  PostCondition_Anchor( );
  }

testcase TCS_PK_FCA_AnchorUDSServer_RequestDownload_NRC7F_DefaultSession_37294()
{
  PreCondition_Anchor("TCS_PK_FCA_AnchorUDSServer_RequestDownload_NRC7F_DefaultSession_37294");
  testCaseComment("Actions");
  testWaitForTimeout(1000);
  TestStep("1","Send request 10 03 to enter Extended Diagnostic Session");
	SendDiag_Request_Verify_Response(DiagAnchor3,"10 03","50 03 00 32 01 F4");
  testWaitForTimeout(1000);
  TestStep("2,3","Send security unlock request 61 and 62");   
       	Security_Seed_Key_Access(Anch3,Physical,Bosch);
  TestStep("4","Send request 10 02 to enter Programming Diagnostic Session");
	SendDiag_Request_Verify_Response(DiagAnchor3,"10 02","50 02 00 32 01 F4");	
  TestStep("5","Send request 34 00 14 00 00 00 00 EE to Request Download services");
	SendDiag_Request_Verify_Negative_Response(DiagAnchor3,"34 00 14 00 00 00 00 EE","74 20 00 F2");
  TestStep("6","Send request 10 01 to enter Default Diagnostic Session");
	SendDiag_Request_Verify_Response(DiagAnchor3,"10 01","50 01 00 32 01 F4");
  TestStep("7","Send request 34 00 14 00 00 00 00 EE to Request Download services");
	SendDiag_Request_Verify_Negative_Response(DiagAnchor3,"34 00 14 00 00 00 00 EE","7F 34 7F");
  PostCondition_Anchor( );
  }
	
testcase TCS_PK_FCA_AnchorUDSServer_RequestDownload_NRC7F_ExtendedSession_NoSecurityLevel_37330()
{
  PreCondition_Anchor("TCS_PK_FCA_AnchorUDSServer_RequestDownload_NRC7F_ExtendedSession_NoSecurityLevel_37330");
  testCaseComment("Actions");
  testWaitForTimeout(1000);
  TestStep("1","Send request 10 03 to enter Extended Diagnostic Session");
	SendDiag_Request_Verify_Response(DiagAnchor3,"10 03","50 03 00 32 01 F4");
  testWaitForTimeout(1000);
  TestStep("2,3","Send security unlock request 61 and 62");   
       	Security_Seed_Key_Access(Anch3,Physical,Bosch);
  TestStep("4","Send request 10 02 to enter Programming Diagnostic Session");
	SendDiag_Request_Verify_Response(DiagAnchor3,"10 02","50 02 00 32 01 F4");	
  TestStep("5","Send request 34 00 14 00 00 00 00 EE to Request Download services");
	SendDiag_Request_Verify_Response(DiagAnchor3,"34 00 14 00 00 00 00 EE","74 20 00 F2");
  TestStep("6","Send request 10 01 to enter Default Diagnostic Session");
	SendDiag_Request_Verify_Response(DiagAnchor3,"10 01","50 01 00 32 01 F4");
  TestStep("7","Send request 10 03 to enter Extended Diagnostic Session");
	SendDiag_Request_Verify_Response(DiagAnchor3,"10 03","50 03 00 32 01 F4");
  TestStep("8","Send request 34 00 14 00 00 00 00 EE to Request Download services");
	SendDiag_Request_Verify_Negative_Response(DiagAnchor3,"34 00 14 00 00 00 00 EE","7F 34 7F");
  PostCondition_Anchor( );
  }



   ////////////////////////////TransferData_NRCs////////////////////////

testcase TCS_PK_FCA_AnchorUDSServer_TransferData_NRC11_DefaultSession_31268()
{
  PreCondition_Anchor("TCS_PK_FCA_AnchorUDSServer_TransferData_NRC11_DefaultSession_31268");
  testCaseComment("Actions");
  TestStep("1","Send request 10 01 to enter Default Diagnostic Session");
	SendDiag_Request_Verify_Response(DiagAnchor3,"10 01","50 01 00 32 01 F4");
  testWaitForTimeout(1000);
  TestStep("2","Send request 36 01 11 11 11 11 11 11 11 11 11 11 11 11 11 11 11 11 11 11 11 11 11 11 11 11 11 11 11 11 11 11 11 11 11 11 11 11 11 11 11 11 11 11 11 11 11 11 11 11 11 11 11 11 11 11 11 11 11 11 11 11 11 11 11 11 11 11 11 11 11 11 11 11 11 11 11 11 11 11 11 11 11 11 11 11 11 11 11 11 11 11 11 11 11 11 11 11 11 11 11 11 11 11 11 11 11 11 11 11 11 11 11 11 11 11 11 11 11 11 11 11 11 11 11 11 11 11 11 11 11 11 11 11 11 11 11 11 11 11 11 11 11 11 11 11 11 11 11 11 11 11 11 11 11 11 11 11 11 11 11 11 11 11 11 11 11 11 11 11 11 11 11 11 11 11 11 11 11 11 11 11 11 11 11 11 11 11 11 11 11 11 11 11 11 11 11 11 11 11 11 11 11 11 11 11 11 11 11 11 11 11 11 11 11 11 11 11 11 11 11 11 11 11 11 11 11 11 11 11 11 11 11 11 11 11 11 11 11 11 to enter Transfer Data services");
	SendDiag_Request_Verify_Negative_Response(DiagAnchor3,"36 01 11 11 11 11 11 11 11 11 11 11 11 11 11 11 11 11 11 11 11 11 11 11 11 11 11 11 11 11 11 11 11 11 11 11 11 11 11 11 11 11 11 11 11 11 11 11 11 11 11 11 11 11 11 11 11 11 11 11 11 11 11 11 11 11 11 11 11 11 11 11 11 11 11 11 11 11 11 11 11 11 11 11 11 11 11 11 11 11 11 11 11 11 11 11 11 11 11 11 11 11 11 11 11 11 11 11 11 11 11 11 11 11 11 11 11 11 11 11 11 11 11 11 11 11 11 11 11 11 11 11 11 11 11 11 11 11 11 11 11 11 11 11 11 11 11 11 11 11 11 11 11 11 11 11 11 11 11 11 11 11 11 11 11 11 11 11 11 11 11 11 11 11 11 11 11 11 11 11 11 11 11 11 11 11 11 11 11 11 11 11 11 11 11 11 11 11 11 11 11 11 11 11 11 11 11 11 11 11 11 11 11 11 11 11 11 11 11 11 11 11 11 11 11 11 11 11 11 11 11 11 11 11 11 11 11 11 11 11","7F 36 11");
  TestStep("3","Send request 11 01 to ECU Reset");
	SendDiag_Request_Verify_Response(DiagAnchor3,"11 01","51 01");
  testWaitForTimeout(1000);
  PostCondition_Anchor( );
  }	
  
testcase TCS_PK_FCA_AnchorUDSServer_TransferData_NRC11_ExtendedSession_NoSecurityLevel_31243()
{
  PreCondition_Anchor("TCS_PK_FCA_AnchorUDSServer_TransferData_NRC11_ExtendedSession_NoSecurityLevel_31243");
  testCaseComment("Actions");
  testWaitForTimeout(1000);
  TestStep("1","Send request 10 03 to enter Extended Diagnostic Session");
	SendDiag_Request_Verify_Response(DiagAnchor3,"10 03","50 03 00 32 01 F4");
  testWaitForTimeout(1000);
  TestStep("2","Send request 36 01 11 11 11 11 11 11 11 11 11 11 11 11 11 11 11 11 11 11 11 11 11 11 11 11 11 11 11 11 11 11 11 11 11 11 11 11 11 11 11 11 11 11 11 11 11 11 11 11 11 11 11 11 11 11 11 11 11 11 11 11 11 11 11 11 11 11 11 11 11 11 11 11 11 11 11 11 11 11 11 11 11 11 11 11 11 11 11 11 11 11 11 11 11 11 11 11 11 11 11 11 11 11 11 11 11 11 11 11 11 11 11 11 11 11 11 11 11 11 11 11 11 11 11 11 11 11 11 11 11 11 11 11 11 11 11 11 11 11 11 11 11 11 11 11 11 11 11 11 11 11 11 11 11 11 11 11 11 11 11 11 11 11 11 11 11 11 11 11 11 11 11 11 11 11 11 11 11 11 11 11 11 11 11 11 11 11 11 11 11 11 11 11 11 11 11 11 11 11 11 11 11 11 11 11 11 11 11 11 11 11 11 11 11 11 11 11 11 11 11 11 11 11 11 11 11 11 11 11 11 11 11 11 11 11 11 11 11 11 to enter Transfer Data services");
	SendDiag_Request_Verify_Negative_Response(DiagAnchor3,"36 01 11 11 11 11 11 11 11 11 11 11 11 11 11 11 11 11 11 11 11 11 11 11 11 11 11 11 11 11 11 11 11 11 11 11 11 11 11 11 11 11 11 11 11 11 11 11 11 11 11 11 11 11 11 11 11 11 11 11 11 11 11 11 11 11 11 11 11 11 11 11 11 11 11 11 11 11 11 11 11 11 11 11 11 11 11 11 11 11 11 11 11 11 11 11 11 11 11 11 11 11 11 11 11 11 11 11 11 11 11 11 11 11 11 11 11 11 11 11 11 11 11 11 11 11 11 11 11 11 11 11 11 11 11 11 11 11 11 11 11 11 11 11 11 11 11 11 11 11 11 11 11 11 11 11 11 11 11 11 11 11 11 11 11 11 11 11 11 11 11 11 11 11 11 11 11 11 11 11 11 11 11 11 11 11 11 11 11 11 11 11 11 11 11 11 11 11 11 11 11 11 11 11 11 11 11 11 11 11 11 11 11 11 11 11 11 11 11 11 11 11 11 11 11 11 11 11 11 11 11 11 11 11 11 11 11 11 11 11","7F 36 11");
  TestStep("3","Send request 11 01 to ECU Reset");
	SendDiag_Request_Verify_Response(DiagAnchor3,"11 01","51 01");
  testWaitForTimeout(1000);
  PostCondition_Anchor( );
  }	

testcase TCS_PK_FCA_AnchorUDSServer_TransferData_NRC13_ProgrammingSession_0x61SecurityLevel_31250()
{
  PreCondition_Anchor("TCS_PK_FCA_AnchorUDSServer_TransferData_NRC13_ProgrammingSession_0x61SecurityLevel_31250");
  testCaseComment("Actions");
  testWaitForTimeout(1000);
  TestStep("1","Send request 10 03 to enter Extended Diagnostic Session");
	SendDiag_Request_Verify_Response(DiagAnchor3,"10 03","50 03 00 32 01 F4");
  testWaitForTimeout(1000);
  TestStep("2,3","Send security unlock request 61 and 62");   
       	Security_Seed_Key_Access(Anch3,Physical,Bosch);
  TestStep("4","Send request 10 02 to enter Programming Diagnostic Session");
	SendDiag_Request_Verify_Response(DiagAnchor3,"10 02","50 02 00 32 01 F4");
  TestStep("5,6","Send security unlock request 61 and 62");   
       	Security_Seed_Key_Access(Anch3,Physical,Bosch);
  testWaitForTimeout(1000);
  TestStep("7","Send request 34 00 14 00 00 00 00 EE to Request Download services");
	SendDiag_Request_Verify_Response(DiagAnchor3,"34 00 14 00 00 00 00 EE","74 20 00 F2");
  testWaitForTimeout(1000);
  TestStep("8","Send request 36 01 11 11 11 11 11 11 11 11 11 11 11 11 11 11 11 11 11 11 11 11 11 11 11 11 11 11 11 11 11 11 11 11 11 11 11 11 11 11 11 11 11 11 11 11 11 11 11 11 11 11 11 11 11 11 11 11 11 11 11 11 11 11 11 11 11 11 11 11 11 11 11 11 11 11 11 11 11 11 11 11 11 11 11 11 11 11 11 11 11 11 11 11 11 11 11 11 11 11 11 11 11 11 11 11 11 11 11 11 11 11 11 11 11 11 11 11 11 11 11 11 11 11 11 11 11 11 11 11 11 11 11 11 11 11 11 11 11 11 11 11 11 11 11 11 11 11 11 11 11 11 11 11 11 11 11 11 11 11 11 11 11 11 11 11 11 11 11 11 11 11 11 11 11 11 11 11 11 11 11 11 11 11 11 11 11 11 11 11 11 11 11 11 11 11 11 11 11 11 11 11 11 11 11 11 11 11 11 11 11 11 11 11 11 11 11 11 11 11 11 11 11 11 11 11 11 11 11 11 11 11 11 11 11 11 11 11 11 11 to enter Transfer Data services");
	SendDiag_Request_Verify_Negative_Response(DiagAnchor3,"36 01 11 11 11 11 11 11 11 11 11 11 11 11 11 11 11 11 11 11 11 11 11 11 11 11 11 11 11 11 11 11 11 11 11 11 11 11 11 11 11 11 11 11 11 11 11 11 11 11 11 11 11 11 11 11 11 11 11 11 11 11 11 11 11 11 11 11 11 11 11 11 11 11 11 11 11 11 11 11 11 11 11 11 11 11 11 11 11 11 11 11 11 11 11 11 11 11 11 11 11 11 11 11 11 11 11 11 11 11 11 11 11 11 11 11 11 11 11 11 11 11 11 11 11 11 11 11 11 11 11 11 11 11 11 11 11 11 11 11 11 11 11 11 11 11 11 11 11 11 11 11 11 11 11 11 11 11 11 11 11 11 11 11 11 11 11 11 11 11 11 11 11 11 11 11 11 11 11 11 11 11 11 11 11 11 11 11 11 11 11 11 11 11 11 11 11 11 11 11 11 11 11 11 11 11 11 11 11 11 11 11 11 11 11 11 11 11 11 11 11 11 11 11 11 11 11 11 11 11 11 11 11 11 11 11 11 11 11 11","7F 36 13");
  testWaitForTimeout(1000);
  PostCondition_Anchor( );
  }	
  
testcase TCS_PK_FCA_AnchorUDSServer_TransferData_NRC24_ProgrammingSession_0x61SecurityLevel_31323()
{
  PreCondition_Anchor("TCS_PK_FCA_AnchorUDSServer_TransferData_NRC24_ProgrammingSession_0x61SecurityLevel_31323");
  testCaseComment("Actions");
  testWaitForTimeout(1000);
  TestStep("1","Send request 10 03 to enter Extended Diagnostic Session");
	SendDiag_Request_Verify_Response(DiagAnchor3,"10 03","50 03 00 32 01 F4");
  testWaitForTimeout(1000);
  TestStep("2,3","Send security unlock request 61 and 62");   
       	Security_Seed_Key_Access(Anch3,Physical,Bosch);
  TestStep("4","Send request 10 02 to enter Programming Diagnostic Session");
	SendDiag_Request_Verify_Response(DiagAnchor3,"10 02","50 02 00 32 01 F4");
  TestStep("5,6","Send security unlock request 61 and 62");   
       	Security_Seed_Key_Access(Anch3,Physical,Bosch);
  TestStep("7","Send request 36 01 11 11 11 11 11 11 11 11 11 11 11 11 11 11 11 11 11 11 11 11 11 11 11 11 11 11 11 11 11 11 11 11 11 11 11 11 11 11 11 11 11 11 11 11 11 11 11 11 11 11 11 11 11 11 11 11 11 11 11 11 11 11 11 11 11 11 11 11 11 11 11 11 11 11 11 11 11 11 11 11 11 11 11 11 11 11 11 11 11 11 11 11 11 11 11 11 11 11 11 11 11 11 11 11 11 11 11 11 11 11 11 11 11 11 11 11 11 11 11 11 11 11 11 11 11 11 11 11 11 11 11 11 11 11 11 11 11 11 11 11 11 11 11 11 11 11 11 11 11 11 11 11 11 11 11 11 11 11 11 11 11 11 11 11 11 11 11 11 11 11 11 11 11 11 11 11 11 11 11 11 11 11 11 11 11 11 11 11 11 11 11 11 11 11 11 11 11 11 11 11 11 11 11 11 11 11 11 11 11 11 11 11 11 11 11 11 11 11 11 11 11 11 11 11 11 11 11 11 11 11 11 11 11 11 11 11 11 11 to enter Transfer Data services");
	SendDiag_Request_Verify_Negative_Response(DiagAnchor3,"36 01 11 11 11 11 11 11 11 11 11 11 11 11 11 11 11 11 11 11 11 11 11 11 11 11 11 11 11 11 11 11 11 11 11 11 11 11 11 11 11 11 11 11 11 11 11 11 11 11 11 11 11 11 11 11 11 11 11 11 11 11 11 11 11 11 11 11 11 11 11 11 11 11 11 11 11 11 11 11 11 11 11 11 11 11 11 11 11 11 11 11 11 11 11 11 11 11 11 11 11 11 11 11 11 11 11 11 11 11 11 11 11 11 11 11 11 11 11 11 11 11 11 11 11 11 11 11 11 11 11 11 11 11 11 11 11 11 11 11 11 11 11 11 11 11 11 11 11 11 11 11 11 11 11 11 11 11 11 11 11 11 11 11 11 11 11 11 11 11 11 11 11 11 11 11 11 11 11 11 11 11 11 11 11 11 11 11 11 11 11 11 11 11 11 11 11 11 11 11 11 11 11 11 11 11 11 11 11 11 11 11 11 11 11 11 11 11 11 11 11 11 11 11 11 11 11 11 11 11 11 11 11 11 11 11 11 11 11 11","7F 36 24");
  TestStep("8","Send request 34 00 14 00 00 00 00 EE to Request Download services");
	SendDiag_Request_Verify_Response(DiagAnchor3,"34 00 14 00 00 00 00 EE","74 20 00 F2");
  testWaitForTimeout(1000);
  TestStep("9","Send request 36 01 11 11 11 11 11 11 11 11 11 11 11 11 11 11 11 11 11 11 11 11 11 11 11 11 11 11 11 11 11 11 11 11 11 11 11 11 11 11 11 11 11 11 11 11 11 11 11 11 11 11 11 11 11 11 11 11 11 11 11 11 11 11 11 11 11 11 11 11 11 11 11 11 11 11 11 11 11 11 11 11 11 11 11 11 11 11 11 11 11 11 11 11 11 11 11 11 11 11 11 11 11 11 11 11 11 11 11 11 11 11 11 11 11 11 11 11 11 11 11 11 11 11 11 11 11 11 11 11 11 11 11 11 11 11 11 11 11 11 11 11 11 11 11 11 11 11 11 11 11 11 11 11 11 11 11 11 11 11 11 11 11 11 11 11 11 11 11 11 11 11 11 11 11 11 11 11 11 11 11 11 11 11 11 11 11 11 11 11 11 11 11 11 11 11 11 11 11 11 11 11 11 11 11 11 11 11 11 11 11 11 11 11 11 11 11 11 11 11 11 11 11 11 11 11 11 11 11 11 11 11 11 11 11 11 11 11 11 11 to enter Transfer Data services");
	SendDiag_Request_Verify_Response(DiagAnchor3,"36 01 11 11 11 11 11 11 11 11 11 11 11 11 11 11 11 11 11 11 11 11 11 11 11 11 11 11 11 11 11 11 11 11 11 11 11 11 11 11 11 11 11 11 11 11 11 11 11 11 11 11 11 11 11 11 11 11 11 11 11 11 11 11 11 11 11 11 11 11 11 11 11 11 11 11 11 11 11 11 11 11 11 11 11 11 11 11 11 11 11 11 11 11 11 11 11 11 11 11 11 11 11 11 11 11 11 11 11 11 11 11 11 11 11 11 11 11 11 11 11 11 11 11 11 11 11 11 11 11 11 11 11 11 11 11 11 11 11 11 11 11 11 11 11 11 11 11 11 11 11 11 11 11 11 11 11 11 11 11 11 11 11 11 11 11 11 11 11 11 11 11 11 11 11 11 11 11 11 11 11 11 11 11 11 11 11 11 11 11 11 11 11 11 11 11 11 11 11 11 11 11 11 11 11 11 11 11 11 11 11 11 11 11 11 11 11 11 11 11 11 11 11 11 11 11 11 11 11 11 11 11 11 11 11 11 11 11 11 11","76 01");
  TestStep("10","Send request 36 02 11 11 11 11 11 11 11 11 11 11 11 11 11 11 11 11 11 11 11 11 11 11 11 11 11 11 11 11 11 11 11 11 11 11 11 11 11 11 11 11 11 11 11 11 11 11 11 11 11 11 11 11 11 11 11 11 11 11 11 11 11 11 11 11 11 11 11 11 11 11 11 11 11 11 11 11 11 11 11 11 11 11 11 11 11 11 11 11 11 11 11 11 11 11 11 11 11 11 11 11 11 11 11 11 11 11 11 11 11 11 11 11 11 11 11 11 11 11 11 11 11 11 11 11 11 11 11 11 11 11 11 11 11 11 11 11 11 11 11 11 11 11 11 11 11 11 11 11 11 11 11 11 11 11 11 11 11 11 11 11 11 11 11 11 11 11 11 11 11 11 11 11 11 11 11 11 11 11 11 11 11 11 11 11 11 11 11 11 11 11 11 11 11 11 11 11 11 11 11 11 11 11 11 11 11 11 11 11 11 11 11 11 11 11 11 11 11 11 11 11 11 11 11 11 11 11 11 11 11 11 11 11 11 11 11 11 11 11 to enter Transfer Data services");
	SendDiag_Request_Verify_Negative_Response(DiagAnchor3,"36 02 11 11 11 11 11 11 11 11 11 11 11 11 11 11 11 11 11 11 11 11 11 11 11 11 11 11 11 11 11 11 11 11 11 11 11 11 11 11 11 11 11 11 11 11 11 11 11 11 11 11 11 11 11 11 11 11 11 11 11 11 11 11 11 11 11 11 11 11 11 11 11 11 11 11 11 11 11 11 11 11 11 11 11 11 11 11 11 11 11 11 11 11 11 11 11 11 11 11 11 11 11 11 11 11 11 11 11 11 11 11 11 11 11 11 11 11 11 11 11 11 11 11 11 11 11 11 11 11 11 11 11 11 11 11 11 11 11 11 11 11 11 11 11 11 11 11 11 11 11 11 11 11 11 11 11 11 11 11 11 11 11 11 11 11 11 11 11 11 11 11 11 11 11 11 11 11 11 11 11 11 11 11 11 11 11 11 11 11 11 11 11 11 11 11 11 11 11 11 11 11 11 11 11 11 11 11 11 11 11 11 11 11 11 11 11 11 11 11 11 11 11 11 11 11 11 11 11 11 11 11 11 11 11 11 11 11 11 11","7F 36 24");
  testWaitForTimeout(1000);
  PostCondition_Anchor( );
  }
  
testcase TCS_PK_FCA_AnchorUDSServer_TransferData_NRC31_ProgrammingSession_0x61SecurityLevel_32011()
{
  PreCondition_Anchor("TCS_PK_FCA_AnchorUDSServer_TransferData_NRC31_ProgrammingSession_0x61SecurityLevel_32011");
  testCaseComment("Actions");
  testWaitForTimeout(1000);
  TestStep("1","Send request 10 03 to enter Extended Diagnostic Session");
	SendDiag_Request_Verify_Response(DiagAnchor3,"10 03","50 03 00 32 01 F4");
  testWaitForTimeout(1000);
  TestStep("2,3","Send security unlock request 61 and 62");   
       	Security_Seed_Key_Access(Anch3,Physical,Bosch);
  TestStep("4","Send request 10 02 to enter Programming Diagnostic Session");
	SendDiag_Request_Verify_Response(DiagAnchor3,"10 02","50 02 00 32 01 F4");
  TestStep("5,6","Send security unlock request 61 and 62");   
       	Security_Seed_Key_Access(Anch3,Physical,Bosch);
  testWaitForTimeout(1000);
  TestStep("7","Send request 34 00 14 00 00 00 00 EE to Request Download services");
	SendDiag_Request_Verify_Response(DiagAnchor3,"34 00 14 00 00 00 00 EE","74 20 00 F2");
  testWaitForTimeout(1000);
  TestStep("8","Send request 36 01 11 11 11 11 11 11 11 11 11 11 11 11 11 11 11 11 11 11 11 11 11 11 11 11 11 11 11 11 11 11 11 11 11 11 11 11 11 11 11 11 11 11 11 11 11 11 11 11 11 11 11 11 11 11 11 11 11 11 11 11 11 11 11 11 11 11 11 11 11 11 11 11 11 11 11 11 11 11 11 11 11 11 11 11 11 11 11 11 11 11 11 11 11 11 11 11 11 11 11 11 11 11 11 11 11 11 11 11 11 11 11 11 11 11 11 11 11 11 11 11 11 11 11 11 11 11 11 11 11 11 11 11 11 11 11 11 11 11 11 11 11 11 11 11 11 11 11 11 11 11 11 11 11 11 11 11 11 11 11 11 11 11 11 11 11 11 11 11 11 11 11 11 11 11 11 11 11 11 11 11 11 11 11 11 11 11 11 11 11 11 11 11 11 11 11 11 11 11 11 11 11 11 11 11 11 11 11 11 11 11 11 11 11 11 11 11 11 11 11 11 11 11 11 11 11 11 11 11 11 11 11 11 11 11 11 11 11 11 to enter Transfer Data services");
	SendDiag_Request_Verify_Negative_Response(DiagAnchor3,"36 01 11 11 11 11 11 11 11 11 11 11 11 11 11 11 11 11 11 11 11 11 11 11 11 11 11 11 11 11 11 11 11 11 11 11 11 11 11 11 11 11 11 11 11 11 11 11 11 11 11 11 11 11 11 11 11 11 11 11 11 11 11 11 11 11 11 11 11 11 11 11 11 11 11 11 11 11 11 11 11 11 11 11 11 11 11 11 11 11 11 11 11 11 11 11 11 11 11 11 11 11 11 11 11 11 11 11 11 11 11 11 11 11 11 11 11 11 11 11 11 11 11 11 11 11 11 11 11 11 11 11 11 11 11 11 11 11 11 11 11 11 11 11 11 11 11 11 11 11 11 11 11 11 11 11 11 11 11 11 11 11 11 11 11 11 11 11 11 11 11 11 11 11 11 11 11 11 11 11 11 11 11 11 11 11 11 11 11 11 11 11 11 11 11 11 11 11 11 11 11 11 11 11 11 11 11 11 11 11 11 11 11 11 11 11 11 11 11 11 11 11 11 11 11 11 11 11 11 11 11 11 11 11 11 11 11 11 11 11 11 11","7F 36 31");
  testWaitForTimeout(1000);
  PostCondition_Anchor( );
  }

testcase TCS_PK_FCA_AnchorUDSServer_TransferData_NRC71_ProgrammingSession_0x61SecurityLevel_31275()
{
  PreCondition_Anchor("TCS_PK_FCA_AnchorUDSServer_TransferData_NRC71_ProgrammingSession_0x61SecurityLevel_31275");
  testCaseComment("Actions");
  testWaitForTimeout(1000);
  TestStep("1","Send request 10 03 to enter Extended Diagnostic Session");
	SendDiag_Request_Verify_Response(DiagAnchor3,"10 03","50 03 00 32 01 F4");
  testWaitForTimeout(1000);
  TestStep("2,3","Send security unlock request 61 and 62");   
       	Security_Seed_Key_Access(Anch3,Physical,Bosch);
  TestStep("4","Send request 10 02 to enter Programming Diagnostic Session");
	SendDiag_Request_Verify_Response(DiagAnchor3,"10 02","50 02 00 32 01 F4");
  TestStep("5,6","Send security unlock request 61 and 62");   
       	Security_Seed_Key_Access(Anch3,Physical,Bosch);
  TestStep("7","Send request 34 00 14 00 00 00 00 F0 to Request Download services");
	SendDiag_Request_Verify_Response(DiagAnchor3,"34 00 14 00 00 00 00 F0","74 20 00 F2");
  testWaitForTimeout(1000);
  TestStep("8","Send request 36 01 11 11 11 11 11 11 11 11 11 11 11 11 11 11 11 11 11 11 11 11 11 11 11 11 11 11 11 11 11 11 11 11 11 11 11 11 11 11 11 11 11 11 11 11 11 11 11 11 11 11 11 11 11 11 11 11 11 11 11 11 11 11 11 11 11 11 11 11 11 11 11 11 11 11 11 11 11 11 11 11 11 11 11 11 11 11 11 11 11 11 11 11 11 11 11 11 11 11 11 11 11 11 11 11 11 11 11 11 11 11 11 11 11 11 11 11 11 11 11 11 11 11 11 11 11 11 11 11 11 11 11 11 11 11 11 11 11 11 11 11 11 11 11 11 11 11 11 11 11 11 11 11 11 11 11 11 11 11 11 11 11 11 11 11 11 11 11 11 11 11 11 11 11 11 11 11 11 11 11 11 11 11 11 11 11 11 11 11 11 11 11 11 11 11 11 11 11 11 11 11 11 11 11 11 11 11 11 11 11 11 11 11 11 11 11 11 11 11 11 11 11 11 11 11 11 11 11 11 11 11 11 11 11 11 11 11 11 11 to enter Transfer Data services");
	testWaitForTimeout(1000);
  SendDiag_Request_Verify_Response(DiagAnchor3,"36 01 11 11 11 11 11 11 11 11 11 11 11 11 11 11 11 11 11 11 11 11 11 11 11 11 11 11 11 11 11 11 11 11 11 11 11 11 11 11 11 11 11 11 11 11 11 11 11 11 11 11 11 11 11 11 11 11 11 11 11 11 11 11 11 11 11 11 11 11 11 11 11 11 11 11 11 11 11 11 11 11 11 11 11 11 11 11 11 11 11 11 11 11 11 11 11 11 11 11 11 11 11 11 11 11 11 11 11 11 11 11 11 11 11 11 11 11 11 11 11 11 11 11 11 11 11 11 11 11 11 11 11 11 11 11 11 11 11 11 11 11 11 11 11 11 11 11 11 11 11 11 11 11 11 11 11 11 11 11 11 11 11 11 11 11 11 11 11 11 11 11 11 11 11 11 11 11 11 11 11 11 11 11 11 11 11 11 11 11 11 11 11 11 11 11 11 11 11 11 11 11 11 11 11 11 11 11 11 11 11 11 11 11 11 11 11 11 11 11 11 11 11 11 11 11 11 11 11 11 11 11 11 11 11 11 11 11 11 11","76 01");
  TestStep("9","Send request 36 02 11 11 11 11 11 11 11 11 11 11 11 11 11 11 11 11 11 11 11 11 11 11 11 11 11 11 11 11 11 11 11 11 11 11 11 11 11 11 11 11 11 11 11 11 11 11 11 11 11 11 11 11 11 11 11 11 11 11 11 11 11 11 11 11 11 11 11 11 11 11 11 11 11 11 11 11 11 11 11 11 11 11 11 11 11 11 11 11 11 11 11 11 11 11 11 11 11 11 11 11 11 11 11 11 11 11 11 11 11 11 11 11 11 11 11 11 11 11 11 11 11 11 11 11 11 11 11 11 11 11 11 11 11 11 11 11 11 11 11 11 11 11 11 11 11 11 11 11 11 11 11 11 11 11 11 11 11 11 11 11 11 11 11 11 11 11 11 11 11 11 11 11 11 11 11 11 11 11 11 11 11 11 11 11 11 11 11 11 11 11 11 11 11 11 11 11 11 11 11 11 11 11 11 11 11 11 11 11 11 11 11 11 11 11 11 11 11 11 11 11 11 11 11 11 11 11 11 11 11 11 11 11 11 11 11 11 11 11 to enter Transfer Data services");
	SendDiag_Request_Verify_Negative_Response(DiagAnchor3,"36 02 11 11 11 11 11 11 11 11 11 11 11 11 11 11 11 11 11 11 11 11 11 11 11 11 11 11 11 11 11 11 11 11 11 11 11 11 11 11 11 11 11 11 11 11 11 11 11 11 11 11 11 11 11 11 11 11 11 11 11 11 11 11 11 11 11 11 11 11 11 11 11 11 11 11 11 11 11 11 11 11 11 11 11 11 11 11 11 11 11 11 11 11 11 11 11 11 11 11 11 11 11 11 11 11 11 11 11 11 11 11 11 11 11 11 11 11 11 11 11 11 11 11 11 11 11 11 11 11 11 11 11 11 11 11 11 11 11 11 11 11 11 11 11 11 11 11 11 11 11 11 11 11 11 11 11 11 11 11 11 11 11 11 11 11 11 11 11 11 11 11 11 11 11 11 11 11 11 11 11 11 11 11 11 11 11 11 11 11 11 11 11 11 11 11 11 11 11 11 11 11 11 11 11 11 11 11 11 11 11 11 11 11 11 11 11 11 11 11 11 11 11 11 11 11 11 11 11 11 11 11 11 11 11 11 11 11 11 11","7F 36 71");
  testWaitForTimeout(1000);
  PostCondition_Anchor( );
  }

testcase TCS_PK_FCA_AnchorUDSServer_TransferData_NRC73_ProgrammingSession_0x61SecurityLevel_31994()
{
  PreCondition_Anchor("TCS_PK_FCA_AnchorUDSServer_TransferData_NRC73_ProgrammingSession_0x61SecurityLevel_31994");
  testCaseComment("Actions");
  testWaitForTimeout(1000);
  TestStep("1","Send request 10 03 to enter Extended Diagnostic Session");
	SendDiag_Request_Verify_Response(DiagAnchor3,"10 03","50 03 00 32 01 F4");
  testWaitForTimeout(1000);
  TestStep("2,3","Send security unlock request 61 and 62");   
       	Security_Seed_Key_Access(Anch3,Physical,Bosch);
  TestStep("4","Send request 10 02 to enter Programming Diagnostic Session");
	SendDiag_Request_Verify_Response(DiagAnchor3,"10 02","50 02 00 32 01 F4");
  TestStep("5,6","Send security unlock request 61 and 62");   
       	Security_Seed_Key_Access(Anch3,Physical,Bosch);
  TestStep("7","Send request 34 00 24 00 00 00 00 01 DE to Request Download services");
	SendDiag_Request_Verify_Response(DiagAnchor3,"34 00 24 00 00 00 00 01 DE","74 20 00 F2");
  testWaitForTimeout(1000);
  TestStep("8","Send request 36 02 11 11 11 11 11 11 11 11 11 11 11 11 11 11 11 11 11 11 11 11 11 11 11 11 11 11 11 11 11 11 11 11 11 11 11 11 11 11 11 11 11 11 11 11 11 11 11 11 11 11 11 11 11 11 11 11 11 11 11 11 11 11 11 11 11 11 11 11 11 11 11 11 11 11 11 11 11 11 11 11 11 11 11 11 11 11 11 11 11 11 11 11 11 11 11 11 11 11 11 11 11 11 11 11 11 11 11 11 11 11 11 11 11 11 11 11 11 11 11 11 11 11 11 11 11 11 11 11 11 11 11 11 11 11 11 11 11 11 11 11 11 11 11 11 11 11 11 11 11 11 11 11 11 11 11 11 11 11 11 11 11 11 11 11 11 11 11 11 11 11 11 11 11 11 11 11 11 11 11 11 11 11 11 11 11 11 11 11 11 11 11 11 11 11 11 11 11 11 11 11 11 11 11 11 11 11 11 11 11 11 11 11 11 11 11 11 11 11 11 11 11 11 11 11 11 11 11 11 11 11 11 11 11 11 11 11 11 11 to enter Transfer Data services");
	SendDiag_Request_Verify_Negative_Response(DiagAnchor3,"36 02 11 11 11 11 11 11 11 11 11 11 11 11 11 11 11 11 11 11 11 11 11 11 11 11 11 11 11 11 11 11 11 11 11 11 11 11 11 11 11 11 11 11 11 11 11 11 11 11 11 11 11 11 11 11 11 11 11 11 11 11 11 11 11 11 11 11 11 11 11 11 11 11 11 11 11 11 11 11 11 11 11 11 11 11 11 11 11 11 11 11 11 11 11 11 11 11 11 11 11 11 11 11 11 11 11 11 11 11 11 11 11 11 11 11 11 11 11 11 11 11 11 11 11 11 11 11 11 11 11 11 11 11 11 11 11 11 11 11 11 11 11 11 11 11 11 11 11 11 11 11 11 11 11 11 11 11 11 11 11 11 11 11 11 11 11 11 11 11 11 11 11 11 11 11 11 11 11 11 11 11 11 11 11 11 11 11 11 11 11 11 11 11 11 11 11 11 11 11 11 11 11 11 11 11 11 11 11 11 11 11 11 11 11 11 11 11 11 11 11 11 11 11 11 11 11 11 11 11 11 11 11 11 11 11 11 11 11 11","7F 36 73");
  TestStep("9","Send request 36 01 11 11 11 11 11 11 11 11 11 11 11 11 11 11 11 11 11 11 11 11 11 11 11 11 11 11 11 11 11 11 11 11 11 11 11 11 11 11 11 11 11 11 11 11 11 11 11 11 11 11 11 11 11 11 11 11 11 11 11 11 11 11 11 11 11 11 11 11 11 11 11 11 11 11 11 11 11 11 11 11 11 11 11 11 11 11 11 11 11 11 11 11 11 11 11 11 11 11 11 11 11 11 11 11 11 11 11 11 11 11 11 11 11 11 11 11 11 11 11 11 11 11 11 11 11 11 11 11 11 11 11 11 11 11 11 11 11 11 11 11 11 11 11 11 11 11 11 11 11 11 11 11 11 11 11 11 11 11 11 11 11 11 11 11 11 11 11 11 11 11 11 11 11 11 11 11 11 11 11 11 11 11 11 11 11 11 11 11 11 11 11 11 11 11 11 11 11 11 11 11 11 11 11 11 11 11 11 11 11 11 11 11 11 11 11 11 11 11 11 11 11 11 11 11 11 11 11 11 11 11 11 11 11 11 11 11 11 11 to enter Transfer Data services");
	SendDiag_Request_Verify_Response(DiagAnchor3,"36 01 11 11 11 11 11 11 11 11 11 11 11 11 11 11 11 11 11 11 11 11 11 11 11 11 11 11 11 11 11 11 11 11 11 11 11 11 11 11 11 11 11 11 11 11 11 11 11 11 11 11 11 11 11 11 11 11 11 11 11 11 11 11 11 11 11 11 11 11 11 11 11 11 11 11 11 11 11 11 11 11 11 11 11 11 11 11 11 11 11 11 11 11 11 11 11 11 11 11 11 11 11 11 11 11 11 11 11 11 11 11 11 11 11 11 11 11 11 11 11 11 11 11 11 11 11 11 11 11 11 11 11 11 11 11 11 11 11 11 11 11 11 11 11 11 11 11 11 11 11 11 11 11 11 11 11 11 11 11 11 11 11 11 11 11 11 11 11 11 11 11 11 11 11 11 11 11 11 11 11 11 11 11 11 11 11 11 11 11 11 11 11 11 11 11 11 11 11 11 11 11 11 11 11 11 11 11 11 11 11 11 11 11 11 11 11 11 11 11 11 11 11 11 11 11 11 11 11 11 11 11 11 11 11 11 11 11 11 11","76 01");
  TestStep("10","Send request 36 02 11 11 11 11 11 11 11 11 11 11 11 11 11 11 11 11 11 11 11 11 11 11 11 11 11 11 11 11 11 11 11 11 11 11 11 11 11 11 11 11 11 11 11 11 11 11 11 11 11 11 11 11 11 11 11 11 11 11 11 11 11 11 11 11 11 11 11 11 11 11 11 11 11 11 11 11 11 11 11 11 11 11 11 11 11 11 11 11 11 11 11 11 11 11 11 11 11 11 11 11 11 11 11 11 11 11 11 11 11 11 11 11 11 11 11 11 11 11 11 11 11 11 11 11 11 11 11 11 11 11 11 11 11 11 11 11 11 11 11 11 11 11 11 11 11 11 11 11 11 11 11 11 11 11 11 11 11 11 11 11 11 11 11 11 11 11 11 11 11 11 11 11 11 11 11 11 11 11 11 11 11 11 11 11 11 11 11 11 11 11 11 11 11 11 11 11 11 11 11 11 11 11 11 11 11 11 11 11 11 11 11 11 11 11 11 11 11 11 11 11 11 11 11 11 11 11 11 11 11 11 11 11 11 11 11 11 11 11 to enter Transfer Data services");
	SendDiag_Request_Verify_Response(DiagAnchor3,"36 02 11 11 11 11 11 11 11 11 11 11 11 11 11 11 11 11 11 11 11 11 11 11 11 11 11 11 11 11 11 11 11 11 11 11 11 11 11 11 11 11 11 11 11 11 11 11 11 11 11 11 11 11 11 11 11 11 11 11 11 11 11 11 11 11 11 11 11 11 11 11 11 11 11 11 11 11 11 11 11 11 11 11 11 11 11 11 11 11 11 11 11 11 11 11 11 11 11 11 11 11 11 11 11 11 11 11 11 11 11 11 11 11 11 11 11 11 11 11 11 11 11 11 11 11 11 11 11 11 11 11 11 11 11 11 11 11 11 11 11 11 11 11 11 11 11 11 11 11 11 11 11 11 11 11 11 11 11 11 11 11 11 11 11 11 11 11 11 11 11 11 11 11 11 11 11 11 11 11 11 11 11 11 11 11 11 11 11 11 11 11 11 11 11 11 11 11 11 11 11 11 11 11 11 11 11 11 11 11 11 11 11 11 11 11 11 11 11 11 11 11 11 11 11 11 11 11 11 11 11 11 11 11 11 11 11 11 11 11","76 01");
  TestStep("11","Send request 36 02 11 11 11 11 11 11 11 11 11 11 11 11 11 11 11 11 11 11 11 11 11 11 11 11 11 11 11 11 11 11 11 11 11 11 11 11 11 11 11 11 11 11 11 11 11 11 11 11 11 11 11 11 11 11 11 11 11 11 11 11 11 11 11 11 11 11 11 11 11 11 11 11 11 11 11 11 11 11 11 11 11 11 11 11 11 11 11 11 11 11 11 11 11 11 11 11 11 11 11 11 11 11 11 11 11 11 11 11 11 11 11 11 11 11 11 11 11 11 11 11 11 11 11 11 11 11 11 11 11 11 11 11 11 11 11 11 11 11 11 11 11 11 11 11 11 11 11 11 11 11 11 11 11 11 11 11 11 11 11 11 11 11 11 11 11 11 11 11 11 11 11 11 11 11 11 11 11 11 11 11 11 11 11 11 11 11 11 11 11 11 11 11 11 11 11 11 11 11 11 11 11 11 11 11 11 11 11 11 11 11 11 11 11 11 11 11 11 11 11 11 11 11 11 11 11 11 11 11 11 11 11 11 11 11 11 11 11 11 to enter Transfer Data services");
	SendDiag_Request_Verify_Response(DiagAnchor3,"36 02 11 11 11 11 11 11 11 11 11 11 11 11 11 11 11 11 11 11 11 11 11 11 11 11 11 11 11 11 11 11 11 11 11 11 11 11 11 11 11 11 11 11 11 11 11 11 11 11 11 11 11 11 11 11 11 11 11 11 11 11 11 11 11 11 11 11 11 11 11 11 11 11 11 11 11 11 11 11 11 11 11 11 11 11 11 11 11 11 11 11 11 11 11 11 11 11 11 11 11 11 11 11 11 11 11 11 11 11 11 11 11 11 11 11 11 11 11 11 11 11 11 11 11 11 11 11 11 11 11 11 11 11 11 11 11 11 11 11 11 11 11 11 11 11 11 11 11 11 11 11 11 11 11 11 11 11 11 11 11 11 11 11 11 11 11 11 11 11 11 11 11 11 11 11 11 11 11 11 11 11 11 11 11 11 11 11 11 11 11 11 11 11 11 11 11 11 11 11 11 11 11 11 11 11 11 11 11 11 11 11 11 11 11 11 11 11 11 11 11 11 11 11 11 11 11 11 11 11 11 11 11 11 11 11 11 11 11 11","76 01");
  TestStep("12","Send request 36 01 11 11 11 11 11 11 11 11 11 11 11 11 11 11 11 11 11 11 11 11 11 11 11 11 11 11 11 11 11 11 11 11 11 11 11 11 11 11 11 11 11 11 11 11 11 11 11 11 11 11 11 11 11 11 11 11 11 11 11 11 11 11 11 11 11 11 11 11 11 11 11 11 11 11 11 11 11 11 11 11 11 11 11 11 11 11 11 11 11 11 11 11 11 11 11 11 11 11 11 11 11 11 11 11 11 11 11 11 11 11 11 11 11 11 11 11 11 11 11 11 11 11 11 11 11 11 11 11 11 11 11 11 11 11 11 11 11 11 11 11 11 11 11 11 11 11 11 11 11 11 11 11 11 11 11 11 11 11 11 11 11 11 11 11 11 11 11 11 11 11 11 11 11 11 11 11 11 11 11 11 11 11 11 11 11 11 11 11 11 11 11 11 11 11 11 11 11 11 11 11 11 11 11 11 11 11 11 11 11 11 11 11 11 11 11 11 11 11 11 11 11 11 11 11 11 11 11 11 11 11 11 11 11 11 11 11 11 11 to enter Transfer Data services");
	SendDiag_Request_Verify_Negative_Response(DiagAnchor3,"36 01 11 11 11 11 11 11 11 11 11 11 11 11 11 11 11 11 11 11 11 11 11 11 11 11 11 11 11 11 11 11 11 11 11 11 11 11 11 11 11 11 11 11 11 11 11 11 11 11 11 11 11 11 11 11 11 11 11 11 11 11 11 11 11 11 11 11 11 11 11 11 11 11 11 11 11 11 11 11 11 11 11 11 11 11 11 11 11 11 11 11 11 11 11 11 11 11 11 11 11 11 11 11 11 11 11 11 11 11 11 11 11 11 11 11 11 11 11 11 11 11 11 11 11 11 11 11 11 11 11 11 11 11 11 11 11 11 11 11 11 11 11 11 11 11 11 11 11 11 11 11 11 11 11 11 11 11 11 11 11 11 11 11 11 11 11 11 11 11 11 11 11 11 11 11 11 11 11 11 11 11 11 11 11 11 11 11 11 11 11 11 11 11 11 11 11 11 11 11 11 11 11 11 11 11 11 11 11 11 11 11 11 11 11 11 11 11 11 11 11 11 11 11 11 11 11 11 11 11 11 11 11 11 11 11 11 11 11 11","7F 36 73");
  testWaitForTimeout(1000); 
  PostCondition_Anchor( );
  }
  
testcase TCS_PK_FCA_AnchorUDSServer_TransferData_NRC7F_DefaultSession_31974()
{
  PreCondition_Anchor("TCS_PK_FCA_AnchorUDSServer_TransferData_NRC7F_DefaultSession_31974");
  testCaseComment("Actions");
  testWaitForTimeout(1000);
  TestStep("1","Send request 10 03 to enter Extended Diagnostic Session");
	SendDiag_Request_Verify_Response(DiagAnchor3,"10 03","50 03 00 32 01 F4");
  testWaitForTimeout(1000);
  TestStep("2,3","Send security unlock request 61 and 62");   
       	Security_Seed_Key_Access(Anch3,Physical,Bosch);
  TestStep("4","Send request 10 02 to enter Programming Diagnostic Session");
	SendDiag_Request_Verify_Response(DiagAnchor3,"10 02","50 02 00 32 01 F4");
  TestStep("5","Send request 34 00 14 00 00 00 00 EE to Request Download services");
	SendDiag_Request_Verify_Response(DiagAnchor3,"34 00 14 00 00 00 00 EE","74 20 00 F2");
  TestStep("6","Send request 10 01 to enter Default Diagnostic Session");
	SendDiag_Request_Verify_Response(DiagAnchor3,"10 01","50 01 00 32 01 F4");
  testWaitForTimeout(1000);
  TestStep("7","Send request 36 01 11 11 11 11 11 11 11 11 11 11 11 11 11 11 11 11 11 11 11 11 11 11 11 11 11 11 11 11 11 11 11 11 11 11 11 11 11 11 11 11 11 11 11 11 11 11 11 11 11 11 11 11 11 11 11 11 11 11 11 11 11 11 11 11 11 11 11 11 11 11 11 11 11 11 11 11 11 11 11 11 11 11 11 11 11 11 11 11 11 11 11 11 11 11 11 11 11 11 11 11 11 11 11 11 11 11 11 11 11 11 11 11 11 11 11 11 11 11 11 11 11 11 11 11 11 11 11 11 11 11 11 11 11 11 11 11 11 11 11 11 11 11 11 11 11 11 11 11 11 11 11 11 11 11 11 11 11 11 11 11 11 11 11 11 11 11 11 11 11 11 11 11 11 11 11 11 11 11 11 11 11 11 11 11 11 11 11 11 11 11 11 11 11 11 11 11 11 11 11 11 11 11 11 11 11 11 11 11 11 11 11 11 11 11 11 11 11 11 11 11 11 11 11 11 11 11 11 11 11 11 11 11 11 11 11 11 11 11 to enter Transfer Data services");
	SendDiag_Request_Verify_Negative_Response(DiagAnchor3,"36 01 11 11 11 11 11 11 11 11 11 11 11 11 11 11 11 11 11 11 11 11 11 11 11 11 11 11 11 11 11 11 11 11 11 11 11 11 11 11 11 11 11 11 11 11 11 11 11 11 11 11 11 11 11 11 11 11 11 11 11 11 11 11 11 11 11 11 11 11 11 11 11 11 11 11 11 11 11 11 11 11 11 11 11 11 11 11 11 11 11 11 11 11 11 11 11 11 11 11 11 11 11 11 11 11 11 11 11 11 11 11 11 11 11 11 11 11 11 11 11 11 11 11 11 11 11 11 11 11 11 11 11 11 11 11 11 11 11 11 11 11 11 11 11 11 11 11 11 11 11 11 11 11 11 11 11 11 11 11 11 11 11 11 11 11 11 11 11 11 11 11 11 11 11 11 11 11 11 11 11 11 11 11 11 11 11 11 11 11 11 11 11 11 11 11 11 11 11 11 11 11 11 11 11 11 11 11 11 11 11 11 11 11 11 11 11 11 11 11 11 11 11 11 11 11 11 11 11 11 11 11 11 11 11 11 11 11 11 11","7F 36 7F");
  testWaitForTimeout(1000);
  PostCondition_Anchor( );
  }
  
testcase TCS_PK_FCA_AnchorUDSServer_TransferData_NRC7F_ExtendedSession_NoSecurityLevel_32077()
{
  PreCondition_Anchor("TCS_PK_FCA_AnchorUDSServer_TransferData_NRC7F_ExtendedSession_NoSecurityLevel_32077");
  testCaseComment("Actions");
  testWaitForTimeout(1000);
  TestStep("1","Send request 10 03 to enter Extended Diagnostic Session");
	SendDiag_Request_Verify_Response(DiagAnchor3,"10 03","50 03 00 32 01 F4");
  testWaitForTimeout(1000);
  TestStep("2,3","Send security unlock request 61 and 62");   
       	Security_Seed_Key_Access(Anch3,Physical,Bosch);
  TestStep("4","Send request 10 02 to enter Programming Diagnostic Session");
	SendDiag_Request_Verify_Response(DiagAnchor3,"10 02","50 02 00 32 01 F4");
  TestStep("5","Send request 34 00 14 00 00 00 00 EE to Request Download services");
	SendDiag_Request_Verify_Response(DiagAnchor3,"34 00 14 00 00 00 00 EE","74 20 00 F2");
  testWaitForTimeout(1000);
  TestStep("6","Send request 10 01 to enter Default Diagnostic Session");
	SendDiag_Request_Verify_Response(DiagAnchor3,"10 01","50 01 00 32 01 F4");
  testWaitForTimeout(1000);
  TestStep("7","Send request 10 03 to enter Extended Diagnostic Session");
	SendDiag_Request_Verify_Response(DiagAnchor3,"10 03","50 03 00 32 01 F4");
  testWaitForTimeout(1000);
  TestStep("8","Send request 36 01 11 11 11 11 11 11 11 11 11 11 11 11 11 11 11 11 11 11 11 11 11 11 11 11 11 11 11 11 11 11 11 11 11 11 11 11 11 11 11 11 11 11 11 11 11 11 11 11 11 11 11 11 11 11 11 11 11 11 11 11 11 11 11 11 11 11 11 11 11 11 11 11 11 11 11 11 11 11 11 11 11 11 11 11 11 11 11 11 11 11 11 11 11 11 11 11 11 11 11 11 11 11 11 11 11 11 11 11 11 11 11 11 11 11 11 11 11 11 11 11 11 11 11 11 11 11 11 11 11 11 11 11 11 11 11 11 11 11 11 11 11 11 11 11 11 11 11 11 11 11 11 11 11 11 11 11 11 11 11 11 11 11 11 11 11 11 11 11 11 11 11 11 11 11 11 11 11 11 11 11 11 11 11 11 11 11 11 11 11 11 11 11 11 11 11 11 11 11 11 11 11 11 11 11 11 11 11 11 11 11 11 11 11 11 11 11 11 11 11 11 11 11 11 11 11 11 11 11 11 11 11 11 11 11 11 11 11 11 to enter Transfer Data services");
	SendDiag_Request_Verify_Negative_Response(DiagAnchor3,"36 01 11 11 11 11 11 11 11 11 11 11 11 11 11 11 11 11 11 11 11 11 11 11 11 11 11 11 11 11 11 11 11 11 11 11 11 11 11 11 11 11 11 11 11 11 11 11 11 11 11 11 11 11 11 11 11 11 11 11 11 11 11 11 11 11 11 11 11 11 11 11 11 11 11 11 11 11 11 11 11 11 11 11 11 11 11 11 11 11 11 11 11 11 11 11 11 11 11 11 11 11 11 11 11 11 11 11 11 11 11 11 11 11 11 11 11 11 11 11 11 11 11 11 11 11 11 11 11 11 11 11 11 11 11 11 11 11 11 11 11 11 11 11 11 11 11 11 11 11 11 11 11 11 11 11 11 11 11 11 11 11 11 11 11 11 11 11 11 11 11 11 11 11 11 11 11 11 11 11 11 11 11 11 11 11 11 11 11 11 11 11 11 11 11 11 11 11 11 11 11 11 11 11 11 11 11 11 11 11 11 11 11 11 11 11 11 11 11 11 11 11 11 11 11 11 11 11 11 11 11 11 11 11 11 11 11 11 11 11","7F 36 7F");
  testWaitForTimeout(1000); 
  PostCondition_Anchor( );
  }




///////////////////////ControlDTCSetting/////////////////////////

testcase TCS_PK_FCA_AnchorUDSServer_ControlDTCSetting_NRC12_ExtendedSession_NoSecurityLevel_20569()
{
  PreCondition_Anchor("TCS_PK_FCA_AnchorUDSServer_ControlDTCSetting_NRC12_ExtendedSession_NoSecurityLevel_20569");
  testCaseComment("Actions");
  TestStep("1","Send request 10 03 to enter Extended Diagnostic Session");
	SendDiag_Request_Verify_Response(DiagAnchor3,"10 03","50 03 00 32 01 F4");
  TestStep("2","Send request 85 00 to ControlDTCSetting");
	SendDiag_Request_Verify_Negative_Response(DiagAnchor3,"85 00","7F 85 12");
  TestStep("3","Send request 85 03 to ControlDTCSetting");
	SendDiag_Request_Verify_Negative_Response(DiagAnchor3,"85 03","7F 85 12");
  TestStep("4","Send request 85 AA to ControlDTCSetting");
	SendDiag_Request_Verify_Negative_Response(DiagAnchor3,"85 AA","7F 85 12");
  TestStep("5","Send request 85 FF to ControlDTCSetting");
	SendDiag_Request_Verify_Negative_Response(DiagAnchor3,"85 FF","7F 85 12");
  PostCondition_Anchor( );
  }

testcase TCS_PK_FCA_AnchorUDSServer_ControlDTCSetting_NRC13_ExtendedSession_NoSecurityLevel_20588()
{
  PreCondition_Anchor("TCS_PK_FCA_AnchorUDSServer_ControlDTCSetting_NRC13_ExtendedSession_NoSecurityLevel_20588");
  testCaseComment("Actions");
  TestStep("1","Send request 10 03 to enter Extended Diagnostic Session");
	SendDiag_Request_Verify_Response(DiagAnchor3,"10 03","50 03 00 32 01 F4");
  TestStep("2","Send request 85 to ControlDTCSetting");
	SendDiag_Request_Verify_Negative_Response(DiagAnchor3,"85","7F 85 13");
  TestStep("3","Send request 85 01 00 to ControlDTCSetting");
	SendDiag_Request_Verify_Negative_Response(DiagAnchor3,"85 01 00","7F 85 13");
  PostCondition_Anchor( );
  }
  
testcase TCS_PK_FCA_AnchorUDSServer_ControlDTCSetting_NRC7F_DefaultSession_20606()
{
  PreCondition_Anchor("TCS_PK_FCA_AnchorUDSServer_ControlDTCSetting_NRC7F_DefaultSession_20606");
  testCaseComment("Actions");
  TestStep("1","Send request 10 01 to enter Extended Diagnostic Session");
	SendDiag_Request_Verify_Response(DiagAnchor3,"10 01","50 01 00 32 01 F4");
  TestStep("2","Send request 85 01 to ControlDTCSetting");
	SendDiag_Request_Verify_Negative_Response(DiagAnchor3,"85 01","7F 85 7F");
  PostCondition_Anchor( );
  }
	
testcase TCS_PK_FCA_AnchorUDSServer_ControlDTCSetting_NRC7F_ProgrammingSession_NoSecurityLevel_20612()
{
  PreCondition_Anchor("TCS_PK_FCA_AnchorUDSServer_ControlDTCSetting_NRC7F_ProgrammingSession_NoSecurityLevel_20612");
  testCaseComment("Actions");
  TestStep("1","Send request 10 03 to enter Extended Diagnostic Session");
	SendDiag_Request_Verify_Response(DiagAnchor3,"10 03","50 03 00 32 01 F4");
  TestStep("2,3","Send security unlock request 61 and 62");   
       	Security_Seed_Key_Access(Anch3,Physical,Bosch);
  TestStep("4","Send request 10 02 to enter Programming Diagnostic Session");
	SendDiag_Request_Verify_Response(DiagAnchor3,"10 02","50 02 00 32 01 F4");
  TestStep("5","Send request 85 01 to ControlDTCSetting");
	SendDiag_Request_Verify_Negative_Response(DiagAnchor3,"85 01","7F 85 7F");
  PostCondition_Anchor( );
  }
  
testcase TCS_PK_FCA_AnchorUDSServer_ControlDTCSetting_SFID0x01andSFID0x02_ExtendedSession_NoSecurityLevel_20626()
{
  PreCondition_Anchor("TCS_PK_FCA_AnchorUDSServer_ControlDTCSetting_SFID0x01andSFID0x02_ExtendedSession_NoSecurityLevel_20626");
  testCaseComment("Actions");
TestStep("1","Send request 10 03 to enter Extended Diagnostic Session");
	SendDiag_Request_Verify_Response(DiagAnchor3,"10 03","50 03 00 32 01 F4");
  TestStep("2","Send request 85 02 to ControlDTCSetting");
	SendDiag_Request_Verify_Response(DiagAnchor3,"85 01","C5 02");
  TestStep("2","Send request 19 02 FF to ControlDTCSetting");
	SendDiag_Request_Verify_Response(DiagAnchor3,"19 02 FF","59 02 31 90 00 49 00");
  TestStep("3","Send request 85 01 to ControlDTCSetting");
	SendDiag_Request_Verify_Response(DiagAnchor3,"85 01","C5 01");
  TestStep("4","Send request 19 02 FF to ControlDTCSetting");
	SendDiag_Request_Verify_Response(DiagAnchor3,"19 02 FF","59 02 31 90 00 49 01");
  TestStep("5","Send request 14 FF FF FF to ControlDTCSetting");
	SendDiag_Request_Verify_Response(DiagAnchor3,"14 FF FF FF","54");
  PostCondition_Anchor( );
  }
  
testcase TCS_PK_FCA_AnchorUDSServer_ControlDTCSetting_SFID0x01_ExtendedSession_0x61SecurityLevel_20594()
{
  PreCondition_Anchor("TCS_PK_FCA_AnchorUDSServer_ControlDTCSetting_SFID0x01_ExtendedSession_0x61SecurityLevel_20594");
  testCaseComment("Actions");
  TestStep("1","Send request 10 03 to enter Extended Diagnostic Session");
	SendDiag_Request_Verify_Response(DiagAnchor3,"10 03","50 03 00 32 01 F4");
  TestStep("2,3","Send security unlock request 61 and 62");   
       	Security_Seed_Key_Access(Anch3,Physical,Bosch);
  TestStep("4","Send request 85 01 to ControlDTCSetting");
	SendDiag_Request_Verify_Response(DiagAnchor3,"85 01","C5 01");
  PostCondition_Anchor( );
  }

testcase TCS_PK_FCA_AnchorUDSServer_ControlDTCSetting_SFID0x01_ExtendedSession_0x65SecurityLevel_20646()
{
  PreCondition_Anchor("TCS_PK_FCA_AnchorUDSServer_ControlDTCSetting_SFID0x01_ExtendedSession_0x65SecurityLevel_20646");
  testCaseComment("Actions");
  TestStep("1","Send request 10 03 to enter Extended Diagnostic Session");
	SendDiag_Request_Verify_Response(DiagAnchor3,"10 03","50 03 00 32 01 F4");
  TestStep("2,3","Send security unlock request 65 and 66");   
       	Security_Seed_Key_Access(Anch3,Physical,Incar_1);
  TestStep("4","Send request 85 01 to ControlDTCSetting");
	SendDiag_Request_Verify_Response(DiagAnchor3,"85 01","C5 01");
  PostCondition_Anchor( );
  }

testcase TCS_PK_FCA_AnchorUDSServer_ControlDTCSetting_SFID0x01_ExtendedSession_NoSecurityLevel_20658()
{
  PreCondition_Anchor("TCS_PK_FCA_AnchorUDSServer_ControlDTCSetting_SFID0x01_ExtendedSession_NoSecurityLevel_20658");
  testCaseComment("Actions");
  TestStep("1","Send request 10 03 to enter Extended Diagnostic Session");
	SendDiag_Request_Verify_Response(DiagAnchor3,"10 03","50 03 00 32 01 F4");
  TestStep("2","Send request 85 01 to ControlDTCSetting");
	SendDiag_Request_Verify_Response(DiagAnchor3,"85 01","C5 01");
  PostCondition_Anchor( );
  }

testcase TCS_PK_FCA_AnchorUDSServer_ControlDTCSetting_SFID0x02_ExtendedSession_0x61SecurityLevel_20632()
{
  PreCondition_Anchor("TCS_PK_FCA_AnchorUDSServer_ControlDTCSetting_SFID0x02_ExtendedSession_0x61SecurityLevel_20632");
  testCaseComment("Actions");
  TestStep("1","Send request 10 03 to enter Extended Diagnostic Session");
	SendDiag_Request_Verify_Response(DiagAnchor3,"10 03","50 03 00 32 01 F4");
  TestStep("2,3","Send security unlock request 61 and 62");   
       	Security_Seed_Key_Access(Anch3,Physical,Bosch);
  TestStep("4","Send request 85 02 to ControlDTCSetting");
	SendDiag_Request_Verify_Response(DiagAnchor3,"85 02","C5 02");
  PostCondition_Anchor( );
  }
  
testcase TCS_PK_FCA_AnchorUDSServer_ControlDTCSetting_SFID0x02_ExtendedSession_0x65SecurityLevel_20664()
{
  PreCondition_Anchor("TCS_PK_FCA_AnchorUDSServer_ControlDTCSetting_SFID0x02_ExtendedSession_0x65SecurityLevel_20664");
  testCaseComment("Actions");
  TestStep("1","Send request 10 03 to enter Extended Diagnostic Session");
	SendDiag_Request_Verify_Response(DiagAnchor3,"10 03","50 03 00 32 01 F4");
  TestStep("2,3","Send security unlock request 65 and 66");   
       	Security_Seed_Key_Access(Anch3,Physical,Incar_1);
  TestStep("4","Send request 85 02 to ControlDTCSetting");
	SendDiag_Request_Verify_Response(DiagAnchor3,"85 02","C5 02");
  PostCondition_Anchor( );
  }



/////////////////////////////ReadDataByIdentifier_NRC13////////////////////////

testcase TCS_PK_FCA_AnchorUDSServer_ReadDataByIdentifier_NRC13_DefaultSession_54569()
{
  PreCondition_Anchor("TCS_PK_FCA_AnchorUDSServer_ReadDataByIdentifier_NRC13_DefaultSession_54569");
  testCaseComment("Actions");
  TestStep("1","Send request 10 01 to enter Default Diagnostic Session");
	SendDiag_Request_Verify_Response(DiagAnchor3,"10 01","50 01 00 32 01 F4");
  TestStep("2","Send request 22 to ReadDataByIdentifier");
	SendDiag_Request_Verify_Negative_Response(DiagAnchor3,"22","7F 22 13");
  TestStep("3","Send request 22 00 to ReadDataByIdentifier");
	SendDiag_Request_Verify_Negative_Response(DiagAnchor3,"22 00","7F 22 13");
  TestStep("4","Send request 22 F1 80 00 to ReadDataByIdentifier");
	SendDiag_Request_Verify_Negative_Response(DiagAnchor3,"22 F1 80 00","7F 22 13");
  TestStep("5","Send request 22 F1 80 F1 80 to ReadDataByIdentifier");
	SendDiag_Request_Verify_Negative_Response(DiagAnchor3,"22 F1 80 F1 80","7F 22 13");
  PostCondition_Anchor( );
  }


///////////////////////WriteDataByIdentifier_NRC31///////////////////////

testcase TCS_PK_FCA_AnchorUDSServer_WriteDataByIdentifier_NRC31_DIDF180_ExtendedSession_NoSecurityLevel_36194()
{
  PreCondition_Anchor("TCS_PK_FCA_AnchorUDSServer_WriteDataByIdentifier_NRC31_DIDF180_ExtendedSession_NoSecurityLevel_36194");
  testCaseComment("Actions");
  TestStep("1","Send request 10 03 to enter Extended Diagnostic Session");
	SendDiag_Request_Verify_Response(DiagAnchor3,"10 03","50 03 00 32 01 F4");
  TestStep("2","Send request 2E F1 80 00 to WriteDataByIdentifier");
	SendDiag_Request_Verify_Negative_Response(DiagAnchor3,"2E F1 80 00","7F 2E 31");
  PostCondition_Anchor( );
  }	
  
testcase TCS_PK_FCA_AnchorUDSServer_WriteDataByIdentifier_NRC31_DIDF181_ExtendedSession_NoSecurityLevel_36201()
{
  PreCondition_Anchor("TCS_PK_FCA_AnchorUDSServer_WriteDataByIdentifier_NRC31_DIDF181_ExtendedSession_NoSecurityLevel_36201");
  testCaseComment("Actions");
  TestStep("1","Send request 10 03 to enter Extended Diagnostic Session");
	SendDiag_Request_Verify_Response(DiagAnchor3,"10 03","50 03 00 32 01 F4");
  TestStep("2","Send request 2E F1 81 00 to WriteDataByIdentifier");
	SendDiag_Request_Verify_Negative_Response(DiagAnchor3,"2E F1 81 00","7F 2E 31");
  PostCondition_Anchor( );
  }
  
testcase TCS_PK_FCA_AnchorUDSServer_WriteDataByIdentifier_NRC31_DIDF186_ExtendedSession_NoSecurityLevel_36211()
{
  PreCondition_Anchor("TCS_PK_FCA_AnchorUDSServer_WriteDataByIdentifier_NRC31_DIDF186_ExtendedSession_NoSecurityLevel_36211");
  testCaseComment("Actions");
  TestStep("1","Send request 10 03 to enter Extended Diagnostic Session");
	SendDiag_Request_Verify_Response(DiagAnchor3,"10 03","50 03 00 32 01 F4");
  TestStep("2","Send request 2E F1 86 00 to WriteDataByIdentifier");
	SendDiag_Request_Verify_Negative_Response(DiagAnchor3,"2E F1 86 00","7F 2E 31");
  PostCondition_Anchor( );
  }
  
  
testcase TCS_PK_FCA_AnchorUDSServer_WriteDataByIdentifier_NRC31_DIDF188_ExtendedSession_NoSecurityLevel_36188()
{
  PreCondition_Anchor("TCS_PK_FCA_AnchorUDSServer_WriteDataByIdentifier_NRC31_DIDF188_ExtendedSession_NoSecurityLevel_36188");
  testCaseComment("Actions");
  TestStep("1","Send request 10 03 to enter Extended Diagnostic Session");
	SendDiag_Request_Verify_Response(DiagAnchor3,"10 03","50 03 00 32 01 F4");
  TestStep("2","Send request 2E F1 88 00 to WriteDataByIdentifier");
	SendDiag_Request_Verify_Negative_Response(DiagAnchor3,"2E F1 88 00","7F 2E 31");
  PostCondition_Anchor( );
  }

testcase TCS_PK_FCA_AnchorUDSServer_WriteDataByIdentifier_NRC31_DIDF18C_ExtendedSession_NoSecurityLevel_36223()
{
  PreCondition_Anchor("TCS_PK_FCA_AnchorUDSServer_WriteDataByIdentifier_NRC31_DIDF18C_ExtendedSession_NoSecurityLevel_36223");
  testCaseComment("Actions");
  TestStep("1","Send request 10 03 to enter Extended Diagnostic Session");
	SendDiag_Request_Verify_Response(DiagAnchor3,"10 03","50 03 00 32 01 F4");
  TestStep("2","Send request 2E F1 8C 00 to WriteDataByIdentifier");
	SendDiag_Request_Verify_Negative_Response(DiagAnchor3,"2E F1 8C 00","7F 2E 31");
  PostCondition_Anchor( );
  }
  
testcase TCS_PK_FCA_AnchorUDSServer_WriteDataByIdentifier_NRC31_DIDF192_ExtendedSession_36229()
{
  PreCondition_Anchor("TCS_PK_FCA_AnchorUDSServer_WriteDataByIdentifier_NRC31_DIDF192_ExtendedSession_36229");
  testCaseComment("Actions");
  TestStep("1","Send request 10 03 to enter Extended Diagnostic Session");
	SendDiag_Request_Verify_Response(DiagAnchor3,"10 03","50 03 00 32 01 F4");
  TestStep("2","Send request 2E F1 92 00 to WriteDataByIdentifier");
	SendDiag_Request_Verify_Negative_Response(DiagAnchor3,"2E F1 92 00","7F 2E 31");
  PostCondition_Anchor( );
  }
  
testcase TCS_PK_FCA_AnchorUDSServer_WriteDataByIdentifier_NRC31_DIDF195_ExtendedSession_NoSecurityLevel_36247()
{
  PreCondition_Anchor("TCS_PK_FCA_AnchorUDSServer_WriteDataByIdentifier_NRC31_DIDF195_ExtendedSession_NoSecurityLevel_36247");
  testCaseComment("Actions");
  TestStep("1","Send request 10 03 to enter Extended Diagnostic Session");
	SendDiag_Request_Verify_Response(DiagAnchor3,"10 03","50 03 00 32 01 F4");
  TestStep("2","Send request 2E F1 95 00 to WriteDataByIdentifier");
	SendDiag_Request_Verify_Negative_Response(DiagAnchor3,"2E F1 95 00","7F 2E 31");
  PostCondition_Anchor( );
  }
  
testcase TCS_PK_FCA_AnchorUDSServer_WriteDataByIdentifier_NRC31_DIDFE05_ExtendedSession_NoSecurityLevel_36216()
{
  PreCondition_Anchor("TCS_PK_FCA_AnchorUDSServer_WriteDataByIdentifier_NRC31_DIDFE05_ExtendedSession_NoSecurityLevel_36216");
  testCaseComment("Actions");
  TestStep("1","Send request 10 03 to enter Extended Diagnostic Session");
	SendDiag_Request_Verify_Response(DiagAnchor3,"10 03","50 03 00 32 01 F4");
  TestStep("2","Send request 2E FE 05 00 to WriteDataByIdentifier");
	SendDiag_Request_Verify_Negative_Response(DiagAnchor3,"2E FE 05 00","7F 2E 31");
  PostCondition_Anchor( );
  }
  
testcase TCS_PK_FCA_AnchorUDSServer_WriteDataByIdentifier_NRC31_DIDFE06_ExtendedSession_NoSecurityLevel_36253()
{
  PreCondition_Anchor("TCS_PK_FCA_AnchorUDSServer_WriteDataByIdentifier_NRC31_DIDFE06_ExtendedSession_NoSecurityLevel_36253");
  testCaseComment("Actions");
  TestStep("1","Send request 10 03 to enter Extended Diagnostic Session");
	SendDiag_Request_Verify_Response(DiagAnchor3,"10 03","50 03 00 32 01 F4");
  TestStep("2","Send request 2E FE 06 00 to WriteDataByIdentifier");
	SendDiag_Request_Verify_Negative_Response(DiagAnchor3,"2E FE 06 00","7F 2E 31");
  PostCondition_Anchor( );
  }

testcase TCS_PK_FCA_AnchorUDSServer_WriteDataByIdentifier_NRC31_DIDFE08_ExtendedSession_NoSecurityLevel_36265()
{
  PreCondition_Anchor("TCS_PK_FCA_AnchorUDSServer_WriteDataByIdentifier_NRC31_DIDFE08_ExtendedSession_NoSecurityLevel_36265");
  testCaseComment("Actions");
  TestStep("1","Send request 10 03 to enter Extended Diagnostic Session");
	SendDiag_Request_Verify_Response(DiagAnchor3,"10 03","50 03 00 32 01 F4");
  TestStep("2","Send request 2E FE 08 00 to WriteDataByIdentifier");
	SendDiag_Request_Verify_Negative_Response(DiagAnchor3,"2E FE 08 00","7F 2E 31");
  PostCondition_Anchor( );
  }
  
testcase TCS_PK_FCA_AnchorUDSServer_WriteDataByIdentifier_NRC31_DIDFE0E_ExtendedSession_NoSecurityLevel_36277()
{
  PreCondition_Anchor("TCS_PK_FCA_AnchorUDSServer_WriteDataByIdentifier_NRC31_DIDFE0E_ExtendedSession_NoSecurityLevel_36277");
  testCaseComment("Actions");
  TestStep("1","Send request 10 03 to enter Extended Diagnostic Session");
	SendDiag_Request_Verify_Response(DiagAnchor3,"10 03","50 03 00 32 01 F4");
  TestStep("2","Send request 2E FE 0E 00 to WriteDataByIdentifier");
	SendDiag_Request_Verify_Negative_Response(DiagAnchor3,"2E FE 0E 00","7F 2E 31");
  PostCondition_Anchor( );
  }
  
testcase TCS_PK_FCA_AnchorUDSServer_WriteDataByIdentifier_NRC31_DIDFE11_ExtendedSession_NoSecurityLevel_36271()
{
  PreCondition_Anchor("TCS_PK_FCA_AnchorUDSServer_WriteDataByIdentifier_NRC31_DIDFE11_ExtendedSession_NoSecurityLevel_36271");
  testCaseComment("Actions");
  TestStep("1","Send request 10 03 to enter Extended Diagnostic Session");
	SendDiag_Request_Verify_Response(DiagAnchor3,"10 03","50 03 00 32 01 F4");
  TestStep("2","Send request 2E FE 11 00 to WriteDataByIdentifier");
	SendDiag_Request_Verify_Negative_Response(DiagAnchor3,"2E FE 11 00","7F 2E 31");
  PostCondition_Anchor( );
  }
  
testcase TCS_PK_FCA_AnchorUDSServer_WriteDataByIdentifier_NRC31_DIDFE13_ExtendedSession_NoSecurityLevel_36292()
{
  PreCondition_Anchor("TCS_PK_FCA_AnchorUDSServer_WriteDataByIdentifier_NRC31_DIDFE13_ExtendedSession_NoSecurityLevel_36292");
  testCaseComment("Actions");
  TestStep("1","Send request 10 03 to enter Extended Diagnostic Session");
	SendDiag_Request_Verify_Response(DiagAnchor3,"10 03","50 03 00 32 01 F4");
  TestStep("2","Send request 2E FE 13 00 to WriteDataByIdentifier");
	SendDiag_Request_Verify_Negative_Response(DiagAnchor3,"2E FE 13 00","7F 2E 31");
  PostCondition_Anchor( );
  }
  
testcase TCS_PK_FCA_AnchorUDSServer_WriteDataByIdentifier_NRC31_DIDFE14_ExtendedSession_NoSecurityLevel_36298()
{
  PreCondition_Anchor("TCS_PK_FCA_AnchorUDSServer_WriteDataByIdentifier_NRC31_DIDFE14_ExtendedSession_NoSecurityLevel_36298");
  testCaseComment("Actions");
  TestStep("1","Send request 10 03 to enter Extended Diagnostic Session");
	SendDiag_Request_Verify_Response(DiagAnchor3,"10 03","50 03 00 32 01 F4");
  TestStep("2","Send request 2E FE 14 00 to WriteDataByIdentifier");
	SendDiag_Request_Verify_Negative_Response(DiagAnchor3,"2E FE 14 00","7F 2E 31");
  PostCondition_Anchor( );
  }
  
testcase TCS_PK_FCA_AnchorUDSServer_WriteDataByIdentifier_NRC31_DIDFE1A_ExtendedSession_NoSecurityLevel_36283()
{
  PreCondition_Anchor("TCS_PK_FCA_AnchorUDSServer_WriteDataByIdentifier_NRC31_DIDFE1A_ExtendedSession_NoSecurityLevel_36283");
  testCaseComment("Actions");
  TestStep("1","Send request 10 03 to enter Extended Diagnostic Session");
	SendDiag_Request_Verify_Response(DiagAnchor3,"10 03","50 03 00 32 01 F4");
  TestStep("2","Send request 2E FE 1A 00 to WriteDataByIdentifier");
	SendDiag_Request_Verify_Negative_Response(DiagAnchor3,"2E FE 1A 00","7F 2E 31");
  PostCondition_Anchor( );
  }
  
testcase TCS_PK_FCA_AnchorUDSServer_WriteDataByIdentifier_NRC31_DIDFE1C_ExtendedSession_NoSecurityLevel_36322()
{
  PreCondition_Anchor("TCS_PK_FCA_AnchorUDSServer_WriteDataByIdentifier_NRC31_DIDFE1C_ExtendedSession_NoSecurityLevel_36322");
  testCaseComment("Actions");
  TestStep("1","Send request 10 03 to enter Extended Diagnostic Session");
	SendDiag_Request_Verify_Response(DiagAnchor3,"10 03","50 03 00 32 01 F4");
  TestStep("2","Send request 2E FE 1C 00 to WriteDataByIdentifier");
	SendDiag_Request_Verify_Negative_Response(DiagAnchor3,"2E FE 1C 00","7F 2E 31");
  PostCondition_Anchor( );
  }
  
testcase TCS_PK_FCA_AnchorUDSServer_WriteDataByIdentifier_NRC31_DIDFE25_ExtendedSession_NoSecurityLevel_36328()
{
  PreCondition_Anchor("TCS_PK_FCA_AnchorUDSServer_WriteDataByIdentifier_NRC31_DIDFE25_ExtendedSession_NoSecurityLevel_36328");
  testCaseComment("Actions");
  TestStep("1","Send request 10 03 to enter Extended Diagnostic Session");
	SendDiag_Request_Verify_Response(DiagAnchor3,"10 03","50 03 00 32 01 F4");
  TestStep("2","Send request 2E FE 25 00 to WriteDataByIdentifier");
	SendDiag_Request_Verify_Negative_Response(DiagAnchor3,"2E FE 25 00","7F 2E 31");
  PostCondition_Anchor( );
  }
  
testcase TCS_PK_FCA_AnchorUDSServer_WriteDataByIdentifier_NRC31_DIDFE26_ExtendedSession_NoSecurityLevel_36340()
{
  PreCondition_Anchor(" TCS_PK_FCA_AnchorUDSServer_WriteDataByIdentifier_NRC31_DIDFE26_ExtendedSession_NoSecurityLevel_36340");
  testCaseComment("Actions");
  TestStep("1","Send request 10 03 to enter Extended Diagnostic Session");
	SendDiag_Request_Verify_Response(DiagAnchor3,"10 03","50 03 00 32 01 F4");
  TestStep("2","Send request 2E FE 26 00 to WriteDataByIdentifier");
	SendDiag_Request_Verify_Negative_Response(DiagAnchor3,"2E FE 26 00","7F 2E 31");
  PostCondition_Anchor( );
  }
  
testcase TCS_PK_FCA_AnchorUDSServer_WriteDataByIdentifier_NRC31_DIDFE27_ExtendedSession_NoSecurityLevel_36304()
{
  PreCondition_Anchor("TCS_PK_FCA_AnchorUDSServer_WriteDataByIdentifier_NRC31_DIDFE27_ExtendedSession_NoSecurityLevel_36304");
  testCaseComment("Actions");
  TestStep("1","Send request 10 03 to enter Extended Diagnostic Session");
	SendDiag_Request_Verify_Response(DiagAnchor3,"10 03","50 03 00 32 01 F4");
  TestStep("2","Send request 2E FE 27 00 to WriteDataByIdentifier");
	SendDiag_Request_Verify_Negative_Response(DiagAnchor3,"2E FE 27 00","7F 2E 31");
  PostCondition_Anchor( );
  }
  
testcase TCS_PK_FCA_AnchorUDSServer_WriteDataByIdentifier_NRC31_DIDFE30_ExtendedSession_NoSecurityLevel_36364()
{
  PreCondition_Anchor("TCS_PK_FCA_AnchorUDSServer_WriteDataByIdentifier_NRC31_DIDFE30_ExtendedSession_NoSecurityLevel_36364");
  testCaseComment("Actions");
  TestStep("1","Send request 10 03 to enter Extended Diagnostic Session");
	SendDiag_Request_Verify_Response(DiagAnchor3,"10 03","50 03 00 32 01 F4");
  TestStep("2","Send request 2E FE 30 00 to WriteDataByIdentifier");
	SendDiag_Request_Verify_Negative_Response(DiagAnchor3,"2E FE 30 00","7F 2E 31");
  PostCondition_Anchor( );
  }
  
testcase TCS_PK_FCA_AnchorUDSServer_WriteDataByIdentifier_NRC31_DIDFE33_ExtendedSession_NoSecurityLevel_36382()
{
  PreCondition_Anchor("TCS_PK_FCA_AnchorUDSServer_WriteDataByIdentifier_NRC31_DIDFE33_ExtendedSession_NoSecurityLevel_36382");
  testCaseComment("Actions");
  TestStep("1","Send request 10 03 to enter Extended Diagnostic Session");
	SendDiag_Request_Verify_Response(DiagAnchor3,"10 03","50 03 00 32 01 F4");
  TestStep("2","Send request 2E FE 33 00 to WriteDataByIdentifier");
	SendDiag_Request_Verify_Negative_Response(DiagAnchor3,"2E FE 33 00","7F 2E 31");
  PostCondition_Anchor( );
  }
  
testcase TCS_PK_FCA_AnchorUDSServer_WriteDataByIdentifier_NRC31_DIDFE34_ExtendedSession_NoSecurityLevel_36352()
{
  PreCondition_Anchor("TCS_PK_FCA_AnchorUDSServer_WriteDataByIdentifier_NRC31_DIDFE34_ExtendedSession_NoSecurityLevel_36352");
  testCaseComment("Actions");
  TestStep("1","Send request 10 03 to enter Extended Diagnostic Session");
	SendDiag_Request_Verify_Response(DiagAnchor3,"10 03","50 03 00 32 01 F4");
  TestStep("2","Send request 2E FE 34 00 to WriteDataByIdentifier");
	SendDiag_Request_Verify_Negative_Response(DiagAnchor3,"2E FE 34 00","7F 2E 31");
  PostCondition_Anchor( );
  }
  
testcase TCS_PK_FCA_AnchorUDSServer_WriteDataByIdentifier_NRC31_DIDFE35_ExtendedSession_NoSecurityLevel_36346()
{ 
  PreCondition_Anchor("TCS_PK_FCA_AnchorUDSServer_WriteDataByIdentifier_NRC31_DIDFE35_ExtendedSession_NoSecurityLevel_36346");
  testCaseComment("Actions");
  TestStep("1","Send request 10 03 to enter Extended Diagnostic Session");
	SendDiag_Request_Verify_Response(DiagAnchor3,"10 03","50 03 00 32 01 F4");
  TestStep("2","Send request 2E FE 35 00 to WriteDataByIdentifier");
	SendDiag_Request_Verify_Negative_Response(DiagAnchor3,"2E FE 35 00","7F 2E 31");
  PostCondition_Anchor( );
  }
  
testcase TCS_PK_FCA_AnchorUDSServer_WriteDataByIdentifier_NRC31_DIDFE40_ExtendedSession_NoSecurityLevel_36395()
{
  PreCondition_Anchor("TCS_PK_FCA_AnchorUDSServer_WriteDataByIdentifier_NRC31_DIDFE40_ExtendedSession_NoSecurityLevel_36395");
  testCaseComment("Actions");
  TestStep("1","Send request 10 03 to enter Extended Diagnostic Session");
	SendDiag_Request_Verify_Response(DiagAnchor3,"10 03","50 03 00 32 01 F4");
  TestStep("2","Send request 2E FE 40 00 to WriteDataByIdentifier");
	SendDiag_Request_Verify_Negative_Response(DiagAnchor3,"2E FE 40 00","7F 2E 31");
  PostCondition_Anchor( );
  }
  
testcase TCS_PK_FCA_AnchorUDSServer_WriteDataByIdentifier_NRC31_DIDFE43_ExtendedSession_NoSecurityLevel_36400()
{ 
  PreCondition_Anchor("TCS_PK_FCA_AnchorUDSServer_WriteDataByIdentifier_NRC31_DIDFE43_ExtendedSession_NoSecurityLevel_36400");
  testCaseComment("Actions");
  TestStep("1","Send request 10 03 to enter Extended Diagnostic Session");
	SendDiag_Request_Verify_Response(DiagAnchor3,"10 03","50 03 00 32 01 F4");
  TestStep("2","Send request 2E FE 43 00 to WriteDataByIdentifier");
	SendDiag_Request_Verify_Negative_Response(DiagAnchor3,"2E FE 43 00","7F 2E 31");
  PostCondition_Anchor( );
  }
  
testcase TCS_PK_FCA_AnchorUDSServer_WriteDataByIdentifier_NRC31_DIDFE60_ExtendedSession_36389()
{
  PreCondition_Anchor("TCS_PK_FCA_AnchorUDSServer_WriteDataByIdentifier_NRC31_DIDFE60_ExtendedSession_36389");
  testCaseComment("Actions");
  TestStep("1","Send request 10 03 to enter Extended Diagnostic Session");
	SendDiag_Request_Verify_Response(DiagAnchor3,"10 03","50 03 00 32 01 F4");
  TestStep("2","Send request 2E FE 60 00 to WriteDataByIdentifier");
	SendDiag_Request_Verify_Negative_Response(DiagAnchor3,"2E FE 60 00","7F 2E 31");
  PostCondition_Anchor( );
  }
  
testcase TCS_PK_FCA_AnchorUDSServer_WriteDataByIdentifier_NRC31_DIDFED8_ExtendedSession_NoSecurityLevel_35083()
{
  PreCondition_Anchor("TCS_PK_FCA_AnchorUDSServer_WriteDataByIdentifier_NRC31_DIDFED8_ExtendedSession_NoSecurityLevel_35083");
  testCaseComment("Actions");
  TestStep("1","Send request 10 03 to enter Extended Diagnostic Session");
	SendDiag_Request_Verify_Response(DiagAnchor3,"10 03","50 03 00 32 01 F4");
  TestStep("2","Send request 2E FE D8 00 to WriteDataByIdentifier");
	SendDiag_Request_Verify_Negative_Response(DiagAnchor3,"2E FE D8 00","7F 2E 31");
  PostCondition_Anchor( );
  }
  
testcase TCS_PK_FCA_AnchorUDSServer_WriteDataByIdentifier_NRC31_DIDFEE0_ExtendedSession_NoSecurityLevel_35113()
{
  PreCondition_Anchor("TCS_PK_FCA_AnchorUDSServer_WriteDataByIdentifier_NRC31_DIDFEE0_ExtendedSession_NoSecurityLevel_35113");
  testCaseComment("Actions");
  TestStep("1","Send request 10 03 to enter Extended Diagnostic Session");
	SendDiag_Request_Verify_Response(DiagAnchor3,"10 03","50 03 00 32 01 F4");
  TestStep("2","Send request 2E FE E0 00 to WriteDataByIdentifier");
	SendDiag_Request_Verify_Negative_Response(DiagAnchor3,"2E FE E0 00","7F 2E 31");
  PostCondition_Anchor( );
  }
  
testcase TCS_PK_FCA_AnchorUDSServer_WriteDataByIdentifier_NRC31_DIDFEE1_ExtendedSession_NoSecurityLevel_35119()
{
  PreCondition_Anchor("TCS_PK_FCA_AnchorUDSServer_WriteDataByIdentifier_NRC31_DIDFEE1_ExtendedSession_NoSecurityLevel_35119");
  testCaseComment("Actions");
  TestStep("1","Send request 10 03 to enter Extended Diagnostic Session");
	SendDiag_Request_Verify_Response(DiagAnchor3,"10 03","50 03 00 32 01 F4");
  TestStep("2","Send request 2E FE E1 00 to WriteDataByIdentifier");
	SendDiag_Request_Verify_Negative_Response(DiagAnchor3,"2E FE E1 00","7F 2E 31");
  PostCondition_Anchor( );
  }
  
testcase TCS_PK_FCA_AnchorUDSServer_WriteDataByIdentifier_NRC31_DIDFEFF_XCPEnable_ExtendedSession_0x61SecurityLevel_35133()
{
  PreCondition_Anchor("TCS_PK_FCA_AnchorUDSServer_WriteDataByIdentifier_NRC31_DIDFEFF_XCPEnable_ExtendedSession_0x61SecurityLevel_35133");
  testCaseComment("Actions");
  TestStep("1","Send request 10 03 to enter Extended Diagnostic Session");
	SendDiag_Request_Verify_Response(DiagAnchor3,"10 03","50 03 00 32 01 F4");
  TestStep("2","Send request 2E FE FF 00 to WriteDataByIdentifier");
	SendDiag_Request_Verify_Negative_Response(DiagAnchor3,"2E FE FF 00","7F 2E 31");
  PostCondition_Anchor( );
  }
  
testcase TCS_PK_FCA_AnchorUDSServer_WriteDataByIdentifier_NRC31_UnsupportedDID_ExtendedSession_NoSecurityLevel_35139()
{
  PreCondition_Anchor("TCS_PK_FCA_AnchorUDSServer_WriteDataByIdentifier_NRC31_UnsupportedDID_ExtendedSession_NoSecurityLevel_35139");
  testCaseComment("Actions");
  TestStep("1","Send request 10 03 to enter Extended Diagnostic Session");
	SendDiag_Request_Verify_Response(DiagAnchor3,"10 03","50 03 00 32 01 F4");
  TestStep("2","Send request 2E 00 00 00 to WriteDataByIdentifier");
	SendDiag_Request_Verify_Negative_Response(DiagAnchor3,"2E 00 00 00","7F 2E 31");
  TestStep("3","Send request 2E 00 AA 00 to WriteDataByIdentifier");
	SendDiag_Request_Verify_Negative_Response(DiagAnchor3,"2E 00 AA 00","7F 2E 31");
  TestStep("4","Send request 2E 00 FF 00 to WriteDataByIdentifier");
	SendDiag_Request_Verify_Negative_Response(DiagAnchor3,"2E 00 FF 00","7F 2E 31");
  PostCondition_Anchor( );
  }
  

//////////////////////////////RoutineControl_NRC7F//////////////////////////////////

testcase TCS_PK_FCA_AnchorUDSServer_RoutineControl_NRC7F_DefaultSession_47076()
{
  PreCondition_Anchor("TCS_PK_FCA_AnchorUDSServer_RoutineControl_NRC7F_DefaultSession_47076");
  testCaseComment("Actions");
  TestStep("1","Send request 10 01 to enter Default Diagnostic Session");
	SendDiag_Request_Verify_Response(DiagAnchor3,"10 01","50 01 00 32 01 F4");
  TestStep("2","Send request 31 01 FA 08 05 01 23 45 67 00 01 to Request Routine control services");
	SendDiag_Request_Verify_Negative_Response(DiagAnchor3,"31 01 FA 08 05 01 23 45 67 00 01","7F 31 7F");
  PostCondition_Anchor( );
  }


//////////////////////////WriteDataByIdentifier_NRC7F////////////////////////


testcase TCS_PK_FCA_AnchorUDSServer_WriteDataByIdentifier_NRC7F_DefaultSession_35237()
{
  PreCondition_Anchor("TCS_PK_FCA_AnchorUDSServer_WriteDataByIdentifier_NRC7F_DefaultSession_35237");
  testCaseComment("Actions");
  TestStep("1","Send request 10 01 to enter Default Diagnostic Session");
	SendDiag_Request_Verify_Response(DiagAnchor3,"10 01","50 01 00 32 01 F4");
  TestStep("2","Send request 2E to Request Write data by Idnetifier services");
	SendDiag_Request_Verify_Negative_Response(DiagAnchor3,"2E","7F 2E 7F");
  PostCondition_Anchor( );
  }

testcase TCS_PK_FCA_AnchorUDSServer_WriteDataByIdentifier_NRC7F_ProgrammingSession_NoSecurityLevel_35243()
{
  PreCondition_Anchor("TCS_PK_FCA_AnchorUDSServer_WriteDataByIdentifier_NRC7F_ProgrammingSession_NoSecurityLevel_35243");
  testCaseComment("Actions");
  TestStep("1","Send request 10 01 to enter Default Diagnostic Session");
	SendDiag_Request_Verify_Response(DiagAnchor3,"10 01","50 01 00 32 01 F4");
  TestStep("2","Send request 10 03 to enter Extended Diagnostic Session");
	SendDiag_Request_Verify_Response(DiagAnchor3,"10 03","50 03 00 32 01 F4");
  TestStep("3,4","Send security unlock request 61 and 62");   
    Security_Seed_Key_Access(Anch3,Physical,Bosch);
  TestStep("5","Send request 10 02 to enter Programming Diagnostic Session");
	SendDiag_Request_Verify_Response(DiagAnchor3,"10 02","50 02 00 32 01 F4");
  TestStep("6","Send request 2E to Request Write data by Idnetifier services");
	SendDiag_Request_Verify_Negative_Response(DiagAnchor3,"2E","7F 2E 7F");
  PostCondition_Anchor( );
  }




//////////////////////////SupportedNegativeResponseCodes/////////////////////


testcase TCS_PK_FCA_AnchorUDSServer_SupportedNegativeResponseCodes_NRC10_31353()
{
  PreCondition_Anchor("TCS_PK_FCA_AnchorUDSServer_SupportedNegativeResponseCodes_NRC10_31353");
  testCaseComment("Actions");
  TestStep("1","Send request 10 03 to enter Extended Diagnostic Session");
	SendDiag_Request_Verify_Response(DiagAnchor3,"10 03","50 03 00 32 01 F4");
  TestStep("2,3","Send security unlock request 61 and 62");   
       	Security_Seed_Key_Access(Anch3,Physical,Bosch);
  TestStep("4","Send request 31 01 FB 36 55 55 55 55 55 55 55 55 55 55 55 55 55 55 55 55 55 55 55 55 55 55 55 55 55 55 55 55 55 55 55 55 to Request RoutineControl service");
	SendDiag_Request_Verify_Negative_Response(DiagAnchor3,"31 01 FB 36 55 55 55 55 55 55 55 55 55 55 55 55 55 55 55 55 55 55 55 55 55 55 55 55 55 55 55 55 55 55 55 55","7F 31 10");	
  PostCondition_Anchor( );
  }	
  
testcase TCS_PK_FCA_AnchorUDSServer_SupportedNegativeResponseCodes_NRC11_DefaultSession_32023()
{
  PreCondition_Anchor("TCS_PK_FCA_AnchorUDSServer_SupportedNegativeResponseCodes_NRC11_DefaultSession_32023");
  testCaseComment("Actions");
  testWaitForTimeout(5000);
  TestStep("2","Send request 50 to Request positive response service identifier");
	SendDiag_Request_Verify_Negative_Response(DiagAnchor3,"50","7F 50 11");
  TestStep("3","Send request 51 to Request positive response service identifier");
	SendDiag_Request_Verify_Negative_Response(DiagAnchor3,"51","7F 51 11");
  TestStep("4","Send request 67 to Request positive response service identifier");
	SendDiag_Request_Verify_Negative_Response(DiagAnchor3,"67","7F 67 11");
  TestStep("5","Send request 68 to Request positive response service identifier");
	SendDiag_Request_Verify_Negative_Response(DiagAnchor3,"68","7F 68 11");
  TestStep("6","Send request 7E to Request positive response service identifier");
	SendDiag_Request_Verify_Negative_Response(DiagAnchor3,"7E","7F 7E 11");
  TestStep("7","Send request C3 to Request positive response service identifier");
	SendDiag_Request_Verify_Negative_Response(DiagAnchor3,"C3","7F C3 11");
  TestStep("8","Send request C4 to Request positive response service identifier");
	SendDiag_Request_Verify_Negative_Response(DiagAnchor3,"C4","7F C4 11");
  TestStep("9","Send request C5 to Request positive response service identifier");
	SendDiag_Request_Verify_Negative_Response(DiagAnchor3,"C5","7F C5 11");
  TestStep("10","Send request C6 to Request positive response service identifier");
	SendDiag_Request_Verify_Negative_Response(DiagAnchor3,"C6","7F C6 11");
  TestStep("11","Send request C7 to Request positive response service identifier");
	SendDiag_Request_Verify_Negative_Response(DiagAnchor3,"C7","7F C7 11");
  TestStep("12","Send request 62 to Request positive response service identifier");
	SendDiag_Request_Verify_Negative_Response(DiagAnchor3,"62","7F 62 11");
  TestStep("13","Send request 63 to Request positive response service identifier");
	SendDiag_Request_Verify_Negative_Response(DiagAnchor3,"63","7F 63 11");
  TestStep("14","Send request 64 to Request positive response service identifier");
	SendDiag_Request_Verify_Negative_Response(DiagAnchor3,"64","7F 64 11");
	TestStep("15","Send request 6A to Request positive response service identifier");
	SendDiag_Request_Verify_Negative_Response(DiagAnchor3,"6A","7F 6A 11");
	TestStep("16","Send request 6C to Request positive response service identifier");
	SendDiag_Request_Verify_Negative_Response(DiagAnchor3,"6C","7F 6C 11");
	TestStep("17","Send request 6E to Request positive response service identifier");
	SendDiag_Request_Verify_Negative_Response(DiagAnchor3,"6E","7F 6E 11");
	TestStep("18","Send request 7D to Request positive response service identifier");
	SendDiag_Request_Verify_Negative_Response(DiagAnchor3,"7D","7F 7D 11");
	TestStep("19","Send request 54 to Request positive response service identifier");
	SendDiag_Request_Verify_Negative_Response(DiagAnchor3,"54","7F 54 11");
	TestStep("20","Send request 59 to Request positive response service identifier");
	SendDiag_Request_Verify_Negative_Response(DiagAnchor3,"59","7F 59 11");
	TestStep("21","Send request 6F to Request positive response service identifier");
	SendDiag_Request_Verify_Negative_Response(DiagAnchor3,"6F","7F 6F 11");
	TestStep("22","Send request 71 to Request positive response service identifier");
	SendDiag_Request_Verify_Negative_Response(DiagAnchor3,"71","7F 71 11");
	TestStep("23","Send request 74 to Request positive response service identifier");
	SendDiag_Request_Verify_Negative_Response(DiagAnchor3,"74","7F 74 11");
	TestStep("24","Send request 75 to Request positive response service identifier");
	SendDiag_Request_Verify_Negative_Response(DiagAnchor3,"75","7F 75 11");
	TestStep("25","Send request 76 to Request positive response service identifier");
	SendDiag_Request_Verify_Negative_Response(DiagAnchor3,"76","7F 76 11");
	TestStep("26","Send request 77 to Request positive response service identifier");
	SendDiag_Request_Verify_Negative_Response(DiagAnchor3,"77","7F 77 11");
	TestStep("27","Send request 78 to Request positive response service identifier");
	SendDiag_Request_Verify_Negative_Response(DiagAnchor3,"78","7F 78 11");
	TestStep("28","Send request 7F to Request positive response service identifier");
	SendDiag_Request_Verify_Negative_Response(DiagAnchor3,"7F","7F 7F 11");
	TestStep("29","Send request 00 to Request positive response service identifier");
	SendDiag_Request_Verify_Negative_Response(DiagAnchor3,"00","7F 00 11");
	TestStep("30","Send request AA to Request positive response service identifier");
	SendDiag_Request_Verify_Negative_Response(DiagAnchor3,"AA","7F AA 11");
	TestStep("31","Send request FF to Request positive response service identifier");
	SendDiag_Request_Verify_Negative_Response(DiagAnchor3,"FF","7F FF 11");
	TestStep("32","Send request 83 to Request positive response service identifier");
	SendDiag_Request_Verify_Negative_Response(DiagAnchor3,"83","7F 83 11");
	TestStep("33","Send request 84 to Request positive response service identifier");
	SendDiag_Request_Verify_Negative_Response(DiagAnchor3,"84","7F 84 11");
	TestStep("34","Send request 86 to Request positive response service identifier");
	SendDiag_Request_Verify_Negative_Response(DiagAnchor3,"86","7F 86 11");
	TestStep("35","Send request 87 to Request positive response service identifier");
	SendDiag_Request_Verify_Negative_Response(DiagAnchor3,"87","7F 87 11");
	TestStep("36","Send request 23 to Request positive response service identifier");
	SendDiag_Request_Verify_Negative_Response(DiagAnchor3,"23","7F 23 11");
	TestStep("37","Send request 24 to Request positive response service identifier");
	SendDiag_Request_Verify_Negative_Response(DiagAnchor3,"24","7F 24 11");
	TestStep("38","Send request 2A to Request positive response service identifier");
	SendDiag_Request_Verify_Negative_Response(DiagAnchor3,"2A","7F 2A 11");
	TestStep("39","Send request 2C to Request positive response service identifier");
	SendDiag_Request_Verify_Negative_Response(DiagAnchor3,"2C","7F 2C 11");
	TestStep("40","Send request 3D to Request positive response service identifier");
	SendDiag_Request_Verify_Negative_Response(DiagAnchor3,"3D","7F 3D 11");
	TestStep("41","Send request 35 to Request positive response service identifier");
	SendDiag_Request_Verify_Negative_Response(DiagAnchor3,"35","7F 35 11");
	TestStep("42","Send request 38 to Request positive response service identifier");
	SendDiag_Request_Verify_Negative_Response(DiagAnchor3,"38","7F 38 11");
	PostCondition_Anchor( );
  }	
	
	
	
	
////////////AnchorUDSServer_TesterPresent/////////


testcase TCS_PK_FCA_AnchorUDSServer_TesterPresent_DefaultSession_29555()
{ 
  PreCondition_Anchor("TCS_PK_FCA_AnchorUDSServer_TesterPresent_DefaultSession_29555");
  testCaseComment("Actions");
  TestStep("1","Send request 10 01 to enter Default Diagnostic Session");
	SendDiag_Request_Verify_Response(DiagAnchor3,"10 01","50 01 00 32 01 F4");
  TestStep("2","Send TesterPresent 3E 00 every 4000ms");
	SendDiag_Request_Verify_Response(DiagAnchor3,"3E 00","7E 00");
  PostCondition_Anchor( );
  }
  
testcase TCS_PK_FCA_AnchorUDSServer_TesterPresent_ExtendedSession_0x61SecurityLevel_29549()
{
  PreCondition_Anchor("TCS_PK_FCA_AnchorUDSServer_TesterPresent_ExtendedSession_0x61SecurityLevel_29549");
  testCaseComment("Actions");
  TestStep("1","Send request 10 03 to enter Extended Diagnostic Session");
	SendDiag_Request_Verify_Response(DiagAnchor3,"10 03","50 03 00 32 01 F4");
  TestStep("2,3","Send security unlock request 61 and 62");   
      Security_Seed_Key_Access(Anch3,Physical,Bosch);
  TestStep("4","Send TesterPresent 3E 00 every 4000ms");
	SendDiag_Request_Verify_Response(DiagAnchor3,"3E 00","7E 00");
  PostCondition_Anchor( );
  }
  
testcase TCS_PK_FCA_AnchorUDSServer_TesterPresent_ExtendedSession_0x65SecurityLevel_29573()
{
  PreCondition_Anchor("TCS_PK_FCA_AnchorUDSServer_TesterPresent_ExtendedSession_0x65SecurityLevel_29573");
  testCaseComment("Actions");
  TestStep("1","Send request 10 03 to enter Extended Diagnostic Session");
	SendDiag_Request_Verify_Response(DiagAnchor3,"10 03","50 03 00 32 01 F4");
  TestStep("2,3","Send security unlock request 65 and 66");   
      Security_Seed_Key_Access(Anch3,Physical,Incar_1);
  TestStep("4","Send TesterPresent 3E 00 every 4000ms");
	SendDiag_Request_Verify_Response(DiagAnchor3,"3E 00","7E 00");
  PostCondition_Anchor( );
  }
  
testcase TCS_PK_FCA_AnchorUDSServer_TesterPresent_ExtendedSession_NoSecurityLevel_29579()
{
  PreCondition_Anchor("TCS_PK_FCA_AnchorUDSServer_TesterPresent_ExtendedSession_NoSecurityLevel_29579");
  testCaseComment("Actions");
  TestStep("1","Send request 10 03 to enter Extended Diagnostic Session");
	SendDiag_Request_Verify_Response(DiagAnchor3,"10 03","50 03 00 32 01 F4");
  TestStep("2","Send TesterPresent 3E 00 every 4000ms");
	SendDiag_Request_Verify_Response(DiagAnchor3,"3E 00","7E 00");
  PostCondition_Anchor( );
  }
  
testcase TCS_PK_FCA_AnchorUDSServer_TesterPresent_NRC12_DefaultSession_29592()
{
  PreCondition_Anchor("TCS_PK_FCA_AnchorUDSServer_TesterPresent_NRC12_DefaultSession_29592");
  testCaseComment("Actions");
  TestStep("1","Send request 10 01 to enter Default Diagnostic Session");
	SendDiag_Request_Verify_Response(DiagAnchor3,"10 01","50 01 00 32 01 F4");
  TestStep("2","Send request 3E 01 to enter an invalid sub-function of TesterPresent service");
	SendDiag_Request_Verify_Negative_Response(DiagAnchor3,"3E 01","7F 3E 12");
  TestStep("3","Send request 3E AA to enter an invalid sub-function of TesterPresent service");
	SendDiag_Request_Verify_Negative_Response(DiagAnchor3,"3E AA","7F 3E 12");
  TestStep("4","Send request 3E FF to enter an invalid sub-function of TesterPresent service");
	SendDiag_Request_Verify_Negative_Response(DiagAnchor3,"3E FF","7F 3E 12");
  PostCondition_Anchor( );
  }
  
testcase TCS_PK_FCA_AnchorUDSServer_TesterPresent_NRC12_ExtendedSession_0x61SecurityLevel_29599()
{ 
  PreCondition_Anchor("TCS_PK_FCA_AnchorUDSServer_TesterPresent_NRC12_ExtendedSession_0x61SecurityLevel_29599");
  testCaseComment("Actions");
  TestStep("1","Send request 10 03 to enter Extended Diagnostic Session");
	SendDiag_Request_Verify_Response(DiagAnchor3,"10 03","50 03 00 32 01 F4");
  TestStep("2,3","Send security unlock request 61 and 62");   
      Security_Seed_Key_Access(Anch3,Physical,Bosch);
  TestStep("4","Send request 3E 01 to enter an invalid sub-function of TesterPresent service");
	SendDiag_Request_Verify_Negative_Response(DiagAnchor3,"3E 01","7F 3E 12");
  TestStep("5","Send request 3E AA to enter an invalid sub-function of TesterPresent service");
	SendDiag_Request_Verify_Negative_Response(DiagAnchor3,"3E AA","7F 3E 12");
  TestStep("6","Send request 3E FF to enter an invalid sub-function of TesterPresent service");
	SendDiag_Request_Verify_Negative_Response(DiagAnchor3,"3E FF","7F 3E 12");
  PostCondition_Anchor( );
  }
  
testcase TCS_PK_FCA_AnchorUDS_TesterPresent_NRC12_ExtendedSession_0x65Security_29586()
{
  PreCondition_Anchor("testcaseTCS_PK_FCA_AnchorUDSServer_TesterPresent_NRC12_ExtendedSession_0x65SecurityLevel_29586");
  testCaseComment("Actions");
  TestStep("1","Send request 10 03 to enter Extended Diagnostic Session");
	SendDiag_Request_Verify_Response(DiagAnchor3,"10 03","50 03 00 32 01 F4");
  TestStep("2,3","Send security unlock request 65 and 66");   
      Security_Seed_Key_Access(Anch3,Physical,Incar_1);
  TestStep("4","Send request 3E 01 to enter an invalid sub-function of TesterPresent service");
	SendDiag_Request_Verify_Negative_Response(DiagAnchor3,"3E 01","7F 3E 12");
  TestStep("5","Send request 3E AA to enter an invalid sub-function of TesterPresent service");
	SendDiag_Request_Verify_Negative_Response(DiagAnchor3,"3E AA","7F 3E 12");
  TestStep("6","Send request 3E FF to enter an invalid sub-function of TesterPresent service");
	SendDiag_Request_Verify_Negative_Response(DiagAnchor3,"3E FF","7F 3E 12");
  PostCondition_Anchor( );
  }
  
testcase TCS_PK_FCA_AnchorUDSServer_TesterPresent_NRC12_ExtendedSession_NoSecurityLevel_29617()
{
  PreCondition_Anchor("TCS_PK_FCA_AnchorUDSServer_TesterPresent_NRC12_ExtendedSession_NoSecurityLevel_29617");
  testCaseComment("Actions");
  TestStep("1","Send request 10 03 to enter Extended Diagnostic Session");
	SendDiag_Request_Verify_Response(DiagAnchor3,"10 03","50 03 00 32 01 F4");
  TestStep("2","Send request 3E 01 to enter an invalid sub-function of TesterPresent service");
	SendDiag_Request_Verify_Negative_Response(DiagAnchor3,"3E 01","7F 3E 12");
  TestStep("3","Send request 3E AA to enter an invalid sub-function of TesterPresent service");
	SendDiag_Request_Verify_Negative_Response(DiagAnchor3,"3E AA","7F 3E 12");
  TestStep("4","Send request 3E FF to enter an invalid sub-function of TesterPresent service");
	SendDiag_Request_Verify_Negative_Response(DiagAnchor3,"3E FF","7F 3E 12");
  PostCondition_Anchor( );
  }
  
testcase TCS_PK_FCA_AnchorUDSServer_TesterPresent_NRC12_ProgrammingSession_0x61SecurityLevel_29623()
{
  PreCondition_Anchor("TCS_PK_FCA_AnchorUDSServer_TesterPresent_NRC12_ProgrammingSession_0x61SecurityLevel_29623");
  testCaseComment("Actions");
  TestStep("1","Send request 10 03 to enter Extended Diagnostic Session");
	SendDiag_Request_Verify_Response(DiagAnchor3,"10 03","50 03 00 32 01 F4");
  TestStep("2,3","Send security unlock request 61 and 62");   
      Security_Seed_Key_Access(Anch3,Physical,Bosch);
  TestStep("4","Send request 10 02 to enter Programming Diagnostic Session");
	SendDiag_Request_Verify_Response(DiagAnchor3,"10 02","50 02 00 32 01 F4");
  TestStep("5,6","Send security unlock request 61 and 62");   
      Security_Seed_Key_Access(Anch3,Physical,Bosch);
  TestStep("7","Send request 3E 01 to enter an invalid sub-function of TesterPresent service");
	SendDiag_Request_Verify_Negative_Response(DiagAnchor3,"3E 01","7F 3E 12");
  TestStep("8","Send request 3E AA to enter an invalid sub-function of TesterPresent service");
	SendDiag_Request_Verify_Negative_Response(DiagAnchor3,"3E AA","7F 3E 12");
  TestStep("9","Send request 3E FF to enter an invalid sub-function of TesterPresent service");
	SendDiag_Request_Verify_Negative_Response(DiagAnchor3,"3E FF","7F 3E 12");
  PostCondition_Anchor( );
  }
  
testcase TCS_PK_FCA_AnchorUDSServer_TesterPresent_NRC12_ProgrammingSession_0x65SecurityLevel_29611()
{
  PreCondition_Anchor("TCS_PK_FCA_AnchorUDSServer_TesterPresent_NRC12_ProgrammingSession_0x65SecurityLevel_29611");
  testCaseComment("Actions");
  TestStep("1","Send request 10 03 to enter Extended Diagnostic Session");
	SendDiag_Request_Verify_Response(DiagAnchor3,"10 03","50 03 00 32 01 F4");
  TestStep("2,3","Send security unlock request 61 and 62");   
      Security_Seed_Key_Access(Anch3,Physical,Bosch);
  TestStep("4","Send request 10 02 to enter Programming Diagnostic Session");
	SendDiag_Request_Verify_Response(DiagAnchor3,"10 02","50 02 00 32 01 F4");
  TestStep("5,6","Send security unlock request 65 and 66");   
      Security_Seed_Key_Access(Anch3,Physical,Incar_1);
  TestStep("7","Send request 3E 01 to enter an invalid sub-function of TesterPresent service");
	SendDiag_Request_Verify_Negative_Response(DiagAnchor3,"3E 01","7F 3E 12");
  TestStep("8","Send request 3E AA to enter an invalid sub-function of TesterPresent service");
	SendDiag_Request_Verify_Negative_Response(DiagAnchor3,"3E AA","7F 3E 12");
  TestStep("9","Send request 3E FF to enter an invalid sub-function of TesterPresent service");
	SendDiag_Request_Verify_Negative_Response(DiagAnchor3,"3E FF","7F 3E 12");
  PostCondition_Anchor( );
  }
 
testcase TCS_PK_FCA_AnchorUDSServer_TesterPresent_NRC12_ProgrammingSession_NoSecurityLevel_29635()
{
  PreCondition_Anchor("TCS_PK_FCA_AnchorUDSServer_TesterPresent_NRC12_ProgrammingSession_NoSecurityLevel_29635");
  testCaseComment("Actions");
  TestStep("1","Send request 10 03 to enter Extended Diagnostic Session");
	SendDiag_Request_Verify_Response(DiagAnchor3,"10 03","50 03 00 32 01 F4");
  TestStep("2,3","Send security unlock request 61 and 62");   
      Security_Seed_Key_Access(Anch3,Physical,Bosch);
  TestStep("4","Send request 10 02 to enter Programming Diagnostic Session");
	SendDiag_Request_Verify_Response(DiagAnchor3,"10 02","50 02 00 32 01 F4");
  TestStep("5","Send request 3E 01 to enter an invalid sub-function of TesterPresent service");
	SendDiag_Request_Verify_Negative_Response(DiagAnchor3,"3E 01","7F 3E 12");
  TestStep("6","Send request 3E AA to enter an invalid sub-function of TesterPresent service");
	SendDiag_Request_Verify_Negative_Response(DiagAnchor3,"3E AA","7F 3E 12");
  TestStep("7","Send request 3E FF to enter an invalid sub-function of TesterPresent service");
	SendDiag_Request_Verify_Negative_Response(DiagAnchor3,"3E FF","7F 3E 12");
  PostCondition_Anchor( );
  }
  
testcase TCS_PK_FCA_AnchorUDSServer_TesterPresent_NRC13_DefaultSession_29641()
{
  PreCondition_Anchor("TCS_PK_FCA_AnchorUDSServer_TesterPresent_NRC13_DefaultSession_29641");
  testCaseComment("Actions");
  TestStep("1","Send request 10 01 to enter Default Diagnostic Session");
	SendDiag_Request_Verify_Response(DiagAnchor3,"10 01","50 01 00 32 01 F4");
  TestStep("2","Send request 3E 00 00 to enter TesterPresent service");
	SendDiag_Request_Verify_Negative_Response(DiagAnchor3,"3E 00 00","7F 3E 13");
  TestStep("3","Send request 3E to enter TesterPresent service");
    SendDiag_Request_Verify_Negative_Response(DiagAnchor3,"3E","7F 3E 13");
  PostCondition_Anchor( );
  }
  
testcase TCS_PK_FCA_AnchorUDSServer_TesterPresent_NRC13_ExtendedSession_0x61SecurityLevel_29629()
{
  PreCondition_Anchor("TCS_PK_FCA_AnchorUDSServer_TesterPresent_NRC13_ExtendedSession_0x61SecurityLevel_29629");
  testCaseComment("Actions");
  TestStep("1","Send request 10 03 to enter Extended Diagnostic Session");
	SendDiag_Request_Verify_Response(DiagAnchor3,"10 03","50 03 00 32 01 F4");
  TestStep("2,3","Send security unlock request 61 and 62");   
      Security_Seed_Key_Access(Anch3,Physical,Bosch);
  TestStep("4","Send request 3E 00 00 to enter TesterPresent service");
	SendDiag_Request_Verify_Negative_Response(DiagAnchor3,"3E 00 00","7F 3E 13");
  TestStep("5","Send request 3E to enter TesterPresent service");
    SendDiag_Request_Verify_Negative_Response(DiagAnchor3,"3E","7F 3E 13");
  PostCondition_Anchor( );
  }
  
testcase TCS_PK_FCA_AnchorUDSServer_TesterPresent_NRC13_ExtendedSession_0x65SecurityLevel_29654()
{
  PreCondition_Anchor("TCS_PK_FCA_AnchorUDSServer_TesterPresent_NRC13_ExtendedSession_0x65SecurityLevel_29654");
  testCaseComment("Actions");
  TestStep("1","Send request 10 03 to enter Extended Diagnostic Session");
	SendDiag_Request_Verify_Response(DiagAnchor3,"10 03","50 03 00 32 01 F4");
  TestStep("2,3","Send security unlock request 65 and 66");   
      Security_Seed_Key_Access(Anch3,Physical,Incar_1);
  TestStep("4","Send request 3E 00 00 to enter TesterPresent service");
	SendDiag_Request_Verify_Negative_Response(DiagAnchor3,"3E 00 00","7F 3E 13");
  TestStep("5","Send request 3E to enter TesterPresent service");
    SendDiag_Request_Verify_Negative_Response(DiagAnchor3,"3E","7F 3E 13");
  PostCondition_Anchor( );
  }
  
testcase TCS_PK_FCA_AnchorUDSServer_TesterPresent_NRC13_ExtendedSession_NoSecurityLevel_29666()
{
  PreCondition_Anchor("TCS_PK_FCA_AnchorUDSServer_TesterPresent_NRC13_ExtendedSession_NoSecurityLevel_29666");
  testCaseComment("Actions");
  TestStep("1","Send request 10 03 to enter Extended Diagnostic Session");
	SendDiag_Request_Verify_Response(DiagAnchor3,"10 03","50 03 00 32 01 F4");
  TestStep("2","Send request 3E 00 00 to enter TesterPresent service");
	SendDiag_Request_Verify_Negative_Response(DiagAnchor3,"3E 00 00","7F 3E 13");
  TestStep("3","Send request 3E to enter TesterPresent service");
    SendDiag_Request_Verify_Negative_Response(DiagAnchor3,"3E","7F 3E 13");
  PostCondition_Anchor( );
  }
  
testcase TCS_PK_FCA_AnchorUDSServer_TesterPresent_NRC13_ProgrammingSession_0x61SecurityLevel_29647()
{
  PreCondition_Anchor("TCS_PK_FCA_AnchorUDSServer_TesterPresent_NRC13_ProgrammingSession_0x61SecurityLevel_29647");
  testCaseComment("Actions");
  TestStep("1","Send request 10 03 to enter Extended Diagnostic Session");
	SendDiag_Request_Verify_Response(DiagAnchor3,"10 03","50 03 00 32 01 F4");
  TestStep("2,3","Send security unlock request 61 and 62");   
      Security_Seed_Key_Access(Anch3,Physical,Bosch);
  TestStep("4","Send request 10 02 to enter Programming Diagnostic Session");
	SendDiag_Request_Verify_Response(DiagAnchor3,"10 02","50 02 00 32 01 F4");
  TestStep("5,6","Send security unlock request 61 and 62");   
      Security_Seed_Key_Access(Anch3,Physical,Bosch);
  TestStep("7","Send request 3E 00 00 to enter TesterPresent service");
	SendDiag_Request_Verify_Negative_Response(DiagAnchor3,"3E 00 00","7F 3E 13");
  TestStep("8","Send request 3E to enter TesterPresent service");
    SendDiag_Request_Verify_Negative_Response(DiagAnchor3,"3E","7F 3E 13");
  PostCondition_Anchor( );
  }
  
testcase TCS_PK_FCA_AnchorUDSServer_TesterPresent_NRC13_ProgrammingSession_0x65SecurityLevel_29691()
{
  PreCondition_Anchor("TCS_PK_FCA_AnchorUDSServer_TesterPresent_NRC13_ProgrammingSession_0x65SecurityLevel_29691");
  testCaseComment("Actions");
  TestStep("1","Send request 10 03 to enter Extended Diagnostic Session");
	SendDiag_Request_Verify_Response(DiagAnchor3,"10 03","50 03 00 32 01 F4");
  TestStep("2,3","Send security unlock request 61 and 62");   
      Security_Seed_Key_Access(Anch3,Physical,Bosch);
  TestStep("4","Send request 10 02 to enter Programming Diagnostic Session");
	SendDiag_Request_Verify_Response(DiagAnchor3,"10 02","50 02 00 32 01 F4");
  TestStep("5,6","Send security unlock request 65 and 66");   
      Security_Seed_Key_Access(Anch3,Physical,Incar_1);
  TestStep("7","Send request 3E 00 00 to enter TesterPresent service");
	SendDiag_Request_Verify_Negative_Response(DiagAnchor3,"3E 00 00","7F 3E 13");
  TestStep("8","Send request 3E to enter TesterPresent service");
    SendDiag_Request_Verify_Negative_Response(DiagAnchor3,"3E","7F 3E 13");
  PostCondition_Anchor( );
  }
 
testcase TCS_PK_FCA_AnchorUDSServer_TesterPresent_NRC13_ProgrammingSession_NoSecurityLevel_29697()
{
  PreCondition_Anchor("TCS_PK_FCA_AnchorUDSServer_TesterPresent_NRC13_ProgrammingSession_NoSecurityLevel_29697");
  testCaseComment("Actions");
  TestStep("1","Send request 10 03 to enter Extended Diagnostic Session");
	SendDiag_Request_Verify_Response(DiagAnchor3,"10 03","50 03 00 32 01 F4");
  TestStep("2,3","Send security unlock request 61 and 62");   
      Security_Seed_Key_Access(Anch3,Physical,Bosch);
  TestStep("4","Send request 10 02 to enter Programming Diagnostic Session");
	SendDiag_Request_Verify_Response(DiagAnchor3,"10 02","50 02 00 32 01 F4");
  TestStep("5","Send request 3E 00 00 to enter TesterPresent service");
	SendDiag_Request_Verify_Negative_Response(DiagAnchor3,"3E 00 00","7F 3E 13");
  TestStep("6","Send request 3E to enter TesterPresent service");
    SendDiag_Request_Verify_Negative_Response(DiagAnchor3,"3E","7F 3E 13");
  PostCondition_Anchor( );
  }
  
testcase TCS_PK_FCA_AnchorUDSServer_TesterPresent_ProgrammingSession_0x61SecurityLevel_29679()
{
  PreCondition_Anchor("TCS_PK_FCA_AnchorUDSServer_TesterPresent_ProgrammingSession_0x61SecurityLevel_29679");
  testCaseComment("Actions");
  TestStep("1","Send request 10 03 to enter Extended Diagnostic Session");
	SendDiag_Request_Verify_Response(DiagAnchor3,"10 03","50 03 00 32 01 F4");
  TestStep("2,3","Send security unlock request 61 and 62");   
      Security_Seed_Key_Access(Anch3,Physical,Bosch);
  TestStep("4","Send request 10 02 to enter Programming Diagnostic Session");
	SendDiag_Request_Verify_Response(DiagAnchor3,"10 02","50 02 00 32 01 F4");
  TestStep("5,6","Send security unlock request 61 and 62");   
      Security_Seed_Key_Access(Anch3,Physical,Bosch);
  TestStep("7","Send TesterPresent 3E 00 every 4000ms");
	SendDiag_Request_Verify_Response(DiagAnchor3,"3E 00","7E 00");
  PostCondition_Anchor( );
  }
  
testcase TCS_PK_FCA_AnchorUDSServer_TesterPresent_ProgrammingSession_0x65SecurityLevel_29702()
{
  PreCondition_Anchor("TCS_PK_FCA_AnchorUDSServer_TesterPresent_ProgrammingSession_0x65SecurityLevel_29702");
  testCaseComment("Actions");
  TestStep("1","Send request 10 03 to enter Extended Diagnostic Session");
	SendDiag_Request_Verify_Response(DiagAnchor3,"10 03","50 03 00 32 01 F4");
  TestStep("2,3","Send security unlock request 61 and 62");   
      Security_Seed_Key_Access(Anch3,Physical,Bosch);
  TestStep("4","Send request 10 02 to enter Programming Diagnostic Session");
	SendDiag_Request_Verify_Response(DiagAnchor3,"10 02","50 02 00 32 01 F4");
  TestStep("5,6","Send security unlock request 65 and 66");   
      Security_Seed_Key_Access(Anch3,Physical,Incar_1);
  TestStep("7","Send TesterPresent 3E 00 every 4000ms");
	SendDiag_Request_Verify_Response(DiagAnchor3,"3E 00","7E 00");
  PostCondition_Anchor( );
  }
  
testcase TCS_PK_FCA_AnchorUDSServer_TesterPresent_ProgrammingSession_NoSecurityLevel_29714()
{ 
  PreCondition_Anchor("TCS_PK_FCA_AnchorUDSServer_TesterPresent_ProgrammingSession_NoSecurityLevel_29714");
  testCaseComment("Actions");
 TestStep("1","Send request 10 03 to enter Extended Diagnostic Session");
	SendDiag_Request_Verify_Response(DiagAnchor3,"10 03","50 03 00 32 01 F4");
  TestStep("2,3","Send security unlock request 61 and 62");   
      Security_Seed_Key_Access(Anch3,Physical,Bosch);
  TestStep("4","Send request 10 02 to enter Programming Diagnostic Session");
	SendDiag_Request_Verify_Response(DiagAnchor3,"10 02","50 02 00 32 01 F4");
  TestStep("5","Send TesterPresent 3E 00 every 4000ms");
	SendDiag_Request_Verify_Response(DiagAnchor3,"3E 00","7E 00");
  PostCondition_Anchor( );
  }
  


//////////////////////AnchorUDSServer_ECUReset////////////////////////


testcase TCS_PK_FCA_AnchorUDSServer_ECUReset_DefaultSession_37972()
{
  PreCondition_Anchor("TCS_PK_FCA_AnchorUDSServer_ECUReset_DefaultSession_37972");
  testCaseComment("Actions");
  TestStep("1","Send request 10 01 to enter Default Diagnostic Session");
	SendDiag_Request_Verify_Response(DiagAnchor3,"10 01","50 01 00 32 01 F4");
  TestStep("2","Send request 11 01 to enter ECU Reset");
	SendDiag_Request_Verify_Response(DiagAnchor3,"11 01","51 01");
  PostCondition_Anchor( );
  }
  
testcase TCS_PK_FCA_AnchorUDSServer_ECUReset_ExtendedSession_0x61SecurityLevel_37984()
{
  PreCondition_Anchor("TCS_PK_FCA_AnchorUDSServer_ECUReset_ExtendedSession_0x61SecurityLevel_37984");
  testCaseComment("Actions");
  TestStep("1","Send request 10 03 to enter Extended Diagnostic Session");
	SendDiag_Request_Verify_Response(DiagAnchor3,"10 03","50 03 00 32 01 F4");
  TestStep("2,3","Send security unlock request 61 and 62");   
      Security_Seed_Key_Access(Anch3,Physical,Bosch);
  TestStep("4","Send request 11 01 to enter ECU Reset");
	SendDiag_Request_Verify_Response(DiagAnchor3,"11 01","51 01");
  PostCondition_Anchor( );
  }

testcase TCS_PK_FCA_AnchorUDSServer_ECUReset_ExtendedSession_0x65SecurityLevel_37990()
{
  PreCondition_Anchor("TCS_PK_FCA_AnchorUDSServer_ECUReset_ExtendedSession_0x65SecurityLevel_37990");
  testCaseComment("Actions");
  TestStep("1","Send request 10 03 to enter Extended Diagnostic Session");
	SendDiag_Request_Verify_Response(DiagAnchor3,"10 03","50 03 00 32 01 F4");
  TestStep("2,3","Send security unlock request 65 and 66");   
      Security_Seed_Key_Access(Anch3,Physical,Incar_1);
  TestStep("4","Send request 11 01 to enter ECU Reset");
	SendDiag_Request_Verify_Response(DiagAnchor3,"11 01","51 01");
  PostCondition_Anchor( );
  }

testcase TCS_PK_FCA_AnchorUDSServer_ECUReset_ExtendedSession_NoSecurityLevel_37999()
{
  PreCondition_Anchor("TCS_PK_FCA_AnchorUDSServer_ECUReset_ExtendedSession_NoSecurityLevel_37999");
  testCaseComment("Actions");
  TestStep("1","Send request 10 03 to enter Extended Diagnostic Session");
	SendDiag_Request_Verify_Response(DiagAnchor3,"10 03","50 03 00 32 01 F4");
  TestStep("2","Send request 11 01 to enter ECU Reset");
	SendDiag_Request_Verify_Response(DiagAnchor3,"11 01","51 01");
  PostCondition_Anchor( );
  }
  
testcase TCS_PK_FCA_AnchorUDSServer_ECUReset_NRC12_DefaultSession_38016()
{
  PreCondition_Anchor("TCS_PK_FCA_AnchorUDSServer_ECUReset_NRC12_DefaultSession_38016");
  testCaseComment("Actions");
  TestStep("1","Send request 10 01 to enter Default Diagnostic Session");
	SendDiag_Request_Verify_Response(DiagAnchor3,"10 01","50 01 00 32 01 F4");
  TestStep("2","Send request 11 00 to an invalid sub-function of the ECUReset service");
	SendDiag_Request_Verify_Negative_Response(DiagAnchor3,"11 00","7F 11 12");
  TestStep("3","Send request 11 02 to an invalid sub-function of the ECUReset service");
	SendDiag_Request_Verify_Negative_Response(DiagAnchor3,"11 02","7F 11 12");
  TestStep("4","Send request 11 AA to an invalid sub-function of the ECUReset service");
	SendDiag_Request_Verify_Negative_Response(DiagAnchor3,"11 AA","7F 11 12");
  TestStep("5","Send request 11 FF to an invalid sub-function of the ECUReset service");
	SendDiag_Request_Verify_Negative_Response(DiagAnchor3,"11 FF","7F 11 12");
  PostCondition_Anchor( );
  }
  
testcase TCS_PK_FCA_AnchorUDSServer_ECUReset_NRC12_ExtendedSession_0x61SecurityLevel_38022()
{
  PreCondition_Anchor("TCS_PK_FCA_AnchorUDSServer_ECUReset_NRC12_ExtendedSession_0x61SecurityLevel_38022");
  testCaseComment("Actions");
  TestStep("1","Send request 10 03 to enter Extended Diagnostic Session");
	SendDiag_Request_Verify_Response(DiagAnchor3,"10 03","50 03 00 32 01 F4");
  TestStep("2,3","Send security unlock request 61 and 62");   
      Security_Seed_Key_Access(Anch3,Physical,Bosch);
  TestStep("4","Send request 11 00 to an invalid sub-function of the ECUReset service");
	SendDiag_Request_Verify_Negative_Response(DiagAnchor3,"11 00","7F 11 12");
  TestStep("5","Send request 11 02 to an invalid sub-function of the ECUReset service");
	SendDiag_Request_Verify_Negative_Response(DiagAnchor3,"11 02","7F 11 12");
  TestStep("6","Send request 11 AA to an invalid sub-function of the ECUReset service");
	SendDiag_Request_Verify_Negative_Response(DiagAnchor3,"11 AA","7F 11 12");
  TestStep("7","Send request 11 FF to an invalid sub-function of the ECUReset service");
	SendDiag_Request_Verify_Negative_Response(DiagAnchor3,"11 FF","7F 11 12");
  PostCondition_Anchor( );
  }
  
testcase TCS_PK_FCA_AnchorUDSServer_ECUReset_NRC12_ExtendedSession_0x65SecurityLevel_38028()
{
  PreCondition_Anchor("TCS_PK_FCA_AnchorUDSServer_ECUReset_NRC12_ExtendedSession_0x65SecurityLevel_38028");
  testCaseComment("Actions");
  TestStep("1","Send request 10 03 to enter Extended Diagnostic Session");
	SendDiag_Request_Verify_Response(DiagAnchor3,"10 03","50 03 00 32 01 F4");
  TestStep("2,3","Send security unlock request 61 and 62");   
      Security_Seed_Key_Access(Anch3,Physical,Bosch);
  TestStep("4","Send request 11 00 to an invalid sub-function of the ECUReset service");
	SendDiag_Request_Verify_Negative_Response(DiagAnchor3,"11 00","7F 11 12");
  TestStep("5","Send request 11 02 to an invalid sub-function of the ECUReset service");
	SendDiag_Request_Verify_Negative_Response(DiagAnchor3,"11 02","7F 11 12");
  TestStep("6","Send request 11 AA to an invalid sub-function of the ECUReset service");
	SendDiag_Request_Verify_Negative_Response(DiagAnchor3,"11 AA","7F 11 12");
  TestStep("7","Send request 11 FF to an invalid sub-function of the ECUReset service");
	SendDiag_Request_Verify_Negative_Response(DiagAnchor3,"11 FF","7F 11 12");
  PostCondition_Anchor( );
  }
  
testcase TCS_PK_FCA_AnchorUDSServer_ECUReset_NRC12_ExtendedSession_NoSecurityLevel_38042()
{
  PreCondition_Anchor("TCS_PK_FCA_AnchorUDSServer_ECUReset_NRC12_ExtendedSession_NoSecurityLevel_38042");
  testCaseComment("Actions");
  TestStep("1","Send request 10 03 to enter Extended Diagnostic Session");
	SendDiag_Request_Verify_Response(DiagAnchor3,"10 03","50 03 00 32 01 F4");
  TestStep("2","Send request 11 00 to an invalid sub-function of the ECUReset service");
	SendDiag_Request_Verify_Negative_Response(DiagAnchor3,"11 00","7F 11 12");
  TestStep("3","Send request 11 02 to an invalid sub-function of the ECUReset service");
	SendDiag_Request_Verify_Negative_Response(DiagAnchor3,"11 02","7F 11 12");
  TestStep("4","Send request 11 AA to an invalid sub-function of the ECUReset service");
	SendDiag_Request_Verify_Negative_Response(DiagAnchor3,"11 AA","7F 11 12");
  TestStep("5","Send request 11 FF to an invalid sub-function of the ECUReset service");
	SendDiag_Request_Verify_Negative_Response(DiagAnchor3,"11 FF","7F 11 12");
  PostCondition_Anchor( );
  } 
  
testcase TCS_PK_FCA_AnchorUDSServer_ECUReset_NRC12_ProgrammingSession_0x61SecurityLevel_38034()
{ 
  PreCondition_Anchor("TCS_PK_FCA_AnchorUDSServer_ECUReset_NRC12_ProgrammingSession_0x61SecurityLevel_38034");
  testCaseComment("Actions");
  TestStep("1","Send request 10 03 to enter Extended Diagnostic Session");
	SendDiag_Request_Verify_Response(DiagAnchor3,"10 03","50 03 00 32 01 F4");
  TestStep("2,3","Send security unlock request 61 and 62");   
      Security_Seed_Key_Access(Anch3,Physical,Bosch);
  TestStep("4","Send request 10 02 to enter Progamming Diagnostic Session");
	SendDiag_Request_Verify_Response(DiagAnchor3,"10 02","50 02 00 32 01 F4");
  TestStep("5,6","Send security unlock request 61 and 62");   
      Security_Seed_Key_Access(Anch3,Physical,Bosch);
  TestStep("7","Send request 11 00 to an invalid sub-function of the ECUReset service");
	SendDiag_Request_Verify_Negative_Response(DiagAnchor3,"11 00","7F 11 12");
  TestStep("8","Send request 11 02 to an invalid sub-function of the ECUReset service");
	SendDiag_Request_Verify_Negative_Response(DiagAnchor3,"11 02","7F 11 12");
  TestStep("9","Send request 11 AA to an invalid sub-function of the ECUReset service");
	SendDiag_Request_Verify_Negative_Response(DiagAnchor3,"11 AA","7F 11 12");
  TestStep("10","Send request 11 FF to an invalid sub-function of the ECUReset service");
	SendDiag_Request_Verify_Negative_Response(DiagAnchor3,"11 FF","7F 11 12");
  PostCondition_Anchor( );
  } 
  
testcase TCS_PK_FCA_AnchorUDSServer_ECUReset_NRC12_ProgrammingSession_0x65SecurityLevel_38060()
{
  PreCondition_Anchor("TCS_PK_FCA_AnchorUDSServer_ECUReset_NRC12_ProgrammingSession_0x65SecurityLevel_38060");
  testCaseComment("Actions");
  TestStep("1","Send request 10 03 to enter Extended Diagnostic Session");
	SendDiag_Request_Verify_Response(DiagAnchor3,"10 03","50 03 00 32 01 F4");
  TestStep("2,3","Send security unlock request 61 and 62");   
      Security_Seed_Key_Access(Anch3,Physical,Bosch);
  TestStep("4","Send request 10 02 to enter Progamming Diagnostic Session");
	SendDiag_Request_Verify_Response(DiagAnchor3,"10 02","50 02 00 32 01 F4");
  TestStep("5,6","Send security unlock request 65 and 66");   
      Security_Seed_Key_Access(Anch3,Physical,Incar_1);
  TestStep("7","Send request 11 00 to an invalid sub-function of the ECUReset service");
	SendDiag_Request_Verify_Negative_Response(DiagAnchor3,"11 00","7F 11 12");
  TestStep("8","Send request 11 02 to an invalid sub-function of the ECUReset service");
	SendDiag_Request_Verify_Negative_Response(DiagAnchor3,"11 02","7F 11 12");
  TestStep("9","Send request 11 AA to an invalid sub-function of the ECUReset service");
	SendDiag_Request_Verify_Negative_Response(DiagAnchor3,"11 AA","7F 11 12");
  TestStep("10","Send request 11 FF to an invalid sub-function of the ECUReset service");
	SendDiag_Request_Verify_Negative_Response(DiagAnchor3,"11 FF","7F 11 12");
  PostCondition_Anchor( );
  } 
  
testcase TCS_PK_FCA_AnchorUDSServer_ECUReset_NRC12_ProgrammingSession_NoSecurityLevel_38071()
{
  PreCondition_Anchor("TCS_PK_FCA_AnchorUDSServer_ECUReset_NRC12_ProgrammingSession_NoSecurityLevel_38071");
  testCaseComment("Actions");
  TestStep("1","Send request 10 03 to enter Extended Diagnostic Session");
	SendDiag_Request_Verify_Response(DiagAnchor3,"10 03","50 03 00 32 01 F4");
  TestStep("2,3","Send security unlock request 61 and 62");   
      Security_Seed_Key_Access(Anch3,Physical,Bosch);
  TestStep("4","Send request 10 02 to enter Progamming Diagnostic Session");
	SendDiag_Request_Verify_Response(DiagAnchor3,"10 02","50 02 00 32 01 F4");
  TestStep("5","Send request 11 00 to an invalid sub-function of the ECUReset service");
	SendDiag_Request_Verify_Negative_Response(DiagAnchor3,"11 00","7F 11 12");
  TestStep("6","Send request 11 02 to an invalid sub-function of the ECUReset service");
	SendDiag_Request_Verify_Negative_Response(DiagAnchor3,"11 02","7F 11 12");
  TestStep("7","Send request 11 AA to an invalid sub-function of the ECUReset service");
	SendDiag_Request_Verify_Negative_Response(DiagAnchor3,"11 AA","7F 11 12");
  TestStep("8","Send request 11 FF to an invalid sub-function of the ECUReset service");
	SendDiag_Request_Verify_Negative_Response(DiagAnchor3,"11 FF","7F 11 12");
  PostCondition_Anchor( );
  } 
  
testcase TCS_PK_FCA_AnchorUDSServer_ECUReset_NRC13_DefaultSession_38084()
{
  PreCondition_Anchor("TCS_PK_FCA_AnchorUDSServer_ECUReset_NRC13_DefaultSession_38084");
  testCaseComment("Actions");
  TestStep("1","Send request 10 01 to enter Default Diagnostic Session");
	SendDiag_Request_Verify_Response(DiagAnchor3,"10 01","50 01 00 32 01 F4");
  TestStep("2","Send request 11 00 00 to enter ECUReset service with an Invalid Message Length");
	SendDiag_Request_Verify_Negative_Response(DiagAnchor3,"11 00 00","7F 11 13");
  TestStep("3","Send request 11 to enter ECUReset service");
	SendDiag_Request_Verify_Negative_Response(DiagAnchor3,"11","7F 11 13");
  PostCondition_Anchor( );
  }
  
testcase TCS_PK_FCA_AnchorUDSServer_ECUReset_NRC13_ExtendedSession_0x61SecurityLevel_38090()
{ 
  PreCondition_Anchor("TCS_PK_FCA_AnchorUDSServer_ECUReset_NRC13_ExtendedSession_0x61SecurityLevel_38090");
  testCaseComment("Actions");
  TestStep("1","Send request 10 03 to enter Extended Diagnostic Session");
	SendDiag_Request_Verify_Response(DiagAnchor3,"10 03","50 03 00 32 01 F4");
  TestStep("2,3","Send security unlock request 61 and 62");   
      Security_Seed_Key_Access(Anch3,Physical,Bosch);
  TestStep("4","Send request 11 00 00 to enter ECUReset service with an Invalid Message Length");
	SendDiag_Request_Verify_Negative_Response(DiagAnchor3,"11 00 00","7F 11 13");
  TestStep("5","Send request 11 to enter ECUReset service");
	SendDiag_Request_Verify_Negative_Response(DiagAnchor3,"11","7F 11 13");
  PostCondition_Anchor( );
  }
  
testcase TCS_PK_FCA_AnchorUDSServer_ECUReset_NRC13_ExtendedSession_0x65SecurityLevel_38095()
{ 
  PreCondition_Anchor("TCS_PK_FCA_AnchorUDSServer_ECUReset_NRC13_ExtendedSession_0x65SecurityLevel_38095");
  testCaseComment("Actions");
  TestStep("1","Send request 10 03 to enter Extended Diagnostic Session");
	SendDiag_Request_Verify_Response(DiagAnchor3,"10 03","50 03 00 32 01 F4");
  TestStep("2,3","Send security unlock request 65 and 66");   
      Security_Seed_Key_Access(Anch3,Physical,Incar_1);
  TestStep("4","Send request 11 00 00 to enter ECUReset service with an Invalid Message Length");
	SendDiag_Request_Verify_Negative_Response(DiagAnchor3,"11 00 00","7F 11 13");
  TestStep("5","Send request 11 to enter ECUReset service");
	SendDiag_Request_Verify_Negative_Response(DiagAnchor3,"11","7F 11 13");
  PostCondition_Anchor( );
  }

testcase TCS_PK_FCA_AnchorUDSServer_ECUReset_NRC13_ExtendedSession_NoSecurityLevel_38114()
{  
  PreCondition_Anchor("testcaseTCS_PK_FCA_AnchorUDSServer_ECUReset_NRC13_ExtendedSession_NoSecurityLevel_38114");
  testCaseComment("Actions");
  TestStep("1","Send request 10 03 to enter Extended Diagnostic Session");
	SendDiag_Request_Verify_Response(DiagAnchor3,"10 03","50 03 00 32 01 F4");
  TestStep("2","Send request 11 00 00 to enter ECUReset service with an Invalid Message Length");
	SendDiag_Request_Verify_Negative_Response(DiagAnchor3,"11 00 00","7F 11 13");
  TestStep("3","Send request 11 to enter ECUReset service");
	SendDiag_Request_Verify_Negative_Response(DiagAnchor3,"11","7F 11 13");
  PostCondition_Anchor( );
  }
  
testcase TCS_PK_FCA_AnchorUDSServer_ECUReset_NRC13_ProgrammingSession_0x61SecurityLevel_38120()
{ 
  PreCondition_Anchor("TCS_PK_FCA_AnchorUDSServer_ECUReset_NRC13_ProgrammingSession_0x61SecurityLevel_38120");
  testCaseComment("Actions");
  TestStep("1","Send request 10 03 to enter Extended Diagnostic Session");
	SendDiag_Request_Verify_Response(DiagAnchor3,"10 03","50 03 00 32 01 F4");
  TestStep("2,3","Send security unlock request 61 and 62");   
      Security_Seed_Key_Access(Anch3,Physical,Bosch);
  TestStep("4","Send request 10 02 to enter Progamming Diagnostic Session");
	SendDiag_Request_Verify_Response(DiagAnchor3,"10 02","50 02 00 32 01 F4");
  TestStep("5,6","Send security unlock request 61 and 62");   
      Security_Seed_Key_Access(Anch3,Physical,Bosch);
  TestStep("7","Send request 11 00 00 to enter ECUReset service with an Invalid Message Length");
	SendDiag_Request_Verify_Negative_Response(DiagAnchor3,"11 00 00","7F 11 13");
  TestStep("8","Send request 11 to enter ECUReset service");
	SendDiag_Request_Verify_Negative_Response(DiagAnchor3,"11","7F 11 13");
  PostCondition_Anchor( );
  }
 
 testcase TCS_PK_FCA_AnchorUDSServer_ECUReset_NRC13_ProgrammingSession_0x65SecurityLevel_38102()
 { 
  PreCondition_Anchor("TCS_PK_FCA_AnchorUDSServer_ECUReset_NRC13_ProgrammingSession_0x65SecurityLevel_38102");
  testCaseComment("Actions");
  TestStep("1","Send request 10 03 to enter Extended Diagnostic Session");
	SendDiag_Request_Verify_Response(DiagAnchor3,"10 03","50 03 00 32 01 F4");
  TestStep("2,3","Send security unlock request 61 and 62");   
      Security_Seed_Key_Access(Anch3,Physical,Bosch);
  TestStep("4","Send request 10 02 to enter Progamming Diagnostic Session");
	SendDiag_Request_Verify_Response(DiagAnchor3,"10 02","50 02 00 32 01 F4");
  TestStep("5,6","Send security unlock request 65 and 66");   
      Security_Seed_Key_Access(Anch3,Physical,Incar_1);
  TestStep("7","Send request 11 00 00 to enter ECUReset service with an Invalid Message Length");
	SendDiag_Request_Verify_Negative_Response(DiagAnchor3,"11 00 00","7F 11 13");
  TestStep("8","Send request 11 to enter ECUReset service");
	SendDiag_Request_Verify_Negative_Response(DiagAnchor3,"11","7F 11 13");
  PostCondition_Anchor( );
  }
  
testcase TCS_PK_FCA_AnchorUDSServer_ECUReset_NRC13_ProgrammingSession_NoSecurityLevel_38155()
{ 
  PreCondition_Anchor("TCS_PK_FCA_AnchorUDSServer_ECUReset_NRC13_ProgrammingSession_NoSecurityLevel_38155");
  testCaseComment("Actions");
  TestStep("1","Send request 10 03 to enter Extended Diagnostic Session");
	SendDiag_Request_Verify_Response(DiagAnchor3,"10 03","50 03 00 32 01 F4");
  TestStep("2,3","Send security unlock request 61 and 62");   
      Security_Seed_Key_Access(Anch3,Physical,Bosch);
  TestStep("4","Send request 10 02 to enter Progamming Diagnostic Session");
	SendDiag_Request_Verify_Response(DiagAnchor3,"10 02","50 02 00 32 01 F4");
  TestStep("5","Send request 11 00 00 to enter ECUReset service with an Invalid Message Length");
	SendDiag_Request_Verify_Negative_Response(DiagAnchor3,"11 00 00","7F 11 13");
  TestStep("6","Send request 11 to enter ECUReset service");
	SendDiag_Request_Verify_Negative_Response(DiagAnchor3,"11","7F 11 13");
  PostCondition_Anchor( );
  }
  
testcase TCS_PK_FCA_AnchorUDSServer_ECUReset_ProgrammingSession_0x61SecurityLevel_38169()
{  
  PreCondition_Anchor("TCS_PK_FCA_AnchorUDSServer_ECUReset_ProgrammingSession_0x61SecurityLevel_38169");
  testCaseComment("Actions");
  TestStep("1","Send request 10 03 to enter Extended Diagnostic Session");
	SendDiag_Request_Verify_Response(DiagAnchor3,"10 03","50 03 00 32 01 F4");
  TestStep("2,3","Send security unlock request 61 and 62");   
      Security_Seed_Key_Access(Anch3,Physical,Bosch);
  TestStep("4","Send request 10 02 to enter Progamming Diagnostic Session");
	SendDiag_Request_Verify_Response(DiagAnchor3,"10 02","50 02 00 32 01 F4");
  TestStep("5,6","Send security unlock request 61 and 62");   
      Security_Seed_Key_Access(Anch3,Physical,Bosch);
  TestStep("7","Send request 11 01 to enter ECU Reset");
	SendDiag_Request_Verify_Response(DiagAnchor3,"11 01","51 01");
  PostCondition_Anchor( );
  }
  
testcase TCS_PK_FCA_AnchorUDSServer_ECUReset_ProgrammingSession_0x65SecurityLevel_38149()
{
  PreCondition_Anchor("TCS_PK_FCA_AnchorUDSServer_ECUReset_ProgrammingSession_0x65SecurityLevel_38149");
  testCaseComment("Actions");
  TestStep("1","Send request 10 03 to enter Extended Diagnostic Session");
	SendDiag_Request_Verify_Response(DiagAnchor3,"10 03","50 03 00 32 01 F4");
  TestStep("2,3","Send security unlock request 61 and 62");   
      Security_Seed_Key_Access(Anch3,Physical,Bosch);
  TestStep("4","Send request 10 02 to enter Progamming Diagnostic Session");
	SendDiag_Request_Verify_Response(DiagAnchor3,"10 02","50 02 00 32 01 F4");
  TestStep("5,6","Send security unlock request 65 and 66");   
      Security_Seed_Key_Access(Anch3,Physical,Incar_1);
  TestStep("7","Send request 11 01 to enter ECU Reset");
	SendDiag_Request_Verify_Response(DiagAnchor3,"11 01","51 01");
  PostCondition_Anchor( );
  }
  
testcase TCS_PK_FCA_AnchorUDSServer_ECUReset_ProgrammingSession_NoSecurityLevel_38175()
{ 
  PreCondition_Anchor("TCS_PK_FCA_AnchorUDSServer_ECUReset_ProgrammingSession_NoSecurityLevel_38175");
  testCaseComment("Actions");
  TestStep("1","Send request 10 03 to enter Extended Diagnostic Session");
	SendDiag_Request_Verify_Response(DiagAnchor3,"10 03","50 03 00 32 01 F4");
  TestStep("2,3","Send security unlock request 61 and 62");   
      Security_Seed_Key_Access(Anch3,Physical,Bosch);
  TestStep("4","Send request 10 02 to enter Progamming Diagnostic Session");
	SendDiag_Request_Verify_Response(DiagAnchor3,"10 02","50 02 00 32 01 F4");
  TestStep("5","Send request 11 01 to enter ECU Reset");
	SendDiag_Request_Verify_Response(DiagAnchor3,"11 01","51 01");
  PostCondition_Anchor( );
  }
  
  
///////////////////////ClearDiagnosticInformation///////////////


testcase TCS_PK_FCA_AnchorUDSServer_ClearDiagnosticInformation_Extended_0x61SecurityLevel_62830()
{
  PreCondition_Anchor("TCS_PK_FCA_AnchorUDSServer_ClearDiagnosticInformation_ExtendedSession_0x61SecurityLevel_62830");
  testCaseComment("Actions");
  TestStep("1","Send request 10 03 to enter Extended Diagnostic Session");
	SendDiag_Request_Verify_Response(DiagAnchor3,"10 03","50 03 00 32 01 F4");
  TestStep("2,3","Send security unlock request 61 and 62");   
       	Security_Seed_Key_Access(Anch3,Physical,Bosch);
  TestStep("4","Send request 14 FF FF FF to enter ClearDiagnosticInformation");
	SendDiag_Request_Verify_Response(DiagAnchor3,"14 FF FF FF","54");
	PostCondition_Anchor( );
  }
  
testcase TCS_PK_FCA_AnchorUDSServer_ClearDiagnosticInformation_Extended_0x65SecurityLevel_62831()
{
  PreCondition_Anchor("TCS_PK_FCA_AnchorUDSServer_ClearDiagnosticInformation_ExtendedSession_0x65SecurityLevel_62831");
  testCaseComment("Actions");
  TestStep("1","Send request 10 03 to enter Extended Diagnostic Session");
	SendDiag_Request_Verify_Response(DiagAnchor3,"10 03","50 03 00 32 01 F4");
  TestStep("2,3","Send security unlock request 65 and 66");   
       	Security_Seed_Key_Access(Anch3,Physical,Incar_1);
  TestStep("4","Send request 14 FF FF FF to enter ClearDiagnosticInformation");
	SendDiag_Request_Verify_Response(DiagAnchor3,"14 FF FF FF","54");
	PostCondition_Anchor( );
  }

testcase TCS_PK_FCA_AnchorUDSServer_ClearDiagnosticInformation_Extended_NoSecurityLevel_62832()
{ 
  PreCondition_Anchor("TCS_PK_FCA_AnchorUDSServer_ClearDiagnosticInformation_ExtendedSession_NoSecurityLevel_62832");
  testCaseComment("Actions");
  TestStep("1","Send request 10 03 to enter Extended Diagnostic Session");
	SendDiag_Request_Verify_Response(DiagAnchor3,"10 03","50 03 00 32 01 F4");
  TestStep("2","Send request 14 FF FF FF to enter ClearDiagnosticInformation");
	SendDiag_Request_Verify_Response(DiagAnchor3,"14 FF FF FF","54");
	PostCondition_Anchor( );
  }
  
testcase TCS_PK_FCA_AnchorUDS_ClearDiagnosticInformation_NRC11_Programming_NoSecurityLevel_62833()
{
  PreCondition_Anchor("TCS_PK_FCA_AnchorUDSServer_ClearDiagnosticInformation_NRC11_ProgrammingSession_NoSecurityLevel_62833");
  testCaseComment("Actions");
  TestStep("1","Send request 10 03 to enter Extended Diagnostic Session");
	SendDiag_Request_Verify_Response(DiagAnchor3,"10 03","50 03 00 32 01 F4");
  TestStep("2,3","Send security unlock request 61 and 62");   
       	Security_Seed_Key_Access(Anch3,Physical,Bosch);
  TestStep("4","Send request 10 02 to enter Programming Diagnostic Session");
	SendDiag_Request_Verify_Response(DiagAnchor3,"10 02","50 02 00 32 01 F4");		
  TestStep("5","Send request 14 FF FF FF to enter ClearDiagnosticInformation");
	SendDiag_Request_Verify_Negative_Response(DiagAnchor3,"14 FF FF FF","7F 14 11");
	PostCondition_Anchor( );
  }
  
testcase TCS_PK_FCA_AnchorUDS_ClearDiagnosticInformation_NRC31_Extended_NoSecurityLevel_62834()
{
  PreCondition_Anchor("TCS_PK_FCA_AnchorUDSServer_ClearDiagnosticInformation_NRC31_ExtendedSession_NoSecurityLevel_62834");
  testCaseComment("Actions");
  TestStep("1","Send request 10 03 to enter Extended Diagnostic Session");
	SendDiag_Request_Verify_Response(DiagAnchor3,"10 03","50 03 00 32 01 F4");
  TestStep("2","Send request 14 00 00 00 to enter ClearDiagnosticInformation");
	SendDiag_Request_Verify_Negative_Response(DiagAnchor3,"14 00 00 00 ","7F 14 31");
  TestStep("3","Send request 14 AA AA AA to enter ClearDiagnosticInformation");
	SendDiag_Request_Verify_Negative_Response(DiagAnchor3,"14 AA AA AA","7F 14 31");
  TestStep("4","Send request 14 FF FF FF to enter ClearDiagnosticInformation");
	SendDiag_Request_Verify_Negative_Response(DiagAnchor3,"14 FF FF FE","7F 14 31");
  PostCondition_Anchor( );
  }
  
testcase TCS_PK_FCA_AnchorUDS_ClearDiagnosticInformation_NRC13_Extended_NoSecurityLevel_62835()
{
  PreCondition_Anchor("TCS_PK_FCA_AnchorUDSServer_ClearDiagnosticInformation_NRC13_ExtendedSession_NoSecurityLevel_62835");
  testCaseComment("Actions");
  TestStep("1","Send request 10 03 to enter Extended Diagnostic Session");
	SendDiag_Request_Verify_Response(DiagAnchor3,"10 03","50 03 00 32 01 F4");
  TestStep("2","Send request 14 to enter ClearDiagnosticInformation");
	SendDiag_Request_Verify_Negative_Response(DiagAnchor3,"14","7F 14 13");
  TestStep("3","Send request 14 00 00 to enter ClearDiagnosticInformation");
	SendDiag_Request_Verify_Negative_Response(DiagAnchor3,"14 00 00","7F 14 13");
  TestStep("4","Send request 14 00 00 00 00 to enter ClearDiagnosticInformation");
	SendDiag_Request_Verify_Negative_Response(DiagAnchor3,"14 00 00 00 00","7F 14 13");
  PostCondition_Anchor( );
  }
  
testcase TCS_PK_FCA_AnchorUDSServer_ClearDiagnosticInformation_NRC7F_Default_62837()
{
  PreCondition_Anchor("TCS_PK_FCA_AnchorUDSServer_ClearDiagnosticInformation_NRC7F_DefaultSession_62837");
  testCaseComment("Actions");
  TestStep("1","Send request 10 01 to enter Default Diagnostic Session");
	SendDiag_Request_Verify_Response(DiagAnchor3,"10 01","50 01 00 32 01 F4");
  TestStep("2","Send request 14 FF FF FF to enter ClearDiagnosticInformation");
	SendDiag_Request_Verify_Negative_Response(DiagAnchor3,"14 FF FF FF","7F 14 7F");
  PostCondition_Anchor( );
  }
  

/////////////////////RoutineControl_NRC12//////////////

testcase TCS_PK_FCA_AnchorUDSServer_RoutineControl_NRC12_RIDFA02_BLETxPowerTest_ExtendedSession_0x61SecurityLevel_46304()
{
  PreCondition_Anchor("TCS_PK_FCA_AnchorUDSServer_RoutineControl_NRC12_RIDFA02_BLETxPowerTest_ExtendedSession_0x61SecurityLevel_46304");
  testCaseComment("Actions");
  TestStep("1","Send request 10 03 to enter Extended Diagnostic Session");
	SendDiag_Request_Verify_Response(DiagAnchor3,"10 03","50 03 00 32 01 F4");
  TestStep("2,3","Send security unlock request 61 and 62");   
       	Security_Seed_Key_Access(Anch3,Physical,Bosch);
  TestStep("4","Send request 31 03 FA 02 to Request Routine control services");
	SendDiag_Request_Verify_Negative_Response(DiagAnchor3,"31 03 FA 02","7F 31 12");
	PostCondition_Anchor( );
  }
  
testcase TCS_PK_FCA_AnchorUDSServer_RoutineControl_NRC12_RIDFA03_AnchorImcRoundTripTest_ExtendedSession_0x61SecurityLevel_46310()
{
  PreCondition_Anchor("TCS_PK_FCA_AnchorUDSServer_RoutineControl_NRC12_RIDFA03_AnchorImcRoundTripTest_ExtendedSession_0x61SecurityLevel_46310");
  testCaseComment("Actions");
  TestStep("1","Send request 10 03 to enter Extended Diagnostic Session");
	SendDiag_Request_Verify_Response(DiagAnchor3,"10 03","50 03 00 32 01 F4");
  TestStep("2,3","Send security unlock request 61 and 62");   
       	Security_Seed_Key_Access(Anch3,Physical,Bosch);
  TestStep("4","Send request 31 03 FA 03 to Request Routine control services");
	SendDiag_Request_Verify_Negative_Response(DiagAnchor3,"31 03 FA 03","7F 31 12");
	PostCondition_Anchor( );
  }
  
testcase TCS_PK_FCA_AnchorUDSServer_RoutineControl_NRC12_RIDFA04_BLERSSMeasurement_ExtendedSession_0x61SecurityLevel_45626()
{
  PreCondition_Anchor("TCS_PK_FCA_AnchorUDSServer_RoutineControl_NRC12_RIDFA04_BLERSSMeasurement_ExtendedSession_0x61SecurityLevel_45626");
  testCaseComment("Actions");
  TestStep("1","Send request 10 03 to enter Extended Diagnostic Session");
	SendDiag_Request_Verify_Response(DiagAnchor3,"10 03","50 03 00 32 01 F4");
  TestStep("2,3","Send security unlock request 61 and 62");   
       	Security_Seed_Key_Access(Anch3,Physical,Bosch);
  TestStep("4","Send request 31 03 FA 04 to Request Routine control services");
	SendDiag_Request_Verify_Negative_Response(DiagAnchor3,"31 03 FA 04","7F 31 12");
	PostCondition_Anchor( );
  }
  
testcase TCS_PK_FCA_AnchorUDSServer_RoutineControl_NRC12_RIDFA05_FastSleep_ExtendedSession_0x61SecurityLevel_45632()
{
  PreCondition_Anchor("TCS_PK_FCA_AnchorUDSServer_RoutineControl_NRC12_RIDFA05_FastSleep_ExtendedSession_0x61SecurityLevel_45632");
  testCaseComment("Actions");
  TestStep("1","Send request 10 03 to enter Extended Diagnostic Session");
	SendDiag_Request_Verify_Response(DiagAnchor3,"10 03","50 03 00 32 01 F4");
  TestStep("2,3","Send security unlock request 61 and 62");   
       	Security_Seed_Key_Access(Anch3,Physical,Bosch);
  TestStep("4","Send request 31 02 FA 05 to Request Routine control services");
	SendDiag_Request_Verify_Negative_Response(DiagAnchor3,"31 02 FA 05","7F 31 12");
  TestStep("5","Send request 31 03 FA 05 to Request Routine control services");
	SendDiag_Request_Verify_Negative_Response(DiagAnchor3,"31 03 FA 05","7F 31 12");
	PostCondition_Anchor( );
  }
  
testcase TCS_PK_FCA_AnchorUDSServer_RoutineControl_NRC12_RIDFA0A_UWBTxLoopback_ExtendedSession_0x61SecurityLevel_45650()
{
  PreCondition_Anchor("TCS_PK_FCA_AnchorUDSServer_RoutineControl_NRC12_RIDFA0A_UWBTxLoopback_ExtendedSession_0x61SecurityLevel_45650");
  testCaseComment("Actions");
  TestStep("1","Send request 10 03 to enter Extended Diagnostic Session");
	SendDiag_Request_Verify_Response(DiagAnchor3,"10 03","50 03 00 32 01 F4");
  TestStep("2,3","Send security unlock request 61 and 62");   
       	Security_Seed_Key_Access(Anch3,Physical,Bosch);
  TestStep("4","Send request 31 02 FA 0A to Request Routine control services");
	SendDiag_Request_Verify_Negative_Response(DiagAnchor3,"31 02 FA 0A","7F 31 12");
  TestStep("5","Send request 31 03 FA 0A to Request Routine control services");
	SendDiag_Request_Verify_Negative_Response(DiagAnchor3,"31 03 FA 0A","7F 31 12");
	PostCondition_Anchor( );
  }
  
testcase TCS_PK_FCA_AnchorUDSServer_RoutineControl_NRC12_RIDFA0B_CarrierWaveMode_ExtendedSession_0x61SecurityLevel_45638()
{
  PreCondition_Anchor("TCS_PK_FCA_AnchorUDSServer_RoutineControl_NRC12_RIDFA0B_CarrierWaveMode_ExtendedSession_0x61SecurityLevel_45638");
  testCaseComment("Actions");
  TestStep("1","Send request 10 03 to enter Extended Diagnostic Session");
	SendDiag_Request_Verify_Response(DiagAnchor3,"10 03","50 03 00 32 01 F4");
  TestStep("2,3","Send security unlock request 61 and 62");   
       	Security_Seed_Key_Access(Anch3,Physical,Bosch);
  TestStep("4","Send request 31 02 FA 0B to Request Routine control services");
	SendDiag_Request_Verify_Negative_Response(DiagAnchor3,"31 02 FA 0B","7F 31 12");
  TestStep("5","Send request 31 03 FA 0B to Request Routine control services");
	SendDiag_Request_Verify_Negative_Response(DiagAnchor3,"31 03 FA 0B","7F 31 12");
	PostCondition_Anchor( );
  }
  
testcase TCS_PK_FCA_AnchorUDSServer_RoutineControl_NRC12_RIDFA11_Node2NodeRangingCCC_ExtendedSession_0x61SecurityLevel_45656()
{
  PreCondition_Anchor("TCS_PK_FCA_AnchorUDSServer_RoutineControl_NRC12_RIDFA11_Node2NodeRangingCCC_ExtendedSession_0x61SecurityLevel_45656");
  testCaseComment("Actions");
  TestStep("1","Send request 10 03 to enter Extended Diagnostic Session");
	SendDiag_Request_Verify_Response(DiagAnchor3,"10 03","50 03 00 32 01 F4");
  TestStep("2,3","Send security unlock request 61 and 62");   
       	Security_Seed_Key_Access(Anch3,Physical,Bosch);
  TestStep("4","Send request 31 03 FA 11 to Request Routine control services");
	SendDiag_Request_Verify_Negative_Response(DiagAnchor3,"31 03 FA 11","7F 31 12");
	PostCondition_Anchor( );
  }
  
testcase TCS_PK_FCA_AnchorUDSServer_RoutineControl_NRC12_RIDFA13_UWBTxTest_ExtendedSession_0x61SecurityLevel_45669()
{
  PreCondition_Anchor("TCS_PK_FCA_AnchorUDSServer_RoutineControl_NRC12_RIDFA13_UWBTxTest_ExtendedSession_0x61SecurityLevel_45669");
  testCaseComment("Actions");
  TestStep("1","Send request 10 03 to enter Extended Diagnostic Session");
	SendDiag_Request_Verify_Response(DiagAnchor3,"10 03","50 03 00 32 01 F4");
  TestStep("2,3","Send security unlock request 61 and 62");   
       	Security_Seed_Key_Access(Anch3,Physical,Bosch);
  TestStep("4","Send request 31 03 FA 13 to Request Routine control services");
	SendDiag_Request_Verify_Negative_Response(DiagAnchor3,"31 03 FA 13","7F 31 12");
	PostCondition_Anchor( );
  }
  
testcase TCS_PK_FCA_AnchorUDSServer_RoutineControl_NRC12_RIDFA21_StoreSHEKey_ExtendedSession_0x61SecurityLevel_54251()
{
  PreCondition_Anchor("TCS_PK_FCA_AnchorUDSServer_RoutineControl_NRC12_RIDFA21_StoreSHEKey_ExtendedSession_0x61SecurityLevel_54251");
  testCaseComment("Actions");
  TestStep("1","Send request 10 03 to enter Extended Diagnostic Session");
	SendDiag_Request_Verify_Response(DiagAnchor3,"10 03","50 03 00 32 01 F4");
  TestStep("2,3","Send security unlock request 61 and 62");   
       	Security_Seed_Key_Access(Anch3,Physical,Bosch);
  TestStep("4","Send request 31 03 FA 21 to Request Routine control services");
	SendDiag_Request_Verify_Negative_Response(DiagAnchor3,"31 03 FA 21","7F 31 12");
	PostCondition_Anchor( );
  }

testcase TCS_PK_FCA_AnchorUDSServer_RoutineControl_NRC12_RIDFA22_ActivateSecureBoot_ExtendedSession_0x61SecurityLevel_38257()
{
  PreCondition_Anchor("TCS_PK_FCA_AnchorUDSServer_RoutineControl_NRC12_RIDFA22_ActivateSecureBoot_ExtendedSession_0x61SecurityLevel_38257");
  testCaseComment("Actions");
  TestStep("1","Send request 10 03 to enter Extended Diagnostic Session");
	SendDiag_Request_Verify_Response(DiagAnchor3,"10 03","50 03 00 32 01 F4");
  TestStep("2,3","Send security unlock request 61 and 62");   
       	Security_Seed_Key_Access(Anch3,Physical,Bosch);
  TestStep("4","Send request 31 02 FA 22 to Request Routine control services");
	SendDiag_Request_Verify_Negative_Response(DiagAnchor3,"31 02 FA 22","7F 31 12");
  TestStep("5","Send request 31 03 FA 22 to Request Routine control services");
	SendDiag_Request_Verify_Negative_Response(DiagAnchor3,"31 03 FA 22","7F 31 12");
	PostCondition_Anchor( );
  }
  
testcase TCS_PK_FCA_AnchorUDSServer_RoutineControl_NRC12_RIDFA23_GetSHEEraseChallenge_ExtendedSession_0x61SecurityLevel_41572()
{
  PreCondition_Anchor("TCS_PK_FCA_AnchorUDSServer_RoutineControl_NRC12_RIDFA23_GetSHEEraseChallenge_ExtendedSession_0x61SecurityLevel_41572");
  testCaseComment("Actions");
  TestStep("1","Send request 10 03 to enter Extended Diagnostic Session");
	SendDiag_Request_Verify_Response(DiagAnchor3,"10 03","50 03 00 32 01 F4");
  TestStep("2,3","Send security unlock request 61 and 62");   
       	Security_Seed_Key_Access(Anch3,Physical,Bosch);
  TestStep("4","Send request 31 02 FA 23 to Request Routine control services");
	SendDiag_Request_Verify_Negative_Response(DiagAnchor3,"31 02 FA 23","7F 31 12");
  TestStep("5","Send request 31 03 FA 23 to Request Routine control services");
	SendDiag_Request_Verify_Negative_Response(DiagAnchor3,"31 03 FA 23","7F 31 12");
	PostCondition_Anchor( );
  }

testcase TCS_PK_FCA_AnchorUDSServer_RoutineControl_NRC12_RIDFA24_EraseSHEKeys_ExtendedSession_0x61SecurityLevel_53912()
{
  PreCondition_Anchor("TCS_PK_FCA_AnchorUDSServer_RoutineControl_NRC12_RIDFA24_EraseSHEKeys_ExtendedSession_0x61SecurityLevel_53912");
  testCaseComment("Actions");
  TestStep("1","Send request 10 03 to enter Extended Diagnostic Session");
	SendDiag_Request_Verify_Response(DiagAnchor3,"10 03","50 03 00 32 01 F4");
  TestStep("2,3","Send security unlock request 61 and 62");   
       	Security_Seed_Key_Access(Anch3,Physical,Bosch);
  TestStep("4","Send request 31 02 FA 24 to Request Routine control services");
	SendDiag_Request_Verify_Negative_Response(DiagAnchor3,"31 02 FA 24","7F 31 12");
  TestStep("5","Send request 31 03 FA 24 to Request Routine control services");
	SendDiag_Request_Verify_Negative_Response(DiagAnchor3,"31 03 FA 24","7F 31 12");
	PostCondition_Anchor( );
  }

testcase TCS_PK_FCA_AnchorUDSServer_RoutineControl_NRC12_RIDFB32_Extended_0x61Security_45686()
{
  PreCondition_Anchor("TCS_PK_FCA_AnchorUDSServer_RoutineControl_NRC12_RIDFB32_GenerateSecureCANInitialisationKeyPair_ExtendedSession_0x61SecurityLevel_45686");
  testCaseComment("Actions");
  TestStep("1","Send request 10 03 to enter Extended Diagnostic Session");
	SendDiag_Request_Verify_Response(DiagAnchor3,"10 03","50 03 00 32 01 F4");
  TestStep("2,3","Send security unlock request 61 and 62");   
       	Security_Seed_Key_Access(Anch3,Physical,Bosch);
  TestStep("4","Send request 31 02 FB 32 to Request Routine control services");
	SendDiag_Request_Verify_Negative_Response(DiagAnchor3,"31 02 FB 32","7F 31 12");
  TestStep("5","Send request 31 03 FB 32 to Request Routine control services");
	SendDiag_Request_Verify_Negative_Response(DiagAnchor3,"31 03 FB 32","7F 31 12");
	PostCondition_Anchor( );
  }
  
testcase TCS_PK_FCA_AnchorUDSServer_RoutineControl_NRC12_RIDFB33_SetECULifeCycleToInfield_ExtendedSession_0x61SecurityLevel_45692()
{
  PreCondition_Anchor("TCS_PK_FCA_AnchorUDSServer_RoutineControl_NRC12_RIDFB33_SetECULifeCycleToInfield_ExtendedSession_0x61SecurityLevel_45692");
  testCaseComment("Actions");
  TestStep("1","Send request 10 03 to enter Extended Diagnostic Session");
	SendDiag_Request_Verify_Response(DiagAnchor3,"10 03","50 03 00 32 01 F4");
  TestStep("2,3","Send security unlock request 61 and 62");   
       	Security_Seed_Key_Access(Anch3,Physical,Bosch);
  TestStep("4","Send request 31 02 FB 33 to Request Routine control services");
	SendDiag_Request_Verify_Negative_Response(DiagAnchor3,"31 02 FB 33","7F 31 12");
  TestStep("5","Send request 31 03 FB 33 to Request Routine control services");
	SendDiag_Request_Verify_Negative_Response(DiagAnchor3,"31 03 FB 33","7F 31 12");
	PostCondition_Anchor( );
  }
  
testcase TCS_PK_FCA_AnchorUDSServer_RoutineControl_NRC12_RIDFB35_WriteR4CEKCust_ExtendedSession_0x61SecurityLevel_45675()
{
  PreCondition_Anchor("TCS_PK_FCA_AnchorUDSServer_RoutineControl_NRC12_RIDFB35_WriteR4CEKCust_ExtendedSession_0x61SecurityLevel_45675");
  testCaseComment("Actions");
  TestStep("1","Send request 10 03 to enter Extended Diagnostic Session");
	SendDiag_Request_Verify_Response(DiagAnchor3,"10 03","50 03 00 32 01 F4");
  TestStep("2,3","Send security unlock request 61 and 62");   
       	Security_Seed_Key_Access(Anch3,Physical,Bosch);
  TestStep("4","Send request 31 02 FB 35 to Request Routine control services");
	SendDiag_Request_Verify_Negative_Response(DiagAnchor3,"31 02 FB 35","7F 31 12");
  TestStep("5","Send request 31 03 FB 35 to Request Routine control services");
	SendDiag_Request_Verify_Negative_Response(DiagAnchor3,"31 03 FB 35","7F 31 12");
	PostCondition_Anchor( );
  }
  
testcase TCS_PK_FCA_AnchorUDSServer_RoutineControl_NRC12_RIDFB36_SetECULifecycleToAnalysis_ExtendedSession_0x61SecurityLevel_45712()
{
  PreCondition_Anchor("TCS_PK_FCA_AnchorUDSServer_RoutineControl_NRC12_RIDFB36_SetECULifecycleToAnalysis_ExtendedSession_0x61SecurityLevel_45712");
  testCaseComment("Actions");
  TestStep("1","Send request 10 03 to enter Extended Diagnostic Session");
	SendDiag_Request_Verify_Response(DiagAnchor3,"10 03","50 03 00 32 01 F4");
  TestStep("2,3","Send security unlock request 61 and 62");   
       	Security_Seed_Key_Access(Anch3,Physical,Bosch);
  TestStep("4","Send request 31 02 FB 36 to Request Routine control services");
	SendDiag_Request_Verify_Negative_Response(DiagAnchor3,"31 02 FB 36","7F 31 12");
  TestStep("5","Send request 31 03 FB 36 to Request Routine control services");
	SendDiag_Request_Verify_Negative_Response(DiagAnchor3,"31 03 FB 36","7F 31 12");
	PostCondition_Anchor( );
  }
  
testcase TCS_PK_FCA_AnchorUDSServer_RoutineControl_NRC12_RIDFB38_WriteUwbReflashPubKey_ExtendedSession_0x61SecurityLevel_45718()
{
  PreCondition_Anchor("TCS_PK_FCA_AnchorUDSServer_RoutineControl_NRC12_RIDFB38_WriteUwbReflashPubKey_ExtendedSession_0x61SecurityLevel_45718");
  testCaseComment("Actions");
  TestStep("1","Send request 10 03 to enter Extended Diagnostic Session");
	SendDiag_Request_Verify_Response(DiagAnchor3,"10 03","50 03 00 32 01 F4");
  TestStep("2,3","Send security unlock request 61 and 62");   
       	Security_Seed_Key_Access(Anch3,Physical,Bosch);
  TestStep("4","Send request 31 02 FB 38 to Request Routine control services");
	SendDiag_Request_Verify_Negative_Response(DiagAnchor3,"31 02 FB 38","7F 31 12");
  TestStep("5","Send request 31 03 FB 38 to Request Routine control services");
	SendDiag_Request_Verify_Negative_Response(DiagAnchor3,"31 03 FB 38","7F 31 12");
	PostCondition_Anchor( );
  }
  
testcase TCS_PK_FCA_AnchorUDSServer_RoutineControl_NRC12_RIDFB40_MasterAnchorPairing1_ExtendedSession_0x65SecurityLevel_45699()
{
  PreCondition_Anchor("TCS_PK_FCA_AnchorUDSServer_RoutineControl_NRC12_RIDFB40_MasterAnchorPairing1_ExtendedSession_0x65SecurityLevel_45699");
  testCaseComment("Actions");
  TestStep("1","Send request 10 03 to enter Extended Diagnostic Session");
	SendDiag_Request_Verify_Response(DiagAnchor3,"10 03","50 03 00 32 01 F4");
  TestStep("2,3","Send security unlock request 61 and 62");   
       	Security_Seed_Key_Access(Anch3,Physical,Bosch);
  TestStep("4","Send request 31 02 FB 40 to Request Routine control services");
	SendDiag_Request_Verify_Negative_Response(DiagAnchor3,"31 02 FB 40","7F 31 12");
  TestStep("5","Send request 31 03 FB 40 to Request Routine control services");
	SendDiag_Request_Verify_Negative_Response(DiagAnchor3,"31 03 FB 40","7F 31 12");
	PostCondition_Anchor( );
  }
  
testcase TCS_PK_FCA_AnchorUDSServer_RoutineControl_NRC12_RIDFB41_MasterAnchorPairing2_ExtendedSession_0x65SecurityLevel_45724()
{
  PreCondition_Anchor("TCS_PK_FCA_AnchorUDSServer_RoutineControl_NRC12_RIDFB41_MasterAnchorPairing2_ExtendedSession_0x65SecurityLevel_45724");
  testCaseComment("Actions");
  TestStep("1","Send request 10 03 to enter Extended Diagnostic Session");
	SendDiag_Request_Verify_Response(DiagAnchor3,"10 03","50 03 00 32 01 F4");
  TestStep("2,3","Send security unlock request 61 and 62");   
       	Security_Seed_Key_Access(Anch3,Physical,Bosch);
  TestStep("4","Send request 31 02 FB 41 to Request Routine control services");
	SendDiag_Request_Verify_Negative_Response(DiagAnchor3,"31 02 FB 41","7F 31 12");
  TestStep("5","Send request 31 03 FB 41 to Request Routine control services");
	SendDiag_Request_Verify_Negative_Response(DiagAnchor3,"31 03 FB 41","7F 31 12");
	PostCondition_Anchor( );
  }
  
testcase TCS_PK_FCA_AnchorUDSServer_RoutineControl_NRC12_RIDFB42_SerialNumberBroadcast_ExtendedSession_0x61SecurityLevel_45730()
{
  PreCondition_Anchor("TCS_PK_FCA_AnchorUDSServer_RoutineControl_NRC12_RIDFB42_SerialNumberBroadcast_ExtendedSession_0x61SecurityLevel_45730");
  testCaseComment("Actions");
  TestStep("1","Send request 10 03 to enter Extended Diagnostic Session");
	SendDiag_Request_Verify_Response(DiagAnchor3,"10 03","50 03 00 32 01 F4");
  TestStep("2,3","Send security unlock request 61 and 62");   
       	Security_Seed_Key_Access(Anch3,Physical,Bosch);
  TestStep("4","Send request 31 02 FB 42 to Request Routine control services");
	SendDiag_Request_Verify_Negative_Response(DiagAnchor3,"31 02 FB 42","7F 31 12");
  TestStep("5","Send request 31 03 FB 42 to Request Routine control services");
	SendDiag_Request_Verify_Negative_Response(DiagAnchor3,"31 03 FB 42","7F 31 12");
	PostCondition_Anchor( );
  }

testcase TCS_PK_FCA_AnchorUDSServer_RoutineControl_NRC12_RIDFB43_SerialNumberCANIDStore_ExtendedSession_0x61SecurityLevel_45744()
{
  PreCondition_Anchor("TCS_PK_FCA_AnchorUDSServer_RoutineControl_NRC12_RIDFB43_SerialNumberCANIDStore_ExtendedSession_0x61SecurityLevel_45744");
  testCaseComment("Actions");
  TestStep("1","Send request 10 03 to enter Extended Diagnostic Session");
	SendDiag_Request_Verify_Response(DiagAnchor3,"10 03","50 03 00 32 01 F4");
  TestStep("2,3","Send security unlock request 61 and 62");   
       	Security_Seed_Key_Access(Anch3,Physical,Bosch);
  TestStep("4","Send request 31 02 FB 43 to Request Routine control services");
	SendDiag_Request_Verify_Negative_Response(DiagAnchor3,"31 02 FB 43","7F 31 12");
  TestStep("5","Send request 31 03 FB 43 to Request Routine control services");
	SendDiag_Request_Verify_Negative_Response(DiagAnchor3,"31 03 FB 43","7F 31 12");
	PostCondition_Anchor( );
  }
  
testcase TCS_PK_FCA_AnchorUDSServer_RoutineControl_NRC12_RIDFC03_CompareSWSignatures_ProgrammingSession_0x61SecurityLevel_45750()
{
  PreCondition_Anchor("TCS_PK_FCA_AnchorUDSServer_RoutineControl_NRC12_RIDFC03_CompareSWSignatures_ProgrammingSession_0x61SecurityLevel_45750");
  testCaseComment("Actions");
  TestStep("1","Send request 10 03 to enter Extended Diagnostic Session");
	SendDiag_Request_Verify_Response(DiagAnchor3,"10 03","50 03 00 32 01 F4");
  TestStep("2,3","Send security unlock request 61 and 62");   
       	Security_Seed_Key_Access(Anch3,Physical,Bosch);
  TestStep("4","Send request 31 02 FC 03 to Request Routine control services");
	SendDiag_Request_Verify_Negative_Response(DiagAnchor3,"31 02 FC 03","7F 31 12");
  TestStep("5","Send request 31 03 FC 03 to Request Routine control services");
	SendDiag_Request_Verify_Negative_Response(DiagAnchor3,"31 03 FC 03","7F 31 12");
	PostCondition_Anchor( );
  }
  
testcase TCS_PK_FCA_AnchorUDSServer_RoutineControl_NRC12_RIDFC04_VerifySignature_ProgrammingSession_0x61SecurityLevel_45762()
{
  PreCondition_Anchor("TCS_PK_FCA_AnchorUDSServer_RoutineControl_NRC12_RIDFC04_VerifySignature_ProgrammingSession_0x61SecurityLevel_45762");
  testCaseComment("Actions");
  TestStep("1","Send request 10 03 to enter Extended Diagnostic Session");
	SendDiag_Request_Verify_Response(DiagAnchor3,"10 03","50 03 00 32 01 F4");
  TestStep("2,3","Send security unlock request 61 and 62");   
       	Security_Seed_Key_Access(Anch3,Physical,Bosch);
  TestStep("4","Send request 31 02 FC 04 to Request Routine control services");
	SendDiag_Request_Verify_Negative_Response(DiagAnchor3,"31 02 FC 04","7F 31 12");
  TestStep("5","Send request 31 03 FC 04 to Request Routine control services");
	SendDiag_Request_Verify_Negative_Response(DiagAnchor3,"31 03 FC 04","7F 31 12");
	PostCondition_Anchor( );
  }
  
testcase TCS_PK_FCA_AnchorUDSServer_RoutineControl_NRC12_SIDChecks_ExtendedSession_NoSecurityLevel_45793()
{
  PreCondition_Anchor("TCS_PK_FCA_AnchorUDSServer_RoutineControl_NRC12_SIDChecks_ExtendedSession_NoSecurityLevel_45793");
  testCaseComment("Actions");
  TestStep("1","Send request 10 03 to enter Extended Diagnostic Session");
	SendDiag_Request_Verify_Response(DiagAnchor3,"10 03","50 03 00 32 01 F4");
  TestStep("2","Send request 31 00 FA 08 to Request Routine control services");
	SendDiag_Request_Verify_Negative_Response(DiagAnchor3,"31 00 FA 08","7F 31 12");
  TestStep("3","Send request 31 04 FA 08 to Request Routine control services");
	SendDiag_Request_Verify_Negative_Response(DiagAnchor3,"31 04 FA 08","7F 31 12");
  TestStep("4","Send request 31 AA FA 08 to Request Routine control services");
	SendDiag_Request_Verify_Negative_Response(DiagAnchor3,"31 AA FA 08","7F 31 12");
  TestStep("5","Send request 31 FF FA 08 to Request Routine control services");
	SendDiag_Request_Verify_Negative_Response(DiagAnchor3,"31 FF FA 08","7F 31 12");
	PostCondition_Anchor( );
  }
  
testcase TCS_PK_FCA_AnchorUDSServer_RoutineControl_NRC12_SIDChecks_ProgrammingSession_0x61SecurityLevel_45799()
{
  PreCondition_Anchor("TCS_PK_FCA_AnchorUDSServer_RoutineControl_NRC12_SIDChecks_ProgrammingSession_0x61SecurityLevel_45799");
  testCaseComment("Actions");
   TestStep("1","Send request 10 03 to enter Extended Diagnostic Session");
	SendDiag_Request_Verify_Response(DiagAnchor3,"10 03","50 03 00 32 01 F4");
   TestStep("2,3","Send security unlock request 61 and 62");   
       	Security_Seed_Key_Access(Anch3,Physical,Bosch);
   TestStep("4","Send request 10 02 to enter Programming Diagnostic Session");
	SendDiag_Request_Verify_Response(DiagAnchor3,"10 02","50 02 00 32 01 F4");
   TestStep("5","Send request 31 00 FC 03 to Request Routine control services");
	SendDiag_Request_Verify_Negative_Response(DiagAnchor3,"31 00 FC 03","7F 31 12");
   TestStep("6","Send request 31 04 FC 03 to Request Routine control services");
	SendDiag_Request_Verify_Negative_Response(DiagAnchor3,"31 04 FC 03","7F 31 12");
   TestStep("7","Send request 31 AA FC 03 to Request Routine control services");
	SendDiag_Request_Verify_Negative_Response(DiagAnchor3,"31 AA FC 03","7F 31 12");
   TestStep("8","Send request 31 FF FC 03 to Request Routine control services");
	SendDiag_Request_Verify_Negative_Response(DiagAnchor3,"31 FF FC 03","7F 31 12");
	PostCondition_Anchor( );
  }
  

///////////AnchorUDSServer_SecurityAccess////////




testcase TCS_PK_FCA_AnchorUDSServer_SecurityAccess_ExtendedSession_NoSecurityLevelTo0x61_62721()
{ 
  PreCondition_Anchor("TCS_PK_FCA_AnchorUDSServer_SecurityAccess_ExtendedSession_NoSecurityLevelTo0x61_62721");
  testCaseComment("Actions");
  TestStep("1","Send request 10 03 to enter Extended Diagnostic Session");
	SendDiag_Request_Verify_Response(DiagAnchor3,"10 03","50 03 00 32 01 F4");
  TestStep("2,3","Send security unlock request 61 and 62");   
      Security_Seed_Key_Access(Anch3,Physical,Bosch);
  PostCondition_Anchor( );
  }
  
testcase TCS_PK_FCA_AnchorUDSServer_SecurityAccess_ExtendedSession_NoSecurityLevelTo0x65_62723()
{
  PreCondition_Anchor("TCS_PK_FCA_AnchorUDSServer_SecurityAccess_ExtendedSession_NoSecurityLevelTo0x65_62723");
  testCaseComment("Actions");
  TestStep("1","Send request 10 03 to enter Extended Diagnostic Session");
	SendDiag_Request_Verify_Response(DiagAnchor3,"10 03","50 03 00 32 01 F4");
  TestStep("2,3","Send security unlock request 65 and 66");   
      Security_Seed_Key_Access(Anch3,Physical,Incar_1);
  PostCondition_Anchor( ); 
  }
  
testcase TCS_PK_FCA_AnchorUDSServer_SecurityAccess_ExtendedSession_SecurityLevel0x61To0x61_62724()
{
  PreCondition_Anchor("TCS_PK_FCA_AnchorUDSServer_SecurityAccess_ExtendedSession_SecurityLevel0x61To0x61_62724");
  testCaseComment("Actions");
  TestStep("1","Send request 10 03 to enter Extended Diagnostic Session");
	SendDiag_Request_Verify_Response(DiagAnchor3,"10 03","50 03 00 32 01 F4");
  TestStep("2,3","Send security unlock request 61 and 62");   
      Security_Seed_Key_Access(Anch3,Physical,Bosch);
   TestStep("4","Send request 27 61 to enter 0x61 security level seed");  
      SendDiag_Request_Verify_Response(DiagAnchor3,"27 61","67 61");
  PostCondition_Anchor( );
  }
  
testcase TCS_PK_FCA_AnchorUDSServer_SecurityAccess_ExtendedSession_SecurityLevel0x61To0x65_62727()
{
  PreCondition_Anchor("TCS_PK_FCA_AnchorUDSServer_SecurityAccess_ExtendedSession_SecurityLevel0x61To0x65_62727");
  testCaseComment("Actions");
  TestStep("1","Send request 10 03 to enter Extended Diagnostic Session");
	SendDiag_Request_Verify_Response(DiagAnchor3,"10 03","50 03 00 32 01 F4");
  TestStep("2,3","Send security unlock request 61 and 62");   
      Security_Seed_Key_Access(Anch3,Physical,Bosch);
  testWaitForTimeout(1000);
  TestStep("4,5","Send security unlock request 65 and 66");   
      Security_Seed_Key_Access(Anch3,Physical,Incar_1);
  PostCondition_Anchor( );
  testWaitForTimeout(1000);
  }
  
testcase TCS_PK_FCA_AnchorUDSServer_SecurityAccess_ExtendedSession_SecurityLevel0x65To0x61_62728()
{
  PreCondition_Anchor("TCS_PK_FCA_AnchorUDSServer_SecurityAccess_ExtendedSession_SecurityLevel0x65To0x61_62728");
  testCaseComment("Actions");
  TestStep("1","Send request 10 03 to enter Extended Diagnostic Session");
	SendDiag_Request_Verify_Response(DiagAnchor3,"10 03","50 03 00 32 01 F4");
  TestStep("2,3","Send security unlock request 65 and 66");   
      Security_Seed_Key_Access(Anch3,Physical,Incar_1);
  TestStep("4,5","Send security unlock request 61 and 62");   
      Security_Seed_Key_Access(Anch3,Physical,Bosch);
  PostCondition_Anchor( );
  }
  
testcase TCS_PK_FCA_AnchorUDSServer_SecurityAccess_ExtendedSession_SecurityLevel0x65To0x65_62729()
{ 
  PreCondition_Anchor("TCS_PK_FCA_AnchorUDSServer_SecurityAccess_ExtendedSession_SecurityLevel0x65To0x65_62729");
  testCaseComment("Actions");
  TestStep("1","Send request 10 03 to enter Extended Diagnostic Session");
	SendDiag_Request_Verify_Response(DiagAnchor3,"10 03","50 03 00 32 01 F4");
  TestStep("2,3","Send security unlock request 65 and 66");   
      Security_Seed_Key_Access(Anch3,Physical,Incar_1);
   TestStep("5","Send request 27 65 to enter 0x65 security level seed");  
      SendDiag_Request_Verify_Response(DiagAnchor3,"27 65","67 65");
  PostCondition_Anchor( );
  }

testcase TCS_PK_FCA_AnchorUDSServer_SecurityAccess_NRC12_ExtendedSession_NoSecurityLevel_62731()
{ 
  PreCondition_Anchor("TCS_PK_FCA_AnchorUDSServer_SecurityAccess_NRC12_ExtendedSession_NoSecurityLevel_62731");
  testCaseComment("Actions");
  testWaitForTimeout(1000);
  TestStep("1","Send request 10 03 to enter Extended Diagnostic Session");
	SendDiag_Request_Verify_Response(DiagAnchor3,"10 03","50 03 00 32 01 F4");
  TestStep("2","Send request 27 00 to enter an unsupported sub-function of SecurityAccess service");
	SendDiag_Request_Verify_Negative_Response(DiagAnchor3,"27 00","7F 27 12");
  TestStep("3","Send request 27 03 to enter an unsupported sub-function of SecurityAccess service");
	SendDiag_Request_Verify_Negative_Response(DiagAnchor3,"27 03","7F 27 12");
  TestStep("4","Send request 27 AA to enter an unsupported sub-function of SecurityAccess service");
	SendDiag_Request_Verify_Negative_Response(DiagAnchor3,"27 AA","7F 27 12");
  TestStep("5","Send request 27 FF to enter an unsupported sub-function of SecurityAccess service");
	SendDiag_Request_Verify_Negative_Response(DiagAnchor3,"27 FF","7F 27 12");
  PostCondition_Anchor( );
  }
  
testcase TCS_PK_FCA_AnchorUDSServer_SecurityAccess_NRC12_ProgrammingSession_NoSecurityLevel_62732()
{ 
  PreCondition_Anchor("TCS_PK_FCA_AnchorUDSServer_SecurityAccess_NRC12_ProgrammingSession_NoSecurityLevel_62732");
  testCaseComment("Actions");
  TestStep("1","Send request 10 03 to enter Extended Diagnostic Session");
	SendDiag_Request_Verify_Response(DiagAnchor3,"10 03","50 03 00 32 01 F4");
  TestStep("2,3","Send security unlock request 61 and 62");   
      Security_Seed_Key_Access(Anch3,Physical,Bosch);
  TestStep("4","Send request 10 02 to enter Progamming Diagnostic Session");
	SendDiag_Request_Verify_Response(DiagAnchor3,"10 02","50 02 00 32 01 F4");
  TestStep("5","Send request 10 02 to enter Progamming Diagnostic Session");
	SendDiag_Request_Verify_Response(DiagAnchor3,"10 02","50 02 00 32 01 F4");
  TestStep("6","Send request 27 00 to enter an unsupported sub-function of SecurityAccess service");
	SendDiag_Request_Verify_Negative_Response(DiagAnchor3,"27 00","7F 27 12");
  TestStep("7","Send request 27 03 to enter an unsupported sub-function of SecurityAccess service");
	SendDiag_Request_Verify_Negative_Response(DiagAnchor3,"27 03","7F 27 12");
  TestStep("8","Send request 27 AA to enter an unsupported sub-function of SecurityAccess service");
	SendDiag_Request_Verify_Negative_Response(DiagAnchor3,"27 AA","7F 27 12");
  TestStep("9","Send request 27 FF to enter an unsupported sub-function of SecurityAccess service");
	SendDiag_Request_Verify_Negative_Response(DiagAnchor3,"27 FF","7F 27 12");
  PostCondition_Anchor( );
  }
	
testcase TCS_PK_FCA_AnchorUDSServer_SecurityAccess_NRC13_ExtendedSession_NoSecurityLevel_62733()
{
  PreCondition_Anchor("TCS_PK_FCA_AnchorUDSServer_SecurityAccess_NRC13_ExtendedSession_NoSecurityLevel_62733");
  testCaseComment("Actions");
  TestStep("1","Send request 10 03 to enter Extended Diagnostic Session");
	SendDiag_Request_Verify_Response(DiagAnchor3,"10 03","50 03 00 32 01 F4");
  TestStep("2","Send request 27 to enter SecurityAccess service");
	SendDiag_Request_Verify_Negative_Response(DiagAnchor3,"27","7F 27 13");
  TestStep("2","Send request 27 61 00 to enter 0x61 security level seed");
	SendDiag_Request_Verify_Negative_Response(DiagAnchor3,"27 61 00","7F 27 13");
  TestStep("3","Send request 27 65 00 to enter 0x61 security level seed");
	SendDiag_Request_Verify_Negative_Response(DiagAnchor3,"27 65 00","7F 27 13");
  PostCondition_Anchor( );
  }
	
testcase TCS_PK_FCA_AnchorUDSServer_SecurityAccess_NRC13_ProgrammingSession_NoSecurityLevel_62734()
{ 
  PreCondition_Anchor("TCS_PK_FCA_AnchorUDSServer_SecurityAccess_NRC13_ProgrammingSession_NoSecurityLevel_62734");
  testCaseComment("Actions");
  TestStep("1","Send request 10 03 to enter Extended Diagnostic Session");
	SendDiag_Request_Verify_Response(DiagAnchor3,"10 03","50 03 00 32 01 F4");
  TestStep("2,3","Send security unlock request 61 and 62");   
      Security_Seed_Key_Access(Anch3,Physical,Bosch);
  TestStep("4","Send request 10 02 to enter Progamming Diagnostic Session");
	SendDiag_Request_Verify_Response(DiagAnchor3,"10 02","50 02 00 32 01 F4");
  TestStep("5","Send request 10 02 to enter Progamming Diagnostic Session");
	SendDiag_Request_Verify_Response(DiagAnchor3,"10 02","50 02 00 32 01 F4");
  TestStep("6","Send request 27 to enter SecurityAccess service");
	SendDiag_Request_Verify_Negative_Response(DiagAnchor3,"27","7F 27 13");
  TestStep("7","Send request 27 61 00 to enter 0x61 security level seed");
	SendDiag_Request_Verify_Negative_Response(DiagAnchor3,"27 61 00","7F 27 13");
  TestStep("8","Send request 27 65 00 to enter 0x61 security level seed");
	SendDiag_Request_Verify_Negative_Response(DiagAnchor3,"27 65 00","7F 27 13");
  PostCondition_Anchor( );
  }
  
testcase TCS_PK_FCA_AnchorUDSServer_SecurityAccess_NRC24_Extended_NoSecurityLevelTo0x61_62737()
{ 
  PreCondition_Anchor("TCS_PK_FCA_AnchorUDSServer_SecurityAccess_NRC24_Extended_NoSecurityLevelTo0x61_62737");
  testCaseComment("Actions");
  TestStep("1","Send request 10 03 to enter Extended Diagnostic Session");
	SendDiag_Request_Verify_Response(DiagAnchor3,"10 03","50 03 00 32 01 F4");
  TestStep("2","Send request 27 62 to enter invalid SecurityKey");  
      SendDiag_Request_Verify_Negative_Response(DiagAnchor3,"27 62 00 00 00 00 00 00 00 00 00 00 00 00 00 00 00 00 00 00 00 00 00 00 00 00 00 00 00 00 00 00 00 00 00 00 00 00 00 00 00 00 00 00 00 00 00 00 00 00 00 00 00 00 00 00 00 00 00 00 00 00 00 00 00 00","7F 27 24");
  PostCondition_Anchor( );
  }
	  
testcase TCS_PK_FCA_AnchorUDSServer_SecurityAccess_NRC24_Extended_NoSecurityLevelTo0x65_62738()
{ 
  PreCondition_Anchor("TCS_PK_FCA_AnchorUDSServer_SecurityAccess_NRC24_Extended_NoSecurityLevelTo0x65_62738");
  testCaseComment("Actions");
  TestStep("1","Send request 10 03 to enter Extended Diagnostic Session");
	SendDiag_Request_Verify_Response(DiagAnchor3,"10 03","50 03 00 32 01 F4");
  TestStep("2","Send request 27 66 to enter invalid SecurityKey");  
      SendDiag_Request_Verify_Negative_Response(DiagAnchor3,"27 66 00 00 00 00 00 00 00 00 00 00 00 00 00 00 00 00 00 00 00 00 00 00 00 00 00 00 00 00 00 00 00 00 00 00 00 00 00 00 00 00 00 00 00 00 00 00 00 00 00 00 00 00 00 00 00 00 00 00 00 00 00 00 00 00","7F 27 24");
  PostCondition_Anchor( );
  }
  
testcase TCS_PK_FCA_AnchorUDSServer_SecurityAccess_NRC24_Programming_NoSecurityLevelTo0x61_62739()
{ 
  PreCondition_Anchor("TCS_PK_FCA_AnchorUDSServer_SecurityAccess_NRC24_Programming_NoSecurityLevelTo0x61_62739");
  testCaseComment("Actions");
  TestStep("1","Send request 10 03 to enter Extended Diagnostic Session");
	SendDiag_Request_Verify_Response(DiagAnchor3,"10 03","50 03 00 32 01 F4");
  TestStep("2,3","Send security unlock request 61 and 62");   
      Security_Seed_Key_Access(Anch3,Physical,Bosch);
  TestStep("4","Send request 10 02 to enter Progamming Diagnostic Session");
	SendDiag_Request_Verify_Response(DiagAnchor3,"10 02","50 02 00 32 01 F4");
  TestStep("5","Send request 10 02 to enter Progamming Diagnostic Session");
	SendDiag_Request_Verify_Response(DiagAnchor3,"10 02","50 02 00 32 01 F4");
  TestStep("6","Send request 27 62 to enter invalid SecurityKey");  
      SendDiag_Request_Verify_Negative_Response(DiagAnchor3,"27 62 00 00 00 00 00 00 00 00 00 00 00 00 00 00 00 00 00 00 00 00 00 00 00 00 00 00 00 00 00 00 00 00 00 00 00 00 00 00 00 00 00 00 00 00 00 00 00 00 00 00 00 00 00 00 00 00 00 00 00 00 00 00 00 00","7F 27 24");
  PostCondition_Anchor( );
  }
  
testcase TCS_PK_FCA_AnchorUDSServer_SecurityAccess_NRC24_Programming_NoSecurityLevelTo0x61_62740()
{  
  PreCondition_Anchor("TCS_PK_FCA_AnchorUDSServer_SecurityAccess_NRC24_Programming_NoSecurityLevelTo0x61_62740");
  testCaseComment("Actions");
  TestStep("1","Send request 10 03 to enter Extended Diagnostic Session");
	SendDiag_Request_Verify_Response(DiagAnchor3,"10 03","50 03 00 32 01 F4");
  TestStep("2,3","Send security unlock request 61 and 62");   
      Security_Seed_Key_Access(Anch3,Physical,Bosch);
  TestStep("4","Send request 10 02 to enter Progamming Diagnostic Session");
	SendDiag_Request_Verify_Response(DiagAnchor3,"10 02","50 02 00 32 01 F4");
  TestStep("5","Send request 10 02 to enter Progamming Diagnostic Session");
	SendDiag_Request_Verify_Response(DiagAnchor3,"10 02","50 02 00 32 01 F4");
  TestStep("6","Send request 27 62 to enter invalid SecurityKey");  
      SendDiag_Request_Verify_Negative_Response(DiagAnchor3,"27 62 00 00 00 00 00 00 00 00 00 00 00 00 00 00 00 00 00 00 00 00 00 00 00 00 00 00 00 00 00 00 00 00 00 00 00 00 00 00 00 00 00 00 00 00 00 00 00 00 00 00 00 00 00 00 00 00 00 00 00 00 00 00 00 00","7F 27 24");
  PostCondition_Anchor( );
  }
  
testcase TCS_PK_FCA_AnchorUDSServer_SecurityAccess_NRC35_Extended_NoSecurityLevelTo0x61_62741()
{ 
  PreCondition_Anchor("TCS_PK_FCA_AnchorUDSServer_SecurityAccess_NRC35_Extended_NoSecurityLevelTo0x61_62741");
  testCaseComment("Actions");
  TestStep("1","Send request 10 03 to enter Extended Diagnostic Session");
	SendDiag_Request_Verify_Response(DiagAnchor3,"10 03","50 03 00 32 01 F4");
  TestStep("2","Send request 27 61 to enter 0x61 security level seed");  
      SendDiag_Request_Verify_Response(DiagAnchor3,"27 61","67 61 E2 74 11 5A 12 61 31 09 37 D3 19 A9 C7 A5 60 D4 31 32 33 34 35 36 37 38 39 41 42 43 44 45 46 00 00 00 00 00 00 00 00 00 00 00 00 00 00 00 00 00");
  TestStep("3","Send request 27 62 to enter invalid SecurityKey");  
      SendDiag_Request_Verify_Negative_Response(DiagAnchor3,"27 62 00 00 00 00 00 00 00 00 00 00 00 00 00 00 00 00 00 00 00 00 00 00 00 00 00 00 00 00 00 00 00 00 00 00 00 00 00 00 00 00 00 00 00 00 00 00 00 00 00 00 00 00 00 00 00 00 00 00 00 00 00 00 00 00","7F 27 35");
  PostCondition_Anchor( );
  }
  
testcase TCS_PK_FCA_AnchorUDSServer_SecurityAccess_NRC35_Extended_NoSecurityLevelTo0x65_62742()
{
  PreCondition_Anchor("TCS_PK_FCA_AnchorUDSServer_SecurityAccess_NRC35_Extended_NoSecurityLevelTo0x65_62742");
  testCaseComment("Actions");
  TestStep("1","Send request 10 03 to enter Extended Diagnostic Session");
	SendDiag_Request_Verify_Response(DiagAnchor3,"10 03","50 03 00 32 01 F4");
  TestStep("2","Send request 27 65 to enter 0x61 security level seed");  
      SendDiag_Request_Verify_Response(DiagAnchor3,"27 65","67 65 F1 A9 01 55 5A E0 BB 99 35 48 62 2F 40 2A DB E3 31 32 33 34 35 36 37 38 39 41 42 43 44 45 46 00 00 00 00 00 00 00 00 00 00 00 00 00 00 00 00 00");
  TestStep("3","Send request 27 66 to enter invalid SecurityKey");  
      SendDiag_Request_Verify_Negative_Response(DiagAnchor3,"27 66 00 00 00 00 00 00 00 00 00 00 00 00 00 00 00 00 00 00 00 00 00 00 00 00 00 00 00 00 00 00 00 00 00 00 00 00 00 00 00 00 00 00 00 00 00 00 00 00 00 00 00 00 00 00 00 00 00 00 00 00 00 00 00 00","7F 27 35");
  PostCondition_Anchor( );
  }
  
testcase TCS_PK_FCA_AnchorUDSServer_SecurityAccess_NRC35_Programming_NoSecurityLevelTo0x61_62745()
{ 
  PreCondition_Anchor("TCS_PK_FCA_AnchorUDSServer_SecurityAccess_NRC35_ProgrammingSession_NoSecurityLevelTo0x61_62745");
  testCaseComment("Actions");
  TestStep("1","Send request 10 03 to enter Extended Diagnostic Session");
	SendDiag_Request_Verify_Response(DiagAnchor3,"10 03","50 03 00 32 01 F4");
  TestStep("2,3","Send security unlock request 61 and 62");   
      Security_Seed_Key_Access(Anch3,Physical,Bosch);
  TestStep("4","Send request 10 02 to enter Progamming Diagnostic Session");
	SendDiag_Request_Verify_Response(DiagAnchor3,"10 02","50 02 00 32 01 F4");
  TestStep("5","Send request 10 02 to enter Progamming Diagnostic Session");
    SendDiag_Request_Verify_Response(DiagAnchor3,"10 02","50 02 00 32 01 F4");
  TestStep("6","Send request 27 61 to enter 0x61 security level seed");  
      SendDiag_Request_Verify_Response(DiagAnchor3,"27 61","67 61 E2 74 11 5A 12 61 31 09 37 D3 19 A9 C7 A5 60 D4 31 32 33 34 35 36 37 38 39 41 42 43 44 45 46 00 00 00 00 00 00 00 00 00 00 00 00 00 00 00 00 00");
  TestStep("7","Send request 27 62 to enter invalid SecurityKey");  
      SendDiag_Request_Verify_Negative_Response(DiagAnchor3,"27 62 00 00 00 00 00 00 00 00 00 00 00 00 00 00 00 00 00 00 00 00 00 00 00 00 00 00 00 00 00 00 00 00 00 00 00 00 00 00 00 00 00 00 00 00 00 00 00 00 00 00 00 00 00 00 00 00 00 00 00 00 00 00 00 00","7F 27 35");
  PostCondition_Anchor( );
  }
  
testcase TCS_PK_FCA_AnchorUDSServer_SecurityAccess_NRC35_Programming_NoSecurityLevelTo0x65_62747()
{
  PreCondition_Anchor("TCS_PK_FCA_AnchorUDSServer_SecurityAccess_NRC35_ProgrammingSession_NoSecurityLevelTo0x65_62747");
  testCaseComment("Actions");
  TestStep("1","Send request 10 03 to enter Extended Diagnostic Session");
	SendDiag_Request_Verify_Response(DiagAnchor3,"10 03","50 03 00 32 01 F4");
  TestStep("2,3","Send security unlock request 61 and 62");   
      Security_Seed_Key_Access(Anch3,Physical,Bosch);
  TestStep("4","Send request 10 02 to enter Progamming Diagnostic Session");
	SendDiag_Request_Verify_Response(DiagAnchor3,"10 02","50 02 00 32 01 F4");
  TestStep("5","Send request 10 02 to enter Progamming Diagnostic Session");
    SendDiag_Request_Verify_Response(DiagAnchor3,"10 02","50 02 00 32 01 F4");
  TestStep("6","Send request 27 65 to enter 0x61 security level seed");  
      SendDiag_Request_Verify_Response(DiagAnchor3,"27 65","67 65 F1 A9 01 55 5A E0 BB 99 35 48 62 2F 40 2A DB E3 31 32 33 34 35 36 37 38 39 41 42 43 44 45 46 00 00 00 00 00 00 00 00 00 00 00 00 00 00 00 00 00");
  TestStep("7","Send request 27 66 to enter invalid SecurityKey");  
      SendDiag_Request_Verify_Negative_Response(DiagAnchor3,"27 66 00 00 00 00 00 00 00 00 00 00 00 00 00 00 00 00 00 00 00 00 00 00 00 00 00 00 00 00 00 00 00 00 00 00 00 00 00 00 00 00 00 00 00 00 00 00 00 00 00 00 00 00 00 00 00 00 00 00 00 00 00 00 00 00","7F 27 35");
  PostCondition_Anchor( );
  }
  
testcase TCS_PK_FCA_AnchorUDSServer_SecurityAccess_NRC37_Extended_NoSecurityLevelTo0x61_62749()
{
  PreCondition_Anchor("TCS_PK_FCA_AnchorUDSServer_SecurityAccess_NRC37_ExtendedSession_NoSecurityLevelTo0x61_62749");
  testCaseComment("Actions");
  TestStep("1","Send request 10 03 to enter Extended Diagnostic Session");
	SendDiag_Request_Verify_Response(DiagAnchor3,"10 03","50 03 00 32 01 F4");
  TestStep("2","Send request 27 61 to enter 0x61 security level seed");  
      SendDiag_Request_Verify_Response(DiagAnchor3,"27 61","67 61 E2 74 11 5A 12 61 31 09 37 D3 19 A9 C7 A5 60 D4 31 32 33 34 35 36 37 38 39 41 42 43 44 45 46 00 00 00 00 00 00 00 00 00 00 00 00 00 00 00 00 00");
  TestStep("3","Send request 27 62 to enter invalid SecurityKey");  
      SendDiag_Request_Verify_Negative_Response(DiagAnchor3,"27 62 00 00 00 00 00 00 00 00 00 00 00 00 00 00 00 00 00 00 00 00 00 00 00 00 00 00 00 00 00 00 00 00 00 00 00 00 00 00 00 00 00 00 00 00 00 00 00 00 00 00 00 00 00 00 00 00 00 00 00 00 00 00 00 00","7F 27 35");
  TestStep("4","Send request 27 61 to enter 0x61 security level seed");  
      SendDiag_Request_Verify_Negative_Response(DiagAnchor3,"27 61","7F 27 37");
  TestStep("5","Send request 27 61 to enter 0x61 security level seed");  
      SendDiag_Request_Verify_Response(DiagAnchor3,"27 61","67 61 E2 74 11 5A 12 61 31 09 37 D3 19 A9 C7 A5 60 D4 31 32 33 34 35 36 37 38 39 41 42 43 44 45 46 00 00 00 00 00 00 00 00 00 00 00 00 00 00 00 00 00");
  PostCondition_Anchor( );
  }
  
testcase TCS_PK_FCA_AnchorUDSServer_SecurityAccess_NRC37_Extended_NoSecurityLevelTo0x65_62750()
{
  PreCondition_Anchor("TCS_PK_FCA_AnchorUDSServer_SecurityAccess_NRC37_ExtendedSession_NoSecurityLevelTo0x65_62750");
  testCaseComment("Actions");
  TestStep("1","Send request 10 03 to enter Extended Diagnostic Session");
	SendDiag_Request_Verify_Response(DiagAnchor3,"10 03","50 03 00 32 01 F4");
  TestStep("2","Send request 27 65 to enter 0x65 security level seed");  
      SendDiag_Request_Verify_Response(DiagAnchor3,"27 65","67 65 F1 A9 01 55 5A E0 BB 99 35 48 62 2F 40 2A DB E3 31 32 33 34 35 36 37 38 39 41 42 43 44 45 46 00 00 00 00 00 00 00 00 00 00 00 00 00 00 00 00 00");
  TestStep("3","Send request 27 66 to enter invalid SecurityKey");  
      SendDiag_Request_Verify_Negative_Response(DiagAnchor3,"27 66 00 00 00 00 00 00 00 00 00 00 00 00 00 00 00 00 00 00 00 00 00 00 00 00 00 00 00 00 00 00 00 00 00 00 00 00 00 00 00 00 00 00 00 00 00 00 00 00 00 00 00 00 00 00 00 00 00 00 00 00 00 00 00 00","7F 27 35");
  TestStep("4","Send request 27 65 to enter 0x65 security level seed");  
      SendDiag_Request_Verify_Negative_Response(DiagAnchor3,"27 65","7F 27 37");
  TestStep("5","Send request 27 65 to enter 0x65 security level seed");  
      SendDiag_Request_Verify_Response(DiagAnchor3,"27 65","67 65 F1 A9 01 55 5A E0 BB 99 35 48 62 2F 40 2A DB E3 31 32 33 34 35 36 37 38 39 41 42 43 44 45 46 00 00 00 00 00 00 00 00 00 00 00 00 00 00 00 00 00");
  PostCondition_Anchor( );
  }
   
testcase TCS_PK_FCA_AnchorUDSServer_SecurityAccess_NRC37_Programming_NoSecurityLevelTo0x61_62751()
{  
  PreCondition_Anchor("TCS_PK_FCA_AnchorUDSServer_SecurityAccess_NRC37_ProgrammingSession_NoSecurityLevelTo0x61_62751");
  testCaseComment("Actions");
  TestStep("1","Send request 10 03 to enter Extended Diagnostic Session");
	SendDiag_Request_Verify_Response(DiagAnchor3,"10 03","50 03 00 32 01 F4");
  TestStep("2,3","Send security unlock request 61 and 62");   
      Security_Seed_Key_Access(Anch3,Physical,Bosch);
  TestStep("4","Send request 10 02 to enter Progamming Diagnostic Session");
	SendDiag_Request_Verify_Response(DiagAnchor3,"10 02","50 02 00 32 01 F4");
  TestStep("5","Send request 10 02 to enter Progamming Diagnostic Session");
    SendDiag_Request_Verify_Response(DiagAnchor3,"10 02","50 02 00 32 01 F4");
  TestStep("6","Send request 27 61 to enter 0x61 security level seed");  
      SendDiag_Request_Verify_Response(DiagAnchor3,"27 61","67 61 E2 74 11 5A 12 61 31 09 37 D3 19 A9 C7 A5 60 D4 31 32 33 34 35 36 37 38 39 41 42 43 44 45 46 00 00 00 00 00 00 00 00 00 00 00 00 00 00 00 00 00");
  TestStep("7","Send request 27 62 to enter invalid SecurityKey");  
      SendDiag_Request_Verify_Negative_Response(DiagAnchor3,"27 62 00 00 00 00 00 00 00 00 00 00 00 00 00 00 00 00 00 00 00 00 00 00 00 00 00 00 00 00 00 00 00 00 00 00 00 00 00 00 00 00 00 00 00 00 00 00 00 00 00 00 00 00 00 00 00 00 00 00 00 00 00 00 00 00","7F 27 35");
  TestStep("8","Send request 27 61 to enter 0x61 security level seed"); 
  testWaitForTimeout(50);
      SendDiag_Request_Verify_Negative_Response(DiagAnchor3,"27 61","7F 27 37");
  TestStep("9","Send request 27 61 to enter 0x61 security level seed");  
      SendDiag_Request_Verify_Response(DiagAnchor3,"27 61","67 61 E2 74 11 5A 12 61 31 09 37 D3 19 A9 C7 A5 60 D4 31 32 33 34 35 36 37 38 39 41 42 43 44 45 46 00 00 00 00 00 00 00 00 00 00 00 00 00 00 00 00 00");
  PostCondition_Anchor( );
  }
	  
testcase TCS_PK_FCA_AnchorUDSServer_SecurityAccess_NRC37_Programming_NoSecurityLevelTo0x65_62752()
{
  PreCondition_Anchor("TCS_PK_FCA_AnchorUDSServer_SecurityAccess_NRC37_Programming_NoSecurityLevelTo0x65_62752");
  testCaseComment("Actions");
  TestStep("1","Send request 10 03 to enter Extended Diagnostic Session");
	SendDiag_Request_Verify_Response(DiagAnchor3,"10 03","50 03 00 32 01 F4");
  TestStep("2,3","Send security unlock request 61 and 62");   
      Security_Seed_Key_Access(Anch3,Physical,Bosch);
  TestStep("4","Send request 10 02 to enter Progamming Diagnostic Session");
	SendDiag_Request_Verify_Response(DiagAnchor3,"10 02","50 02 00 32 01 F4");
  TestStep("5","Send request 10 02 to enter Progamming Diagnostic Session");
    SendDiag_Request_Verify_Response(DiagAnchor3,"10 02","50 02 00 32 01 F4");
  TestStep("6","Send request 27 65 to enter 0x65 security level seed");  
      SendDiag_Request_Verify_Response(DiagAnchor3,"27 65","67 65 F1 A9 01 55 5A E0 BB 99 35 48 62 2F 40 2A DB E3 31 32 33 34 35 36 37 38 39 41 42 43 44 45 46 00 00 00 00 00 00 00 00 00 00 00 00 00 00 00 00 00");
  TestStep("7","Send request 27 66 to enter invalid SecurityKey");  
      SendDiag_Request_Verify_Negative_Response(DiagAnchor3,"27 66 00 00 00 00 00 00 00 00 00 00 00 00 00 00 00 00 00 00 00 00 00 00 00 00 00 00 00 00 00 00 00 00 00 00 00 00 00 00 00 00 00 00 00 00 00 00 00 00 00 00 00 00 00 00 00 00 00 00 00 00 00 00 00 00","7F 27 35");
  testWaitForTimeout(50);
  TestStep("8","Send request 27 65 to enter 0x65 security level seed");  
      SendDiag_Request_Verify_Negative_Response(DiagAnchor3,"27 65","7F 27 37");
  TestStep("9","Send request 27 65 to enter 0x65 security level seed");  
      SendDiag_Request_Verify_Response(DiagAnchor3,"27 65","67 65 F1 A9 01 55 5A E0 BB 99 35 48 62 2F 40 2A DB E3 31 32 33 34 35 36 37 38 39 41 42 43 44 45 46 00 00 00 00 00 00 00 00 00 00 00 00 00 00 00 00 00");
  PostCondition_Anchor( );
  }
	
testcase TCS_PK_FCA_AnchorUDSServer_SecurityAccess_NRC7F_Default_0x61SecurityLevel_62753()
{ 
  PreCondition_Anchor("TCS_PK_FCA_AnchorUDSServer_SecurityAccess_NRC7F_DefaultSession_0x61SecurityLevel_62753");
  testCaseComment("Actions");
  TestStep("1","Send request 10 01 to enter Default Diagnostic Session");
	SendDiag_Request_Verify_Response(DiagAnchor3,"10 01","50 01 00 32 01 F4");
  TestStep("2","Send request 27 to enter SecurityAccess service");
	SendDiag_Request_Verify_Negative_Response(DiagAnchor3,"27","7F 27 7F");
  PostCondition_Anchor( );
  }
  
testcase TCS_PK_FCA_AnchorUDSServer_SecurityAccess_Programming_NoSecurityLevelTo0x61_62754()
{ 
  PreCondition_Anchor("TCS_PK_FCA_AnchorUDSServer_SecurityAccess_ProgrammingSession_NoSecurityLevelTo0x61_62754");
  testCaseComment("Actions");
  TestStep("1","Send request 10 03 to enter Extended Diagnostic Session");
	SendDiag_Request_Verify_Response(DiagAnchor3,"10 03","50 03 00 32 01 F4");
  TestStep("2,3","Send security unlock request 61 and 62");   
      Security_Seed_Key_Access(Anch3,Physical,Bosch);
  TestStep("4","Send request 10 02 to enter Progamming Diagnostic Session");
	SendDiag_Request_Verify_Response(DiagAnchor3,"10 02","50 02 00 32 01 F4");
  TestStep("5","Send request 10 02 to enter Progamming Diagnostic Session");
	SendDiag_Request_Verify_Response(DiagAnchor3,"10 02","50 02 00 32 01 F4");
  TestStep("6,7","Send security unlock request 61 and 62");   
      Security_Seed_Key_Access(Anch3,Physical,Bosch);
  PostCondition_Anchor( );
  }
  
testcase TCS_PK_FCA_AnchorUDSServer_SecurityAccess_Programming_NoSecurityLevelTo0x65_62757()
{ 
  PreCondition_Anchor("TCS_PK_FCA_AnchorUDSServer_SecurityAccess_ProgrammingSession_NoSecurityLevelTo0x65_62757");
  testCaseComment("Actions");
  TestStep("1","Send request 10 03 to enter Extended Diagnostic Session");
	SendDiag_Request_Verify_Response(DiagAnchor3,"10 03","50 03 00 32 01 F4");
  TestStep("2,3","Send security unlock request 61 and 62");   
      Security_Seed_Key_Access(Anch3,Physical,Bosch);
  TestStep("4","Send request 10 02 to enter Progamming Diagnostic Session");
	SendDiag_Request_Verify_Response(DiagAnchor3,"10 02","50 02 00 32 01 F4");
  TestStep("5","Send request 10 02 to enter Progamming Diagnostic Session");
	SendDiag_Request_Verify_Response(DiagAnchor3,"10 02","50 02 00 32 01 F4");
  TestStep("6,7","Send security unlock request 65 and 66");   
      Security_Seed_Key_Access(Anch3,Physical,Incar_1);
  PostCondition_Anchor( );
  }
  
testcase TCS_PK_FCA_AnchorUDSServer_SecurityAccess_Programming_SecurityLevel0x61To0x61_62758()
{
  PreCondition_Anchor("TCS_PK_FCA_AnchorUDSServer_SecurityAccess_ProgrammingSession_SecurityLevel0x61To0x61_62758");
  testCaseComment("Actions");
  TestStep("1","Send request 10 03 to enter Extended Diagnostic Session");
	SendDiag_Request_Verify_Response(DiagAnchor3,"10 03","50 03 00 32 01 F4");
  TestStep("2,3","Send security unlock request 61 and 62");   
      Security_Seed_Key_Access(Anch3,Physical,Bosch);
  TestStep("4","Send request 10 02 to enter Progamming Diagnostic Session");
	SendDiag_Request_Verify_Response(DiagAnchor3,"10 02","50 02 00 32 01 F4");
  TestStep("5","Send request 27 61 to enter 0x61 security level seed");  
      SendDiag_Request_Verify_Response(DiagAnchor3,"27 61","67 61");
  PostCondition_Anchor( );
  }
  
testcase TCS_PK_FCA_AnchorUDSServer_SecurityAccess_Programming_SecurityLevel0x61To0x65_62759()
{
  PreCondition_Anchor("TCS_PK_FCA_AnchorUDSServer_SecurityAccess_ProgrammingSession_SecurityLevel0x61To0x65_62759");
  testCaseComment("Actions");
  TestStep("1","Send request 10 03 to enter Extended Diagnostic Session");
	SendDiag_Request_Verify_Response(DiagAnchor3,"10 03","50 03 00 32 01 F4");
  TestStep("2,3","Send security unlock request 61 and 62");   
      Security_Seed_Key_Access(Anch3,Physical,Bosch);
  TestStep("4","Send request 10 02 to enter Progamming Diagnostic Session");
	SendDiag_Request_Verify_Response(DiagAnchor3,"10 02","50 02 00 32 01 F4");
  TestStep("5,6","Send security unlock request 65 and 66");   
      Security_Seed_Key_Access(Anch3,Physical,Incar_1);
  PostCondition_Anchor( );
  }
  
testcase TCS_PK_FCA_AnchorUDSServer_SecurityAccess_Programming_SecurityLevel0x65To0x61_62760()
{
  PreCondition_Anchor("TCS_PK_FCA_AnchorUDSServer_SecurityAccess_ProgrammingSession_SecurityLevel0x65To0x61_62760");
  testCaseComment("Actions");
  TestStep("1","Send request 10 03 to enter Extended Diagnostic Session");
	SendDiag_Request_Verify_Response(DiagAnchor3,"10 03","50 03 00 32 01 F4");
  TestStep("2,3","Send security unlock request 65 and 66");   
      Security_Seed_Key_Access(Anch3,Physical,Incar_1);
  TestStep("4","Send request 10 02 to enter Progamming Diagnostic Session");
	SendDiag_Request_Verify_Response(DiagAnchor3,"10 02","50 02 00 32 01 F4");
  TestStep("5,6","Send security unlock request 61 and 62");   
      Security_Seed_Key_Access(Anch3,Physical,Bosch);
  PostCondition_Anchor( );
  }
	  
testcase TCS_PK_FCA_AnchorUDSServer_SecurityAccess_Programming_SecurityLevel0x65To0x65_62761()
{
  PreCondition_Anchor("TCS_PK_FCA_AnchorUDSServer_SecurityAccess_ProgrammingSession_SecurityLevel0x65To0x65_62761");
  testCaseComment("Actions");
  TestStep("1","Send request 10 03 to enter Extended Diagnostic Session");
	SendDiag_Request_Verify_Response(DiagAnchor3,"10 03","50 03 00 32 01 F4");
  TestStep("2,3","Send security unlock request 65 and 66");   
      Security_Seed_Key_Access(Anch3,Physical,Incar_1);
  TestStep("4","Send request 10 02 to enter Progamming Diagnostic Session");
	SendDiag_Request_Verify_Response(DiagAnchor3,"10 02","50 02 00 32 01 F4");
  TestStep("5","Send request 27 65 to enter 0x61 security level seed");  
      SendDiag_Request_Verify_Response(DiagAnchor3,"27 65","67 65");
  PostCondition_Anchor( );
  }





